## kconfigs/workflows/Kconfig
```kconfig
config HAVE_SUPPORTS_PURE_IOMAP
	bool

source "kconfigs/workflows/Kconfig.bootlinux"

config WORKFLOWS
	bool "Enable different target workflows"
	default y
	select KDEVOPS_ANSIBLE_PROVISION_ENABLE
	help
	  If you want to do something other than just bring up of target systems
	  enable this option. For instance, you may want to easily boot linux
	  and/or run fstests.

if WORKFLOWS

menu "Shared workflow configuration"
source "kconfigs/workflows/Kconfig.shared"
endmenu

choice
	prompt "Target Linux kernel to use"
	default WORKFLOW_LINUX_DISTRO if !QEMU_ENABLE_EXTRA_DRIVE_LARGEIO
	default WORKFLOW_LINUX_CUSTOM if QEMU_ENABLE_EXTRA_DRIVE_LARGEIO

config WORKFLOW_LINUX_DISTRO
	bool "Distro kernel"
	help
	  If you are targeting a workflow to run on a distribution kernel
	  enable this.

config WORKFLOW_LINUX_CUSTOM
	bool "Upstream Linux or custom kernel"
	select BOOTLINUX
	help
	  If you are targeting a workflow to run on a vanilla upstream
	  linux, linux-stable, linux-next, or a custom kernel you want to
	  build and install enable this.

config WORKFLOW_LINUX_PACKAGED
	bool "Install pre-built kernel package"
	output yaml
	help
	  Choose this option to install a pre-built kernel package on each
	  target node.

	  By default, the kernel packages reside in
	  workflows/linux/artifacts. Later we can introduce a Kconfig
	  option that lets kdevops pull the packages from other
	  locations.

endchoice

if WORKFLOW_LINUX_CUSTOM
menu "Get and install Linux from git"
config BOOTLINUX
	bool "Enable getting and installing Linux from git"
	default n
	help
	  This option will allow the 'make linux' target be usable for you
	  to just get Linux from git, or to install it as well.

	  Say y unless you don't want to have 'make linux' do anything.

source "workflows/linux/Kconfig"
endmenu
endif # WORKFLOW_LINUX_CUSTOM

if WORKFLOW_LINUX_PACKAGED
config BOOTLINUX
	bool
	default y
endif # WORKFLOW_LINUX_PACKAGED

config WORKFLOWS_TESTS
	bool "Enable selection of test workflows"
	default n

if WORKFLOWS_TESTS

config WORKFLOWS_TESTS_DEMOS
	bool "Enable demo workflows"
	help
	 If you are a new developer to kdevops this is where you can look at
	 for simple examples of workflows. Although these are considered
	 hello-world simple in nature, some of them are actually useful tests.

if WORKFLOWS_TESTS_DEMOS
source "kconfigs/workflows/Kconfig.demo"
endif

config WORKFLOWS_LINUX_TESTS
	bool "Linux subsystem tests"
	help
	 Enable this to allow let you select which Linux test frameworks you
	 want to enable. These are tests for specific subsystems.

if WORKFLOWS_LINUX_TESTS

config WORKFLOWS_DEDICATED_WORKFLOW
	bool "Are you only targeting one subsystem test?"
	default y
	help
	 Enable this to if you are only wanting to test one main Linux
	 subsystem. If you enable this, a subsystem test in kdevops might
	 then allow you to grow the number of nodes you are to use to cover
	 all aspects of that subsystem. If you want to test two major subsystems
	 then you'd end up spawning nodes for both subsystems and we don't
	 support that yet. But if you do want to test more than one subsystem,
	 and disable this dedicated workflow option, you'd only get two default
	 nodes spawned.

	 If you disable this you the respective subsystem target test baseline
	 targets may not work as they are intended to work with a node setup
	 dedicated to only one subsystem test. In other words, if you disable
	 this option you are on your own, good luck!

if WORKFLOWS_DEDICATED_WORKFLOW

choice
	prompt "Dedicated target Linux test workflow"
	default KDEVOPS_WORKFLOW_DEDICATE_FSTESTS

config KDEVOPS_WORKFLOW_DEDICATE_FSTESTS
	bool "fstests"
	select KDEVOPS_WORKFLOW_ENABLE_FSTESTS
	depends on !KDEVOPS_USE_DECLARED_HOSTS
	help
	  This will dedicate your configuration only to fstests.

	  Select this option if you are doing filesystem development and want
	  to target development for a filesystem and enable fstests so that
	  you can test the filesystem.

	  The fstests git tree will be cloned, and set up for you, and
	  you will be able to run create a baseline for your target filesystem,
	  and also test to ensure you don't regress that baseline. If a baseline
	  already exists against your distribution you will be able to ensure
	  you don't regress against development changes on your kernel.

config KDEVOPS_WORKFLOW_DEDICATE_BLKTESTS
	bool "blktests"
	depends on !KDEVOPS_USE_DECLARED_HOSTS
	select KDEVOPS_WORKFLOW_ENABLE_BLKTESTS
	help
	  This will dedicate your configuration only to blktests.

config KDEVOPS_WORKFLOW_DEDICATE_CXL
	bool "cxl"
	depends on !KDEVOPS_USE_DECLARED_HOSTS
	select KDEVOPS_WORKFLOW_ENABLE_CXL
	help
	  This will dedicate your configuration only to cxl work.

	  This will expose certain make targets which you can use to get
	  ramped up with all CXL development tools and testing.

	  Note that this does not ensure you have CXL hardware enabled or
	  emulated, that will depend on the type of node you are using.
	  If you are using libvirt you will want to enable in kdevops
	  the symbol CONFIG_QEMU_ENABLE_CXL.

config KDEVOPS_WORKFLOW_DEDICATE_PYNFS
	bool "pynfs"
	depends on !KDEVOPS_USE_DECLARED_HOSTS
	select KDEVOPS_WORKFLOW_ENABLE_PYNFS
	help
	  This will dedicate your configuration only to running pynfs
	  (over loopback).

config KDEVOPS_WORKFLOW_DEDICATE_SELFTESTS
	bool "Linux kernel selftests"
	depends on !KDEVOPS_USE_DECLARED_HOSTS
	select KDEVOPS_WORKFLOW_ENABLE_SELFTESTS
	help
	  This will dedicate your configuration only to Linux kernel
	  selftests work. Note that you will need at least 8 GiB of RAM
	  for your target guests.

config KDEVOPS_WORKFLOW_DEDICATE_GITR
	bool "gitr"
	depends on !KDEVOPS_USE_DECLARED_HOSTS
	select KDEVOPS_WORKFLOW_ENABLE_GITR
	help
	  This will dedicate your configuration to running only the
	  multi-threaded git regression workflow.

config KDEVOPS_WORKFLOW_DEDICATE_LTP
	bool "ltp"
	depends on !KDEVOPS_USE_DECLARED_HOSTS
	select KDEVOPS_WORKFLOW_ENABLE_LTP
	help
	  This will dedicate your configuration to running only the
	  ltp workflow in separate target nodes per testing group.

config KDEVOPS_WORKFLOW_DEDICATE_NFSTEST
	bool "nfstest"
	depends on !KDEVOPS_USE_DECLARED_HOSTS
	select KDEVOPS_WORKFLOW_ENABLE_NFSTEST
	help
	  This will dedicate your configuration to running only the
	  nfstest workflow in separate target nodes per testing group.

config KDEVOPS_WORKFLOW_DEDICATE_SYSBENCH
	bool "sysbench"
	depends on !KDEVOPS_USE_DECLARED_HOSTS
	select KDEVOPS_WORKFLOW_ENABLE_SYSBENCH
	help
	  This will dedicate your configuration to running only the
	  sysbench workflow.

config KDEVOPS_WORKFLOW_DEDICATE_MMTESTS
	bool "mmtests"
	depends on !KDEVOPS_USE_DECLARED_HOSTS
	select KDEVOPS_WORKFLOW_ENABLE_MMTESTS
	help
	  This will dedicate your configuration to running only the
	  mmtests workflow for memory fragmentation testing.

config KDEVOPS_WORKFLOW_DEDICATE_FIO_TESTS
	bool "fio-tests"
	depends on !KDEVOPS_USE_DECLARED_HOSTS
	select KDEVOPS_WORKFLOW_ENABLE_FIO_TESTS
	help
	  This will dedicate your configuration to running only the
	  fio-tests workflow for comprehensive storage performance testing.

config KDEVOPS_WORKFLOW_DEDICATE_AI
	bool "ai"
	depends on !KDEVOPS_USE_DECLARED_HOSTS
	select KDEVOPS_WORKFLOW_ENABLE_AI
	help
	  This will dedicate your configuration to running only the
	  AI workflow for vector database performance testing.

config KDEVOPS_WORKFLOW_DEDICATE_VLLM
	bool "vllm"
	select KDEVOPS_WORKFLOW_ENABLE_VLLM
	help
	  This will dedicate your configuration to running only the
	  vLLM Production Stack workflow for deploying and benchmarking
	  large language models with Kubernetes.

config KDEVOPS_WORKFLOW_DEDICATE_MINIO
	bool "minio"
	select KDEVOPS_WORKFLOW_ENABLE_MINIO
	help
	  This will dedicate your configuration to running only the
	  MinIO workflow for S3 storage benchmarking with Warp testing.

config KDEVOPS_WORKFLOW_DEDICATE_BUILD_LINUX
	bool "build-linux"
	depends on !KDEVOPS_USE_DECLARED_HOSTS
	select KDEVOPS_WORKFLOW_ENABLE_BUILD_LINUX
	help
	  This will dedicate your configuration to running only the
	  build-linux workflow for repeated Linux kernel builds.

endchoice

config KDEVOPS_WORKFLOW_NAME
	string
	output yaml
	default "fstests" if KDEVOPS_WORKFLOW_DEDICATE_FSTESTS
	default "blktests" if KDEVOPS_WORKFLOW_DEDICATE_BLKTESTS
	default "cxl" if KDEVOPS_WORKFLOW_DEDICATE_CXL
	default "pynfs" if KDEVOPS_WORKFLOW_DEDICATE_PYNFS
	default "selftests" if KDEVOPS_WORKFLOW_DEDICATE_SELFTESTS
	default "gitr" if KDEVOPS_WORKFLOW_DEDICATE_GITR
	default "ltp" if KDEVOPS_WORKFLOW_DEDICATE_LTP
	default "nfstest" if KDEVOPS_WORKFLOW_DEDICATE_NFSTEST
	default "sysbench" if KDEVOPS_WORKFLOW_DEDICATE_SYSBENCH
	default "mmtests" if KDEVOPS_WORKFLOW_DEDICATE_MMTESTS
	default "fio-tests" if KDEVOPS_WORKFLOW_DEDICATE_FIO_TESTS
	default "ai" if KDEVOPS_WORKFLOW_DEDICATE_AI
	default "vllm" if KDEVOPS_WORKFLOW_DEDICATE_VLLM
	default "minio" if KDEVOPS_WORKFLOW_DEDICATE_MINIO
	default "build-linux" if KDEVOPS_WORKFLOW_DEDICATE_BUILD_LINUX

endif

if !WORKFLOWS_DEDICATED_WORKFLOW

config KDEVOPS_WORKFLOW_NAME
	string
	output yaml
	default "mix"

config KDEVOPS_WORKFLOW_NOT_DEDICATED_ENABLE_FSTESTS
	bool "fstests"
	select KDEVOPS_WORKFLOW_ENABLE_FSTESTS
	help
	  Select this option if you are doing filesystem development and want
	  to target development for a filesystem and enable fstests so that
	  you can test the filesystem.

	  The fstests git tree will be cloned, and set up for you, and
	  you will be able to run create a baseline for your target filesystem,
	  and also test to ensure you don't regress that baseline. If a baseline
	  already exists against your distribution you will be able to ensure
	  you don't regress against development changes on your kernel.

config KDEVOPS_WORKFLOW_NOT_DEDICATED_ENABLE_BLKTESTS
	bool "blktests"
	depends on !KDEVOPS_USE_DECLARED_HOSTS
	select KDEVOPS_WORKFLOW_ENABLE_BLKTESTS
	help
	  Select this option if you are doing block layer development and want
	  to run blktests. The git tree for blktests will be git clone and
	  setup for you.

config KDEVOPS_WORKFLOW_NOT_DEDICATED_ENABLE_CXL
	bool "cxl"
	depends on !KDEVOPS_USE_DECLARED_HOSTS
	select KDEVOPS_WORKFLOW_ENABLE_CXL
	help
	  Select this option if you are doing cxl development and testing.
	  This will expose certain make targets which you can use to get
	  ramped up with all CXL development tools and testing.

	  Note that this does not ensure you have CXL hardware enabled or
	  emulated, that will depend on the type of node you are using.
	  If you are using libvirt you will want to enable in kdevops
	  the symbol CONFIG_QEMU_ENABLE_CXL.

config KDEVOPS_WORKFLOW_NOT_DEDICATED_ENABLE_PYNFS
	bool "pynfs"
	depends on !KDEVOPS_USE_DECLARED_HOSTS
	select KDEVOPS_WORKFLOW_ENABLE_PYNFS
	depends on LIBVIRT || TERRAFORM_PRIVATE_NET
	help
	  Select this option if you are doing nfsd development and testing,
	  and want to configure the deployment for testing nfsd via pynfs
	  over the loopback interface.

config KDEVOPS_WORKFLOW_NOT_DEDICATED_ENABLE_SELFTESTS
	bool "Linux kernel selftest"
	depends on !KDEVOPS_USE_DECLARED_HOSTS
	select KDEVOPS_WORKFLOW_ENABLE_SELFTESTS
	help
	  Select this option if you are doing Linux kernel developent and
	  testing with sefltests.

config KDEVOPS_WORKFLOW_NOT_DEDICATED_ENABLE_GITR
	bool "gitr"
	depends on !KDEVOPS_USE_DECLARED_HOSTS
	select KDEVOPS_WORKFLOW_ENABLE_GITR
	depends on LIBVIRT || TERRAFORM_PRIVATE_NET
	help
	  Select this option if you want to configure the deployment for
	  testing via the multi-threaded git regression workflow.

config KDEVOPS_WORKFLOW_NOT_DEDICATED_ENABLE_LTP
	bool "ltp"
	depends on !KDEVOPS_USE_DECLARED_HOSTS
	select KDEVOPS_WORKFLOW_ENABLE_LTP
	depends on LIBVIRT || TERRAFORM_PRIVATE_NET
	help
	  Select this option if you want to provision ltp on a single
	  target node for by-hand testing.

config KDEVOPS_WORKFLOW_NOT_DEDICATED_ENABLE_NFSTEST
	bool "nfstest"
	depends on !KDEVOPS_USE_DECLARED_HOSTS
	select KDEVOPS_WORKFLOW_ENABLE_NFSTEST
	depends on LIBVIRT || TERRAFORM_PRIVATE_NET
	help
	  Select this option if you want to provision nfstest on a
	  single target node for by-hand testing.

config KDEVOPS_WORKFLOW_NOT_DEDICATED_ENABLE_SYSBENCH
	bool "sysbench"
	depends on !KDEVOPS_USE_DECLARED_HOSTS
	select KDEVOPS_WORKFLOW_ENABLE_SYSBENCH
	depends on LIBVIRT || TERRAFORM_PRIVATE_NET
	help
	  Select this option if you want to provision sysbench on a
	  single target node for by-hand testing.

config KDEVOPS_WORKFLOW_NOT_DEDICATED_ENABLE_MMTESTS
	bool "mmtests"
	depends on !KDEVOPS_USE_DECLARED_HOSTS
	select KDEVOPS_WORKFLOW_ENABLE_MMTESTS
	depends on LIBVIRT || TERRAFORM_PRIVATE_NET
	help
	  Select this option if you want to provision mmtests on a
	  single target node for by-hand testing.

config KDEVOPS_WORKFLOW_NOT_DEDICATED_ENABLE_FIO_TESTS
	bool "fio-tests"
	depends on !KDEVOPS_USE_DECLARED_HOSTS
	select KDEVOPS_WORKFLOW_ENABLE_FIO_TESTS
	depends on LIBVIRT || TERRAFORM_PRIVATE_NET
	help
	  Select this option if you want to provision fio-tests on a
	  single target node for by-hand testing.

config KDEVOPS_WORKFLOW_NOT_DEDICATED_ENABLE_AI
	bool "ai"
	depends on !KDEVOPS_USE_DECLARED_HOSTS
	select KDEVOPS_WORKFLOW_ENABLE_AI
	depends on LIBVIRT || TERRAFORM_PRIVATE_NET
	help
	  Select this option if you want to provision AI benchmarks on a
	  single target node for by-hand testing.

config KDEVOPS_WORKFLOW_NOT_DEDICATED_ENABLE_VLLM
	bool "vllm"
	select KDEVOPS_WORKFLOW_ENABLE_VLLM
	depends on LIBVIRT || TERRAFORM_PRIVATE_NET
	help
	  Select this option if you want to provision vLLM Production Stack
	  on a single target node for by-hand testing and development.

endif # !WORKFLOWS_DEDICATED_WORKFLOW

config KDEVOPS_WORKFLOW_ENABLE_FSTESTS
	bool
	output yaml
	default y if KDEVOPS_WORKFLOW_NOT_DEDICATED_ENABLE_FSTESTS || KDEVOPS_WORKFLOW_DEDICATE_FSTESTS

if KDEVOPS_WORKFLOW_ENABLE_FSTESTS
menu "Configure and run fstests"
source "workflows/fstests/Kconfig"
endmenu
endif # KDEVOPS_WORKFLOW_ENABLE_FSTESTS

config KDEVOPS_WORKFLOW_ENABLE_BLKTESTS
	bool
	output yaml
	default y if KDEVOPS_WORKFLOW_NOT_DEDICATED_ENABLE_BLKTESTS || KDEVOPS_WORKFLOW_DEDICATE_BLKTESTS

if KDEVOPS_WORKFLOW_ENABLE_BLKTESTS
menu "Configure and run blktests"
source "workflows/blktests/Kconfig"
endmenu
endif # KDEVOPS_WORKFLOW_ENABLE_BLKTESTS

config KDEVOPS_WORKFLOW_ENABLE_CXL
	bool
	output yaml
	default y if KDEVOPS_WORKFLOW_NOT_DEDICATED_ENABLE_CXL || KDEVOPS_WORKFLOW_DEDICATE_CXL

if KDEVOPS_WORKFLOW_ENABLE_CXL
menu "Enable cxl development"
source "workflows/cxl/Kconfig"
endmenu
endif # KDEVOPS_WORKFLOW_ENABLE_CXL

config KDEVOPS_WORKFLOW_ENABLE_PYNFS
	bool
	output yaml
	default y if KDEVOPS_WORKFLOW_NOT_DEDICATED_ENABLE_PYNFS || KDEVOPS_WORKFLOW_DEDICATE_PYNFS
	select KDEVOPS_SETUP_NFSD

if KDEVOPS_WORKFLOW_ENABLE_PYNFS
menu "Configure and run pynfs"
source "workflows/pynfs/Kconfig"
endmenu
endif # KDEVOPS_WORKFLOW_ENABLE_PYNFS

config KDEVOPS_WORKFLOW_ENABLE_SELFTESTS
	bool
	output yaml
	default y if KDEVOPS_WORKFLOW_NOT_DEDICATED_ENABLE_SELFTESTS || KDEVOPS_WORKFLOW_DEDICATE_SELFTESTS

if KDEVOPS_WORKFLOW_ENABLE_SELFTESTS
menu "Enable Linux kernel selftests"
source "workflows/selftests/Kconfig"
endmenu
endif # KDEVOPS_WORKFLOW_ENABLE_SELFTESTS

config KDEVOPS_WORKFLOW_ENABLE_GITR
	bool
	output yaml
	default y if KDEVOPS_WORKFLOW_NOT_DEDICATED_ENABLE_GITR || KDEVOPS_WORKFLOW_DEDICATE_GITR

if KDEVOPS_WORKFLOW_ENABLE_GITR
menu "Configure and run the git regression suite"
source "workflows/gitr/Kconfig"
endmenu
endif # KDEVOPS_WORKFLOW_ENABLE_GITR

config KDEVOPS_WORKFLOW_ENABLE_LTP
	bool
	output yaml
	default y if KDEVOPS_WORKFLOW_NOT_DEDICATED_ENABLE_LTP || KDEVOPS_WORKFLOW_DEDICATE_LTP

if KDEVOPS_WORKFLOW_ENABLE_LTP
menu "Configure and run the ltp suite"
source "workflows/ltp/Kconfig"
endmenu
endif # KDEVOPS_WORKFLOW_ENABLE_GITR

config KDEVOPS_WORKFLOW_ENABLE_NFSTEST
	bool
	output yaml
	default y if KDEVOPS_WORKFLOW_NOT_DEDICATED_ENABLE_NFSTEST || KDEVOPS_WORKFLOW_DEDICATE_NFSTEST

if KDEVOPS_WORKFLOW_ENABLE_NFSTEST
menu "Configure and run the nfstest suite"
source "workflows/nfstest/Kconfig"
endmenu
endif # KDEVOPS_WORKFLOW_ENABLE_NFSTEST

config KDEVOPS_WORKFLOW_ENABLE_SYSBENCH
	bool
	output yaml
	default y if KDEVOPS_WORKFLOW_NOT_DEDICATED_ENABLE_SYSBENCH || KDEVOPS_WORKFLOW_DEDICATE_SYSBENCH

if KDEVOPS_WORKFLOW_ENABLE_SYSBENCH
menu "Configure and run the sysbench tests"
source "workflows/sysbench/Kconfig"
endmenu
endif # KDEVOPS_WORKFLOW_ENABLE_SYSBENCH

config KDEVOPS_WORKFLOW_ENABLE_MMTESTS
	bool
	output yaml
	default y if KDEVOPS_WORKFLOW_NOT_DEDICATED_ENABLE_MMTESTS || KDEVOPS_WORKFLOW_DEDICATE_MMTESTS

if KDEVOPS_WORKFLOW_ENABLE_MMTESTS
menu "Configure and run the mmtests tests"
source "workflows/mmtests/Kconfig"
endmenu
endif # KDEVOPS_WORKFLOW_ENABLE_MMTESTS

config KDEVOPS_WORKFLOW_ENABLE_FIO_TESTS
	bool
	output yaml
	default y if KDEVOPS_WORKFLOW_NOT_DEDICATED_ENABLE_FIO_TESTS || KDEVOPS_WORKFLOW_DEDICATE_FIO_TESTS

if KDEVOPS_WORKFLOW_ENABLE_FIO_TESTS
menu "Configure and run fio-tests"
source "workflows/fio-tests/Kconfig"
endmenu
endif # KDEVOPS_WORKFLOW_ENABLE_FIO_TESTS

config KDEVOPS_WORKFLOW_ENABLE_AI
	bool
	output yaml
	default y if KDEVOPS_WORKFLOW_NOT_DEDICATED_ENABLE_AI || KDEVOPS_WORKFLOW_DEDICATE_AI

if KDEVOPS_WORKFLOW_ENABLE_AI
menu "Configure and run AI benchmarks"
source "workflows/ai/Kconfig"
endmenu
endif # KDEVOPS_WORKFLOW_ENABLE_AI

config KDEVOPS_WORKFLOW_ENABLE_VLLM
	bool
	output yaml
	default y if KDEVOPS_WORKFLOW_NOT_DEDICATED_ENABLE_VLLM || KDEVOPS_WORKFLOW_DEDICATE_VLLM

if KDEVOPS_WORKFLOW_ENABLE_VLLM
menu "Configure and run vLLM Production Stack"
source "workflows/vllm/Kconfig"
endmenu
endif # KDEVOPS_WORKFLOW_ENABLE_VLLM

config KDEVOPS_WORKFLOW_ENABLE_MINIO
	bool
	output yaml
	default y if KDEVOPS_WORKFLOW_NOT_DEDICATED_ENABLE_MINIO || KDEVOPS_WORKFLOW_DEDICATE_MINIO

if KDEVOPS_WORKFLOW_ENABLE_MINIO
menu "Configure and run MinIO S3 benchmarks"
source "workflows/minio/Kconfig"
endmenu
endif # KDEVOPS_WORKFLOW_ENABLE_MINIO

config KDEVOPS_WORKFLOW_ENABLE_BUILD_LINUX
	bool
	output yaml
	default y if KDEVOPS_WORKFLOW_NOT_DEDICATED_ENABLE_BUILD_LINUX || KDEVOPS_WORKFLOW_DEDICATE_BUILD_LINUX

if KDEVOPS_WORKFLOW_ENABLE_BUILD_LINUX
menu "Configure Linux kernel build workflow"
source "workflows/build-linux/Kconfig"
endmenu
endif # KDEVOPS_WORKFLOW_ENABLE_BUILD_LINUX

config KDEVOPS_WORKFLOW_ENABLE_SSD_STEADY_STATE
       bool "Attain SSD steady state prior to tests"
       output yaml
       help
         SNIA guidelines recommend purging and pre-conditioning storage
         devices before collecting performance data.  This optional
         workflow mirrors fio-tests' generic steady state provisioning:
         it pre-fills the device and runs fio steady state checks for
         both IOPS and throughput.  Enable this to ensure your target
         drive has reached steady state prior to running other workflows.

if KDEVOPS_WORKFLOW_ENABLE_SSD_STEADY_STATE
menu "Configure SSD steady state workflow"
source "workflows/steady_state/Kconfig"
endmenu
endif # KDEVOPS_WORKFLOW_ENABLE_SSD_STEADY_STATE

config KDEVOPS_WORKFLOW_GIT_CLONES_KDEVOPS_GIT
	bool
	default y if KDEVOPS_WORKFLOW_ENABLE_FSTESTS || KDEVOPS_WORKFLOW_ENABLE_BLKTESTS

endif # WORKFLOWS_LINUX_TESTS

endif # WORKFLOWS_TESTS

# For Linux custom workflow without tests, still need workflow name for templating
if WORKFLOW_LINUX_CUSTOM && !WORKFLOWS_TESTS
config KDEVOPS_WORKFLOW_NAME
	string
	output yaml
	default "linux"
endif

endif # WORKFLOWS

source "workflows/rcloud/Kconfig"
```
