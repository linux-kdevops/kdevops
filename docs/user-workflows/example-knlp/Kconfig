## kconfigs/Kconfig.nixos
```kconfig
# SPDX-License-Identifier: copyleft-next-0.3.1

if NIXOS

config NIXOS_STORAGE_DIR
	string
	output yaml
	default "{{ kdevops_storage_pool_path }}/nixos"

config NIXOS_CONFIG_DIR
	string
	output yaml
	default "{{ topdir_path }}/nixos"

config NIXOS_GENERATION_DIR
	string
	output yaml
	default "{{ nixos_config_dir }}/generated"

config NIXOS_USE_FLAKES
	bool "Use Nix flakes for configuration"
	output yaml
	default y
	help
	  Use the modern Nix flakes system for managing NixOS configurations.
	  This provides better reproducibility and dependency management.
	  If disabled, will use traditional configuration.nix approach.

config NIXOS_CHANNEL
	string "NixOS channel to use"
	output yaml
	default "nixos-unstable"
	help
	  The NixOS channel to use for the VMs. Options include:
	  - nixos-unstable: Latest packages, rolling release
	  - nixos-24.05: Stable release from May 2024
	  - nixos-23.11: Stable release from November 2023

config NIXOS_ENABLE_WORKFLOW_DEPS
	bool "Automatically install workflow dependencies"
	output yaml
	default y
	help
	  When enabled, NixOS will automatically generate package dependencies
	  based on all enabled workflows (fstests, blktests, etc.) and include
	  them in the VM configuration.

config NIXOS_LIBVIRT_SESSION_INFERENCE
	bool "Automatically infer libvirt session type"
	output yaml
	default y
	help
	  Automatically detect whether to use libvirt system or user session
	  based on your distribution's defaults. Similar to guestfs, this will
	  use system session for most distributions and user session for Fedora.

config NIXOS_CUSTOM_CONFIG_PATH
	string "Path to custom NixOS configuration template"
	output yaml
	default ""
	help
	  Optional path to a custom NixOS configuration template that will be
	  merged with the auto-generated configuration. This allows you to add
	  custom packages, services, or other NixOS settings.

config NIXOS_VM_MEMORY_MB
	int "Memory allocation per VM (MB)"
	output yaml
	default 4096
	help
	  Amount of memory to allocate to each NixOS VM in megabytes.

config NIXOS_VM_DISK_SIZE_GB
	int "Disk size per VM (GB)"
	output yaml
	default 20
	help
	  Size of the primary disk for each NixOS VM in gigabytes.

config NIXOS_VM_VCPUS
	int "Number of vCPUs per VM"
	output yaml
	default 4
	help
	  Number of virtual CPUs to allocate to each NixOS VM.

config NIXOS_SSH_PORT
	int "SSH port for NixOS VMs"
	output yaml
	default 22
	help
	  SSH port to use for connecting to NixOS VMs.

config NIXOS_DEBUG_MODE
	bool "Enable debug mode for NixOS provisioning"
	default n
	help
	  Enable verbose output and debugging information during NixOS
	  VM provisioning and configuration generation.

endif # NIXOS
```

## kconfigs/Kconfig.nixos_flake
```kconfig
# SPDX-License-Identifier: copyleft-next-0.3.1
#
# nixos_flake -- shared infrastructure feature for the Nix flake at
# scripts/nixos-flake/. Consumed by the NIXOSFL bringup
# choice today and by the imageless backend (NIXOSFI) later.

if KDEVOPS_ENABLE_NIXOS_FLAKE

menu "NixOS Flake"

config NIXOS_FLAKE_PATH
	string
	output yaml
	default "$(TOPDIR_PATH)/scripts/nixos-flake"
	help
	  Absolute path to the vendored nixos-flake on the controller.
	  Per-VM flakes import this path via `nixos-flake.url = "path:..."`
	  so a `git subtree pull` against scripts/nixos-flake picks up
	  automatically.

if NIXOSFL

config NIXOSFL_CONFIG_DIR
	string
	output yaml
	default "$(TOPDIR_PATH)/nixos/generated"
	help
	  Controller-side directory where the nixos_flake role writes
	  one subdirectory per guest holding the rendered flake.nix and
	  default.nix. Defaults to nixos/generated/ at the kdevops
	  topdir, which is gitignored.

config NIXOSFL_STORAGE_DIR
	string
	output yaml
	default "{{ kdevops_storage_pool_path }}/nixos"
	help
	  Libvirt storage-pool subdirectory where built qcow2 images and
	  run-<vm>-wrapper.sh scripts are staged. Resolved at task time
	  from the libvirt storage pool path so it tracks the libvirt
	  configuration.

endif # NIXOSFL

if NIXOSFI

config NIXOSFI_CONFIG_DIR
	string
	output yaml
	default "$(TOPDIR_PATH)/nixos/generated"
	help
	  Controller-side directory where the qsu role writes one
	  subdirectory per guest holding the rendered flake.nix and
	  default.nix for the imageless backend. Defaults to
	  nixos/generated/ at the kdevops topdir (same path the libvirt
	  backend uses; they're mutually exclusive bringup choices),
	  which is gitignored.

endif # NIXOSFI

menu "Profiles"

config NIXOS_FLAKE_PROFILE_DEVEL
	bool "Development profile (kernel testing tools)"
	output yaml
	default y
	help
	  Imports nixos-flake.nixosModules.profiles.devel into every
	  guest. Adds kernel testing utilities expected by kdevops
	  workflows.

config NIXOS_FLAKE_PROFILE_BUILD_TOOLS
	bool "Build tools profile (autotools + headers)"
	output yaml
	default n
	help
	  Imports nixos-flake.nixosModules.profiles.build-tools. Pulls in
	  the Autotools build environment when guest-side compilation is
	  expected.

config NIXOS_FLAKE_PROFILE_MONITORING
	bool "Monitoring profile (workflow-bracketed monitor units)"
	output yaml
	default n
	help
	  Imports nixos-flake.nixosModules.profiles.monitoring. Brings in
	  sysstat / cpu-governor / blkalgn / biolatency systemd template
	  units instantiated per workload run-id.

	  Independent of the kdevops ENABLE_MONITORING knob -- the two
	  monitor stacks cover different ground (kdevops monitoring
	  focuses on developmental kernel-research stats like folio
	  migration debugfs; this profile is system-wide perf monitoring
	  via sadc + libbpf-tools). Enabling this just bakes the systemd
	  template units into the guest image; nothing in kdevops drives
	  them today.

endmenu  # Profiles

menu "Mounts"

config NIXOS_FLAKE_MOUNT_SHARES
	bool "Enable virtiofs shares (mounts/shares.nix)"
	output yaml
	default y if NIXOSFI
	default n
	help
	  Imports nixos-flake.nixosModules.mounts.shares. Mounts named
	  virtiofs shares inside the guest. The imageless backend
	  requires this (it sources /nix/store and /lib/modules over
	  virtiofs), so the knob auto-enables under NIXOSFI.

config NIXOS_FLAKE_MOUNT_STORAGE
	bool "Enable block-device storage mounts (mounts/storage.nix)"
	output yaml
	default n
	help
	  Imports nixos-flake.nixosModules.mounts.storage. Mounts named
	  block devices inside the guest, optionally running mkfs first.

endmenu  # Mounts

menu "Test suites"

config NIXOS_FLAKE_TESTSUITE_FSTESTS
	bool "fstests"
	output yaml
	default n
	help
	  Imports nixos-flake.nixosModules.testSuites.fstests. Pulls in
	  the xfstests toolchain + binaries on the guest. The kdevops
	  fstests workflow's role glue (running tests, harvesting results)
	  is a separate follow-up.

config NIXOS_FLAKE_TESTSUITE_BLKTESTS
	bool "blktests"
	output yaml
	default n

config NIXOS_FLAKE_TESTSUITE_LTP
	bool "ltp"
	output yaml
	default n

config NIXOS_FLAKE_TESTSUITE_MMTESTS
	bool "mmtests"
	output yaml
	default n

config NIXOS_FLAKE_TESTSUITE_PYNFS
	bool "pynfs"
	output yaml
	default n

config NIXOS_FLAKE_TESTSUITE_GITR
	bool "gitr"
	output yaml
	default n

config NIXOS_FLAKE_TESTSUITE_SELFTESTS
	bool "selftests"
	output yaml
	default n

config NIXOS_FLAKE_TESTSUITE_SYSBENCH
	bool "sysbench"
	output yaml
	default n

endmenu  # Test suites

menu "Source overrides"

# Per-package source overrides. Each <PKG> exposes a bool gate;
# enabling it surfaces SRC (local path or git URL) and REF
# (branch/tag/commit). When enabled and SRC is non-empty the
# closure rebuilds the package from that source instead of the
# nixpkgs / nixos-flake-overlay default. REF is ignored for
# local paths. All bools off is a no-op.

config NIXOS_FLAKE_OVERRIDE_FIO
	bool "Override fio source"
	output yaml
	default n
	help
	  Rebuild fio from a user-supplied tree instead of the
	  nixos-flake fio overlay (nixpkgs fio + liburing patches).
if NIXOS_FLAKE_OVERRIDE_FIO
config NIXOS_FLAKE_OVERRIDE_FIO_SRC
	string "fio source (local path or git URL)"
	output yaml
	default ""
config NIXOS_FLAKE_OVERRIDE_FIO_REF
	string "fio ref"
	output yaml
	default ""
endif # NIXOS_FLAKE_OVERRIDE_FIO

config NIXOS_FLAKE_OVERRIDE_XFSTESTS
	bool "Override xfstests source"
	output yaml
	default n
	help
	  Rebuild xfstests from a user-supplied tree instead of the
	  nixos-flake xfstests overlay (xfstests 2026.03.20 with
	  gdbm/liburing/file_attr patches).
if NIXOS_FLAKE_OVERRIDE_XFSTESTS
config NIXOS_FLAKE_OVERRIDE_XFSTESTS_SRC
	string "xfstests source (local path or git URL)"
	output yaml
	default ""
config NIXOS_FLAKE_OVERRIDE_XFSTESTS_REF
	string "xfstests ref"
	output yaml
	default ""
endif # NIXOS_FLAKE_OVERRIDE_XFSTESTS

config NIXOS_FLAKE_OVERRIDE_XFSPROGS
	bool "Override xfsprogs source"
	output yaml
	default n
	help
	  Rebuild xfsprogs from a user-supplied tree instead of the
	  nixpkgs default. Use this to pick up xfs_healer or other
	  for-next changes ahead of nixpkgs.
if NIXOS_FLAKE_OVERRIDE_XFSPROGS
config NIXOS_FLAKE_OVERRIDE_XFSPROGS_SRC
	string "xfsprogs source (local path or git URL)"
	output yaml
	default ""
config NIXOS_FLAKE_OVERRIDE_XFSPROGS_REF
	string "xfsprogs ref"
	output yaml
	default ""
endif # NIXOS_FLAKE_OVERRIDE_XFSPROGS

config NIXOS_FLAKE_OVERRIDE_LIBBPF
	bool "Override libbpf source"
	output yaml
	default n
	help
	  Rebuild libbpf from a user-supplied tree instead of the
	  nixpkgs default.
if NIXOS_FLAKE_OVERRIDE_LIBBPF
config NIXOS_FLAKE_OVERRIDE_LIBBPF_SRC
	string "libbpf source (local path or git URL)"
	output yaml
	default ""
config NIXOS_FLAKE_OVERRIDE_LIBBPF_REF
	string "libbpf ref"
	output yaml
	default ""
endif # NIXOS_FLAKE_OVERRIDE_LIBBPF

config NIXOS_FLAKE_OVERRIDE_LIBBPF_TOOLS
	bool "Override libbpf-tools source"
	output yaml
	default n
	help
	  Rebuild libbpf-tools from a user-supplied BCC tree instead
	  of the release pinned by nixos-flake/pkgs/libbpf-tools.nix.
if NIXOS_FLAKE_OVERRIDE_LIBBPF_TOOLS
config NIXOS_FLAKE_OVERRIDE_LIBBPF_TOOLS_SRC
	string "libbpf-tools source (local path or BCC git URL)"
	output yaml
	default ""
config NIXOS_FLAKE_OVERRIDE_LIBBPF_TOOLS_REF
	string "libbpf-tools ref"
	output yaml
	default ""
endif # NIXOS_FLAKE_OVERRIDE_LIBBPF_TOOLS

config NIXOS_FLAKE_OVERRIDE_DAMO
	bool "Override damo source"
	output yaml
	default n
	help
	  Rebuild damo from a user-supplied tree instead of
	  nixos-flake/pkgs/damo.nix.
if NIXOS_FLAKE_OVERRIDE_DAMO
config NIXOS_FLAKE_OVERRIDE_DAMO_SRC
	string "damo source (local path or git URL)"
	output yaml
	default ""
config NIXOS_FLAKE_OVERRIDE_DAMO_REF
	string "damo ref"
	output yaml
	default ""
endif # NIXOS_FLAKE_OVERRIDE_DAMO

config NIXOS_FLAKE_OVERRIDE_NFSTEST
	bool "Override nfstest source"
	output yaml
	default n
	help
	  Rebuild nfstest from a user-supplied tree instead of
	  nixos-flake/pkgs/nfstest.nix.
if NIXOS_FLAKE_OVERRIDE_NFSTEST
config NIXOS_FLAKE_OVERRIDE_NFSTEST_SRC
	string "nfstest source (local path or git URL)"
	output yaml
	default ""
config NIXOS_FLAKE_OVERRIDE_NFSTEST_REF
	string "nfstest ref"
	output yaml
	default ""
endif # NIXOS_FLAKE_OVERRIDE_NFSTEST

config NIXOS_FLAKE_OVERRIDE_PYNFS
	bool "Override pynfs source"
	output yaml
	default n
	help
	  Rebuild pynfs from a user-supplied tree instead of
	  nixos-flake/pkgs/pynfs.nix.
if NIXOS_FLAKE_OVERRIDE_PYNFS
config NIXOS_FLAKE_OVERRIDE_PYNFS_SRC
	string "pynfs source (local path or git URL)"
	output yaml
	default ""
config NIXOS_FLAKE_OVERRIDE_PYNFS_REF
	string "pynfs ref"
	output yaml
	default ""
endif # NIXOS_FLAKE_OVERRIDE_PYNFS

config NIXOS_FLAKE_OVERRIDE_XNVME
	bool "Override xnvme source"
	output yaml
	default n
	help
	  Rebuild xnvme from a user-supplied tree instead of
	  nixos-flake/pkgs/xnvme.nix.
if NIXOS_FLAKE_OVERRIDE_XNVME
config NIXOS_FLAKE_OVERRIDE_XNVME_SRC
	string "xnvme source (local path or git URL)"
	output yaml
	default ""
config NIXOS_FLAKE_OVERRIDE_XNVME_REF
	string "xnvme ref"
	output yaml
	default ""
endif # NIXOS_FLAKE_OVERRIDE_XNVME

config NIXOS_FLAKE_OVERRIDE_CPUPOWER
	bool "Override cpupower source"
	output yaml
	default n
	help
	  Rebuild cpupower from a user-supplied Linux tree
	  (tools/power/cpupower) instead of nixos-flake/pkgs/cpupower.nix.
if NIXOS_FLAKE_OVERRIDE_CPUPOWER
config NIXOS_FLAKE_OVERRIDE_CPUPOWER_SRC
	string "cpupower source (local path or Linux git URL)"
	output yaml
	default ""
config NIXOS_FLAKE_OVERRIDE_CPUPOWER_REF
	string "cpupower ref"
	output yaml
	default ""
endif # NIXOS_FLAKE_OVERRIDE_CPUPOWER

endmenu  # Source overrides

endmenu  # NixOS Flake

endif # KDEVOPS_ENABLE_NIXOS_FLAKE
```
