## kconfigs/Kconfig.smbd
```kconfig
# FIXME: need defaults for terraform hosts
config KDEVOPS_SETUP_SMBD
	bool "Set up the Samba SMB server"
	depends on KDEVOPS_WORKFLOW_ENABLE_FSTESTS
	default n
	help
	  Configure and bring up the Samba SMB server. This will provision
	  a filesystem on a block device, mount it, share it and start up the
	  smb server and associated daemons.

if KDEVOPS_SETUP_SMBD

menu "Configure the Samba SMB server"

choice
	prompt "Type of filesystem to share"
	default SMBD_SHARE_FSTYPE_BTRFS

config SMBD_SHARE_FSTYPE_BTRFS
	bool "btrfs"

config SMBD_SHARE_FSTYPE_XFS
	bool "xfs"

config SMBD_SHARE_FSTYPE_EXT4
	bool "ext4"

config SMBD_SHARE_FSTYPE_TMPFS
	bool "tmpfs"

endchoice

config SMBD_SHARE_FSTYPE
	string
	default "btrfs" if SMBD_SHARE_FSTYPE_BTRFS
	default "xfs" if SMBD_SHARE_FSTYPE_XFS
	default "ext4" if SMBD_SHARE_FSTYPE_EXT4
	default "tmpfs" if SMBD_SHARE_FSTYPE_TMPFS

config SMBD_SHARE_PATH
	string "The path under which to mount the devices to be shared."
	default "/share"
	help
	  This is the path that will be shared from the smbd server. The
	  share devices are mounted here under numbered directories starting
	  with 0.

config SMB_ROOT_PW
        string "SMB root password"
        default "kdevops"
        help
          SMB password to use for the root user.

endmenu

endif
```

## kconfigs/Kconfig.ssh
```kconfig
config KDEVOPS_SSH_CONFIG_UPDATE
	bool "Update your SSH configuration for you?"
	default y
	depends on !SKIP_BRINGUP
	help
	  If enabled, your SSH configuration file will be updated for you based
	  on the results obtained from the bring up. This is useful in case
	  it is not clear what the IP address of the hosts just created are.

	  This is enabled by default, as this is the promise by kdevops, to be
	  easy to use with sensible but careful deafults. If you are concerned
	  for mistakes know that we do a backup of your SSH configuration for
	  you just in case.

	  You are encourated to leave this enabled, uness you really don't trust
	  this code.

if KDEVOPS_SSH_CONFIG_UPDATE

config KDEVOPS_SSH_CONFIG
	string "The controller's ssh configuration file"
	default "~/.ssh/config"
	help
	  The pathname of the Ansible controller's ssh configuration file.
	  kdevops may add an Include directive to this file that refers to a
	  separate file where target node ssh configuration is managed.

config KDEVOPS_SSH_CONFIG_PREFIX
	string "Pathname prefix to an Ansible-managed ssh config file"
	output yaml
	default "~/.ssh/config_kdevops_"
	help
	  The pathname of a file into which Ansible inserts ssh configuration
	  information for the target nodes during the "make bringup" step. On
	  "make destroy" this file is destroyed.

	  This file is kept in the controller's .ssh directory by default,
	  but can be moved to other locations if desired.

config KDEVOPS_SSH_CONFIG_UPDATE_STRICT
	bool "Use strict configuration settings when adding each host"
	default y
	help
	  If enabled when we update your ssh host we will add the following
	  few more lines to each entry:

	     UserKnownHostsFile /dev/null
	     StrictHostKeyChecking no
	     PasswordAuthentication no
	     IdentitiesOnly yes
	     LogLevel FATAL

	  You are encouraged to use this. Vagrant does this, and so you can't
	  disable this if you are using Vagrant.

config KDEVOPS_SSH_CONFIG_UPDATE_BACKUP
	bool "Create a backup when updating your SSH config file"
	default y
	help
	  This will create a backup of your SSH configuration file prior to
	  doing the update for you. The filename for the backup will be:

	    ~/.ssh/config.backup.kdevops.$method

	  where $method is either Vagrant or terraform.

endif # KDEVOPS_SSH_CONFIG_UPDATE
```

## kconfigs/Kconfig.user_workflows
```kconfig
# SPDX-License-Identifier: copyleft-next-0.3.1
#
# User-private workflow configuration
#
# This allows users to maintain private workflows in their home directory
# without modifying the main kdevops repository.
#
# Expected directory structure:
#   ~/.config/kdevops/
#   ├── Kconfig                    # User Kconfig (sourced below)
#   ├── Makefile                   # User Makefile (included by workflows/Makefile)
#   ├── defconfigs/                # User defconfigs
#   │   └── configs/               # User config fragments
#   └── playbooks/
#       └── roles/
#           ├── gen_nodes/tasks/   # User node generation tasks
#           ├── gen_hosts/
#           │   ├── tasks/         # User hosts generation tasks
#           │   └── templates/     # User hosts templates
#           └── <workflow>/        # User workflow roles

config KDEVOPS_USER_CONFIG_ENABLE
	bool "Enable user-private workflows"
	default n
	output yaml
	help
	  Enable support for user-private workflows stored in
	  ~/.config/kdevops/ (or a custom path). This allows you to
	  maintain custom workflows without modifying the kdevops
	  repository.

	  When enabled, kdevops will:
	  - Source user Kconfig files from the user config directory
	  - Include user Makefiles for custom make targets
	  - Load user Ansible roles and tasks for node/host generation

	  If unsure, say N unless you have user workflows to load.

if KDEVOPS_USER_CONFIG_ENABLE

config KDEVOPS_USER_CONFIG_DIR
	string "User configuration directory"
	default "~/.config/kdevops"
	output yaml
	help
	  The directory where user-private workflow configurations are
	  stored. The default is ~/.config/kdevops.

	  This directory should contain:
	  - Kconfig: Sourced for additional workflow options
	  - Makefile: Included for custom make targets
	  - playbooks/roles/: Ansible roles for user workflows

config KDEVOPS_USER_CONFIG_DIR_EXPANDED
	string
	output yaml
	default "$(shell, echo $HOME/.config/kdevops)"

endif # KDEVOPS_USER_CONFIG_ENABLE

# Source user Kconfig - uses script to return valid path or stub
source "$(shell, scripts/get_user_kconfig.sh)"

# Plugin system configuration
config KDEVOPS_PLUGINS_INSTALLED
	bool
	output yaml
	default $(shell, scripts/kdevops-plugin.sh --has-plugins)
	help
	  Automatically set to 'y' when plugins are installed via the
	  kdevops plugin system. This is a hidden option that tracks
	  whether any plugins are currently installed.

config KDEVOPS_PLUGINS_TAINTED
	bool "Configuration uses third-party plugins (tainted)"
	default y if KDEVOPS_PLUGINS_INSTALLED
	output yaml
	help
	  This configuration uses third-party plugins installed via the
	  kdevops plugin system. Plugin configurations are maintained
	  externally and are not validated by kdevops maintainers.

	  This is a taint flag that indicates the configuration includes
	  community or user-developed plugins. The flag is automatically
	  set when plugins are installed.

	  Use 'make kdevops-plugin-list' to see installed plugins.

# Source installed plugins Kconfig
source "$(shell, scripts/get_plugins_kconfig.sh)"
```
