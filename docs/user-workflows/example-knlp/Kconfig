## docs/user-workflows/example-knlp/Kconfig
```kconfig
# SPDX-License-Identifier: copyleft-next-0.3.1
#
# User-private Kconfig for kdevops workflows
#
# This file is sourced by kdevops when KDEVOPS_USER_CONFIG_ENABLE=y
# and placed at ~/.config/kdevops/Kconfig
#
# Source your workflow Kconfigs here:

source "$(shell, echo $HOME/.config/kdevops/workflows/knlp/Kconfig)"
```

## docs/user-workflows/example-knlp/workflows/knlp/Kconfig
```kconfig
# SPDX-License-Identifier: copyleft-next-0.3.1
#
# User-private KNLP workflow Kconfig

config KDEVOPS_USER_WORKFLOW_KNLP
	bool "Enable the knlp ML research workflow"
	default y
	output yaml
	help
	  This enables the knlp (Kernel Natural Language Processing) workflow.
	  knlp is a collaborative transformer architecture research project that
	  applies Linux kernel development methodologies to machine learning
	  experimentation and reproducibility.

	  Repository: https://github.com/mcgrof/knlp

if KDEVOPS_USER_WORKFLOW_KNLP

menu "knlp ML research workflow configuration"

config WORKFLOW_KNLP_GIT_URL
	string "knlp git repository URL"
	default "https://github.com/mcgrof/knlp.git"
	output yaml
	help
	  The git repository URL for knlp.

config WORKFLOW_KNLP_GIT_REF
	string "knlp git reference (branch, tag, or commit)"
	default "main"
	output yaml
	help
	  The git reference to checkout.

config WORKFLOW_KNLP_DATA_PATH
	string "Path to install knlp"
	default "/data/knlp"
	output yaml
	help
	  The directory where knlp will be cloned and installed.

endmenu

endif # KDEVOPS_USER_WORKFLOW_KNLP
```

## kconfigs/Kconfig.ansible_cfg
```kconfig
config ANSIBLE_CFG_CALLBACK_PLUGIN_SET_BY_CLI
	bool
	default $(shell, scripts/check-cli-set-var.sh ANSIBLE_CFG_CALLBACK_PLUGIN)

config ANSIBLE_CFG_INTERPRETER_PYTHON_SET_BY_CLI
	bool
	default $(shell, scripts/check-cli-set-var.sh ANSIBLE_CFG_INTERPRETER_PYTHON)

config ANSIBLE_CFG_FORKS_SET_BY_CLI
	bool
	default $(shell, scripts/check-cli-set-var.sh ANSIBLE_CFG_FORKS)

config ANSIBLE_CFG_TASK_DEBUGGER_SET_BY_CLI
	bool
	default $(shell, scripts/check-cli-set-var.sh ANSIBLE_CFG_TASK_DEBUGGER)

config ANSIBLE_CFG_INVENTORY_SET_BY_CLI
	bool
	default $(shell, scripts/check-cli-set-var.sh KDEVOPS_HOSTS)

config ANSIBLE_CFG_FILE_CUSTOM
	bool "Set a custom location for the ansible.cfg file"
	help
	  When this option is set to N, kdevops creates an ansible.cfg
	  in a sensible default location, using the settings defined
	  in this Kconfig menu. If it is set to Y, you can set the
	  path and filename of the Ansible configuration file.

if ANSIBLE_CFG_FILE_CUSTOM

config ANSIBLE_CFG_FILE
	string "Ansible configuration file"
	output yaml
	default "$(TOPDIR_PATH)/ansible.cfg"
	help
	  Path and filename to the Ansible configuration file.

	  This option lets you specify the path and filename for the Ansible
	  configuration file. If the specified file already exists, it will not
	  be overwritten. Otherwise, kdevops will generate one using the settings
	  defined in this Kconfig menu.

	  If this option is left undefined or set to an empty string, kdevops
	  will not generate any configuration file. In that case, Ansible will
	  fall back to its own search order to locate a config file:
	    1. The ANSIBLE_CONFIG environment variable (if set)
	    2. ./ansible.cfg (in the current working directory)
	    3. ~/.ansible.cfg (in the user's home directory)
	    4. /etc/ansible/ansible.cfg (system-wide default)

	  For more details, refer to the Ansible documentation:
	  https://docs.ansible.com/ansible/latest/reference_appendices/config.html#the-configuration-file

endif # ANSIBLE_CFG_FILE_CUSTOM

menu "Ansible Callback Plugin Configuration"
choice
	prompt "Ansible Callback Plugin"
	default ANSIBLE_CFG_CALLBACK_PLUGIN_DENSE if !ANSIBLE_CFG_CALLBACK_PLUGIN_SET_BY_CLI
	default ANSIBLE_CFG_CALLBACK_PLUGIN_CUSTOM if ANSIBLE_CFG_CALLBACK_PLUGIN_SET_BY_CLI

config ANSIBLE_CFG_CALLBACK_PLUGIN_DEBUG
	bool "Ansible Debug Callback Plugin"
	help
	  Debug: https://docs.ansible.com/ansible/latest/collections/ansible/builtin/debug_module.html

config ANSIBLE_CFG_CALLBACK_PLUGIN_DENSE
	bool "Ansible Dense Callback Plugin"
	help
	  Dense: https://docs.ansible.com/ansible/latest/collections/community/general/dense_callback.html

config ANSIBLE_CFG_CALLBACK_PLUGIN_DIY
	bool "Ansible DIY Callback Plugin"
	help
	  DIY: https://docs.ansible.com/ansible/latest/collections/community/general/diy_callback.html

config ANSIBLE_CFG_CALLBACK_PLUGIN_CUSTOM
	bool "Custom Ansible Callback Plugin"
	help
	  This will let you enter in your own Ansible callback plugin

endchoice

if ANSIBLE_CFG_CALLBACK_PLUGIN_CUSTOM

config ANSIBLE_CFG_CALLBACK_PLUGIN_CUSTOM_NAME
	string "Custom Ansible Callback Plugin Name"
	default $(shell, ./scripts/append-makefile-vars.sh $(ANSIBLE_CFG_CALLBACK_PLUGIN)) if ANSIBLE_CFG_CALLBACK_PLUGIN_SET_BY_CLI
	default "dense" if !ANSIBLE_CFG_CALLBACK_PLUGIN_SET_BY_CLI

endif # ANSIBLE_CFG_CALLBACK_PLUGIN_CUSTOM

config ANSIBLE_CFG_CALLBACK_PLUGIN_STRING
	string
	output yaml
	default "debug" if ANSIBLE_CFG_CALLBACK_PLUGIN_DEBUG
	default "dense" if ANSIBLE_CFG_CALLBACK_PLUGIN_DENSE
	default "community.general.diy" if ANSIBLE_CFG_CALLBACK_PLUGIN_DIY
	default ANSIBLE_CFG_CALLBACK_PLUGIN_CUSTOM_NAME if ANSIBLE_CFG_CALLBACK_PLUGIN_CUSTOM

config ANSIBLE_CFG_CALLBACK_PLUGIN_CHECK_MODE_MARKERS
	bool "check_mode_markers"
	output yaml
	default n
	help
	  Toggle to control displaying markers when running in check mode.
	  https://docs.ansible.com/ansible/latest/collections/community/general/dense_callback.html#parameter-check_mode_markers

config ANSIBLE_CFG_CALLBACK_PLUGIN_DISPLAY_FAILED_STDERR
	bool "display_failed_stderr"
	output yaml
	default n
	help
	  Toggle to control whether failed and unreachable tasks are displayed to STDERR (vs. STDOUT).
	  https://docs.ansible.com/ansible/latest/collections/community/general/dense_callback.html#parameter-display_failed_stderr

config ANSIBLE_CFG_CALLBACK_PLUGIN_DISPLAY_OK_HOSTS
	bool "display_ok_hosts"
	output yaml
	default y if !ANSIBLE_CFG_CALLBACK_PLUGIN_DIY
	default n if ANSIBLE_CFG_CALLBACK_PLUGIN_DIY
	help
	  Toggle to control displaying ‘ok’ task/host results in a task.
	  https://docs.ansible.com/ansible/latest/collections/community/general/dense_callback.html#parameter-display_ok_hosts

config ANSIBLE_CFG_CALLBACK_PLUGIN_DISPLAY_SKIPPED_HOSTS
	bool "display_skipped_hosts"
	output yaml
	default n
	help
	  Toggle to control displaying skipped task/host results in a task.
	  https://docs.ansible.com/ansible/latest/collections/community/general/dense_callback.html#parameter-display_skipped_hosts

config ANSIBLE_CFG_CALLBACK_PLUGIN_SHOW_CUSTOM_STATS
	bool "show_custom_stats"
	output yaml
	default n
	help
	  This adds the custom stats set via the set_stats plugin to the play recap
	  https://docs.ansible.com/ansible/latest/collections/community/general/dense_callback.html#parameter-show_custom_stats

config ANSIBLE_CFG_CALLBACK_PLUGIN_SHOW_PER_HOST_START
	bool "show_per_host_start"
	output yaml
	default y
	help
	  This adds output that shows when a task is started to execute for each host
	  https://docs.ansible.com/ansible/latest/collections/community/general/dense_callback.html#parameter-show_per_host_start

config ANSIBLE_CFG_CALLBACK_PLUGIN_SHOW_TASK_PATH_ON_FAILURE
	bool "show_task_path_on_failure"
	output yaml
	default y
	help
	  When a task fails, display the path to the file containing the failed task and
	  the line number. This information is displayed automatically for every task when
	  running with -vv or greater verbosity.
	  https://docs.ansible.com/ansible/latest/collections/community/general/dense_callback.html#parameter-show_task_path_on_failure

config ANSIBLE_CFG_CALLBACK_PLUGIN_PROFILE_TASKS
	bool "Enable profile_tasks callback for timing analysis"
	output yaml
	default n
	help
	  Enable the profile_tasks callback plugin to provide timing analysis
	  similar to systemd-analyze blame. This shows how long each task takes
	  to execute and provides a summary of the slowest tasks at the end.

	  When enabled, this adds timing information to playbook execution
	  and generates a "TASKS RECAP" section showing execution times.

	  https://docs.ansible.com/ansible/latest/collections/ansible/posix/profile_tasks_callback.html
endmenu

config ANSIBLE_CFG_DEPRECATION_WARNINGS
	bool "deprecation_warnings"
	output yaml
	default y if !ANSIBLE_CFG_CALLBACK_PLUGIN_DIY
	default n if ANSIBLE_CFG_CALLBACK_PLUGIN_DIY
	help
	  Toggle to control the showing of deprecation warnings
	  https://docs.ansible.com/ansible/latest/reference_appendices/config.html#deprecation-warnings

menu "Ansible Python Interpreter"
choice
	prompt "Ansible Python Interpreter"
	default ANSIBLE_CFG_INTERPRETER_PYTHON_AUTO_SILENT if !ANSIBLE_CFG_INTERPRETER_PYTHON_SET_BY_CLI
	default ANSIBLE_CFG_INTERPRETER_PYTHON_CUSTOM if ANSIBLE_CFG_INTERPRETER_PYTHON_SET_BY_CLI

config ANSIBLE_CFG_INTERPRETER_PYTHON_AUTO
	bool "Ansible Python Interpreter: Auto"
	help
	  https://docs.ansible.com/ansible/latest/reference_appendices/interpreter_discovery.html#interpreter-discovery

config ANSIBLE_CFG_INTERPRETER_PYTHON_AUTO_LEGACY
	bool "Ansible Python Interpreter: Auto Legacy"
	help
	  https://docs.ansible.com/ansible/latest/reference_appendices/interpreter_discovery.html#interpreter-discovery

config ANSIBLE_CFG_INTERPRETER_PYTHON_AUTO_LEGACY_CLIENT
	bool "Ansible Python Interpreter: Auto Legacy Client"
	help
	  https://docs.ansible.com/ansible/latest/reference_appendices/interpreter_discovery.html#interpreter-discovery

config ANSIBLE_CFG_INTERPRETER_PYTHON_AUTO_SILENT
	bool "Ansible Python Interpreter: Auto Silent"
	help
	  https://docs.ansible.com/ansible/latest/reference_appendices/interpreter_discovery.html#interpreter-discovery

config ANSIBLE_CFG_INTERPRETER_PYTHON_CUSTOM
	bool "Ansible Python Interpreter: Custom"
	help
	  https://docs.ansible.com/ansible/latest/reference_appendices/interpreter_discovery.html#interpreter-discovery

endchoice

if ANSIBLE_CFG_INTERPRETER_PYTHON_CUSTOM

config ANSIBLE_CFG_INTERPRETER_PYTHON_CUSTOM_NAME
	string "Custom Ansible Python Interpreter Name"
	default $(shell, ./scripts/append-makefile-vars.sh $(ANSIBLE_CFG_INTERPRETER_PYTHON)) if ANSIBLE_CFG_INTERPRETER_PYTHON_SET_BY_CLI
	default "/usr/bin/env python3" if !ANSIBLE_CFG_INTERPRETER_PYTHON_SET_BY_CLI

endif # ANSIBLE_CFG_INTERPRETER_PYTHON_CUSTOM

config ANSIBLE_CFG_INTERPRETER_PYTHON_STRING
	string
	output yaml
	default "auto" if ANSIBLE_CFG_INTERPRETER_PYTHON_AUTO
	default "auto_legacy" if ANSIBLE_CFG_INTERPRETER_PYTHON_AUTO_LEGACY
	default "auto_legacy_client" if ANSIBLE_CFG_INTERPRETER_PYTHON_AUTO_LEGACY_CLIENT
	default "auto_silent" if ANSIBLE_CFG_INTERPRETER_PYTHON_AUTO_SILENT
	default ANSIBLE_CFG_INTERPRETER_PYTHON_CUSTOM_NAME if ANSIBLE_CFG_INTERPRETER_PYTHON_CUSTOM
	help
	  Path to the Python interpreter to be used for module execution on remote targets,
	  or an automatic discovery mode.
	  https://docs.ansible.com/ansible/latest/reference_appendices/python_3_support.html#using-python-3-on-the-managed-machines-with-commands-and-playbooks
	  https://docs.ansible.com/ansible/latest/reference_appendices/interpreter_discovery.html#interpreter-discovery
	  https://docs.ansible.com/ansible/latest/reference_appendices/config.html#interpreter-python
	  https://docs.ansible.com/ansible/latest/reference_appendices/config.html#envvar-ANSIBLE_PYTHON_INTERPRETER

endmenu

config ANSIBLE_CFG_FORKS_CUSTOM
	bool "Enable a custom Ansible forks setting"
	default n
	help
	  When this setting is enabled, specify the maximum number
	  of concurrent Ansible tasks (forks) via Kconfig. When this
	  setting is disabled, kdevops chooses a default value that
	  can be overridden with "ANSIBLE_CFG_FORKS=NN" on the
	  "make" command line.

if ANSIBLE_CFG_FORKS_CUSTOM

config ANSIBLE_CFG_FORKS
	int "forks"
	output yaml
	help
	  Set the maximum number of concurrent Ansible tasks (forks).
	  https://docs.ansible.com/ansible/latest/playbook_guide/playbooks_strategies.html#setting-the-number-of-forks

endif # ANSIBLE_CFG_FORKS_CUSTOM

if !ANSIBLE_CFG_FORKS_CUSTOM

config ANSIBLE_CFG_FORKS
	int
	output yaml
	default 10 if !ANSIBLE_CFG_FORKS_SET_BY_CLI
	default $(shell, ./scripts/append-makefile-vars-int.sh $(ANSIBLE_CFG_FORKS)) if ANSIBLE_CFG_FORKS_SET_BY_CLI

endif # !ANSIBLE_CFG_FORKS_CUSTOM

config ANSIBLE_CFG_TASK_DEBUGGER
	bool "Enable the Ansible task debugger on failed tasks"
	output yaml
	default n
	help
	  When this setting is enabled, a task failure invokes the
	  Ansible debugger. Generally this is useful only when
	  running kdevops from the command line.

	  For more information, see:

	  https://docs.ansible.com/ansible/latest/playbook_guide/playbooks_debugger.html#id10

config ANSIBLE_CFG_INVENTORY_CUSTOM
	bool "Set a custom location for the Ansible inventory"
	help
	  When this option is set to N, kdevops creates its
	  inventory file in a sensible default location. If it is
	  set to Y, you can set the path and filename of the Ansible
	  inventory.

if ANSIBLE_CFG_INVENTORY_CUSTOM

config ANSIBLE_CFG_INVENTORY
	string "Ansible inventory sources"
	output yaml
	default "$(TOPDIR_PATH)/hosts" if !ANSIBLE_CFG_INVENTORY_SET_BY_CLI
	default $(shell, ./scripts/append-makefile-vars-int.sh $(KDEVOPS_HOSTS)) if ANSIBLE_CFG_INVENTORY_SET_BY_CLI
	help
	  Comma-separated list of Ansible inventory source paths.

	  This is mapped to the [defaults] section of the Ansible configuration
	  file (ansible.cfg):
	    inventory = <value>

	  Each entry can be a path to an inventory file or directory,
	  such as:
	    /path/to/hosts,/path/to/inventory_dir

	  For more details, refer to the Ansible documentation:
	  https://docs.ansible.com/ansible/latest/reference_appendices/config.html#default-host-list

endif # ANSIBLE_CFG_INVENTORY_CUSTOM

if DISTRO_OPENSUSE

config ANSIBLE_CFG_RECONNECTION_RETRIES
	string "reconnection_retries"
	output yaml
	default 2000
	help
	  Number of attempts to connect.
	  Ansible retries connections only if it gets an SSH error with a return code of 255.
	  Any errors with return codes other than 255 indicate an issue with program execution.
	  https://docs.ansible.com/ansible/latest/collections/ansible/builtin/ssh_connection.html#parameter-reconnection_retries

endif # DISTRO_OPENSUSE
```
