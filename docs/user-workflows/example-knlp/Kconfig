## kconfigs/monitors/Kconfig
```kconfig
# SPDX-License-Identifier: copyleft-next-0.3.1

config ENABLE_MONITORING
	bool "Enable monitoring services during workflow execution"
	output yaml
	default n
	help
	  Enable monitoring services to collect statistics during workflow
	  execution. This allows collection of various system metrics while
	  workflows are running.

	  Monitoring services run in the background during test execution and
	  automatically collect results afterward. The collected data can be
	  used for performance analysis, debugging, and understanding system
	  behavior during tests.

	  Individual workflows must add support for monitoring integration.
	  Currently supported workflows:
	  - fstests

if ENABLE_MONITORING

config MONITOR_DEVELOPMENTAL_STATS
	bool "Enable developmental statistics (not yet upstream)"
	output yaml
	default n
	help
	  Enable collection of statistics that are still in development
	  and not yet merged upstream in the Linux kernel.

	  This is useful for testing and validating new kernel features
	  that provide additional debugging or performance metrics.

if MONITOR_DEVELOPMENTAL_STATS

config MONITOR_FOLIO_MIGRATION
	bool "Monitor folio migration statistics"
	output yaml
	default n
	help
	  Enable monitoring of folio migration statistics if available.
	  This requires the kernel to have the folio migration debugfs
	  stats patch applied.

	  The statistics are collected from:
	  /sys/kernel/debug/mm/migrate/stats

	  This feature collects migration statistics periodically during
	  workflow execution and can generate plots for visualization.

config MONITOR_FOLIO_MIGRATION_INTERVAL
	int "Folio migration monitoring interval (seconds)"
	output yaml
	default 60
	depends on MONITOR_FOLIO_MIGRATION
	help
	  How often to collect folio migration statistics in seconds.
	  Default is 60 seconds.

	  Lower values provide more granular data but may impact system
	  performance. Higher values reduce overhead but may miss
	  short-lived migration events.

config MONITOR_MEMORY_FRAGMENTATION
	bool "Monitor memory fragmentation with eBPF"
	output yaml
	default n
	help
	  Enable monitoring of memory fragmentation using eBPF-based tracking.
	  This provides advanced memory fragmentation visualization using
	  eBPF tracepoints and matplotlib.

	  This tool tracks memory allocation events and fragmentation indices
	  in real-time, providing insights that traditional methods like
	  /proc/pagetypeinfo cannot fully capture.

	  Features:
	  - eBPF-based tracepoint tracking
	  - Real-time fragmentation index monitoring
	  - Page mobility tracking
	  - Matplotlib visualization of fragmentation data

	  Requirements:
	  - Python 3 with python3-bpfcc
	  - Kernel with required tracepoint support
	  - Root privileges for eBPF attachment

	  The tool is particularly useful for investigating whether Large Block
	  Size support in the kernel creates worse fragmentation.

config MONITOR_FRAGMENTATION_DURATION
	int "Fragmentation monitoring duration (seconds)"
	output yaml
	default 0
	depends on MONITOR_MEMORY_FRAGMENTATION
	help
	  Duration to run fragmentation monitoring in seconds.
	  Set to 0 for continuous monitoring until workflow completion.

	  The monitoring will automatically stop when the workflow
	  finishes or when this duration expires, whichever comes first.

config MONITOR_FRAGMENTATION_OUTPUT_DIR
	string "Fragmentation monitoring output directory"
	output yaml
	default "/root/monitoring/fragmentation"
	depends on MONITOR_MEMORY_FRAGMENTATION
	help
	  Directory where fragmentation monitoring data and plots will be stored.
	  This directory will be created if it doesn't exist.

	  The collected data includes:
	  - Raw eBPF trace data
	  - Generated matplotlib plots
	  - JSON formatted fragmentation metrics

endif # MONITOR_DEVELOPMENTAL_STATS

config MONITOR_NVME_OCP_SMART
	bool "Monitor NVMe OCP extended SMART statistics"
	output yaml
	default n
	help
	  Enable monitoring of NVMe OCP (Open Compute Project) extended SMART
	  statistics using nvme-cli OCP plugin.

	  Collects extended statistics from:
	  nvme ocp smart-add-log --output-format=json

	  The collected data includes cloud SSD specific metrics:
	  - Advanced wear leveling data (erase counts, bad blocks)
	  - Extended reliability metrics (ECC errors, XOR recovery)
	  - Thermal throttling and power management data
	  - Capacitor health and power loss protection status
	  - PCIe error counters and endurance estimates

config MONITOR_NVME_OCP_SMART_INTERVAL
	int "NVMe OCP SMART monitoring interval (seconds)"
	output yaml
	default 120
	depends on MONITOR_NVME_OCP_SMART
	range 60 3600
	help
	  How often to collect NVMe OCP SMART statistics in seconds.
	  Default is 120 seconds (2 minutes).

	  OCP SMART data changes more slowly than standard SMART metrics,
	  so longer intervals are appropriate. Shorter intervals may not
	  provide meaningful additional data and increase system overhead.

config MONITOR_NVME_OCP_SMART_DEVICES
	string "NVMe OCP devices to monitor (space-separated)"
	output yaml
	default "auto"
	depends on MONITOR_NVME_OCP_SMART
	help
	  Space-separated list of OCP-compatible NVMe devices to monitor.

	  Use "auto" to automatically discover OCP-compatible devices by
	  testing nvme ocp smart-add-log capability.

	  Manual specification: "/dev/nvme0n1 /dev/nvme1n1"

config MONITOR_SYSTEM_METRICS
	bool "Monitor system-wide CPU/memory/IO/scheduler time series (sysstat)"
	output yaml
	default n
	help
	  Enable workflow-bracketed sysstat (sadc) recording on the
	  guest. Captures CPU (global + per-CPU + virtualization),
	  memory, hugepages, swap, paging, IO (global + per-device),
	  interrupts, network (DEV + IP/TCP/UDP/ICMP + IPv6), NFS,
	  sockets, run queue + load, softnet, kernel tables, USB,
	  filesystem util, power (CPU freq, temp, fans, voltage),
	  and pressure-stall (PSI).

	  Output is binary sa-current under
	  /data/monitor/sysstat/ inside the guest, converted to
	  sa-current.json (sadf -j) when the recorder stops. On the
	  qemu-system-units backend this path is a virtiofs share
	  written through to the controller at
	  workflows/<workflow>/results/monitoring/<vm>/sysstat/.

config MONITOR_SYSTEM_METRICS_INTERVAL
	int "system_metrics sample interval (seconds)"
	output yaml
	default 5
	depends on MONITOR_SYSTEM_METRICS
	range 1 600
	help
	  How often sadc samples /proc and /sys, in seconds. Lower
	  values produce finer-grained time series at the cost of
	  more data and slightly higher overhead. Default 5 seconds
	  is fine-grained enough to catch test transitions without
	  bloating the .sa file on multi-hour runs.

menu "Host snapshots (one-time captures, not continuous monitoring)"

comment "These monitors take a snapshot of host/kernel state at the"
comment "start of the workload window and another at the end. Output"
comment "lands under /data/monitor/<monitor>/{start,end}.json on the"
comment "guest. The report pivots start vs end to surface drift and"
comment "common-vs-differing attributes across (vm, kernel) runs."

config MONITOR_SNAPSHOTS_ALL
	bool "Enable the default set of snapshot monitors"
	output yaml
	default n
	help
	  Convenience knob that turns on every snapshot-style monitor
	  below with its default settings. Useful when you want the
	  full host/kernel context for the report and don't want to
	  flip each one individually.

	  Time-series monitors (sysstat, fragmentation,
	  folio_migration) above are NOT affected by this knob —
	  they remain opt-in even when this is set.

	  Individual snapshot monitors can still be set =n explicitly
	  to override the auto-enable; this knob only changes their
	  default, not their final value.

config MONITOR_CPU_GOVERNOR
	bool "Snapshot CPU governor at workflow start and end"
	output yaml
	default y if MONITOR_SNAPSHOTS_ALL
	default n
	help
	  Read /sys/devices/system/cpu/cpuN/cpufreq/scaling_governor
	  for every CPU at the start and end of the workload window
	  and write the per-CPU governor mapping as JSON to
	  /data/monitor/cpu_governor/{start,end}.json on the guest.

	  Useful to verify test conditions and detect governor
	  changes mid-run that would skew comparisons.

config MONITOR_BLOCKDEV
	bool "Snapshot block-layer + NVMe sysfs at workflow start and end"
	output yaml
	default y if MONITOR_SNAPSHOTS_ALL
	default n
	help
	  Walk the storage-related sysfs surfaces governed by
	  Documentation/ABI/stable/sysfs-block (/sys/class/block/<dev>/
	  including queue/) and Documentation/ABI/stable/sysfs-class-nvme
	  (/sys/class/nvme/<ctrl>/) at the start and end of the
	  workload window and write the per-device attribute snapshots
	  as JSON to /data/monitor/blockdev/{start,end}.json on the
	  guest.

	  The walker auto-discovers attributes — kernel-added files
	  appear in future runs without a script change. The report
	  pivots common-vs-differing attributes per ABI surface so a
	  reviewer can confirm the storage configuration the workload
	  ran against (queue depth, scheduler, write_cache, atomic-write
	  limits, NVMe model/firmware) at a glance.

config MONITOR_HOST_INFO
	bool "Snapshot host identity (fastfetch) at workflow start and end"
	output yaml
	default y if MONITOR_SNAPSHOTS_ALL
	default n
	help
	  Run fastfetch with --format json and write the result to
	  /data/monitor/host_info/{start,end}.json on the guest.
	  Captures distro id and version, kernel name + release +
	  build banner, CPU vendor + model + topology + cache sizes,
	  RAM total, BIOS + board + chassis vendor and revision,
	  package counts, init system, and locale.

	  fastfetch must be present on the guest. The kdevops
	  qemu-system-units backend ships it via the nixos-qemu
	  monitoring module; on libvirt guests this monitor is a
	  no-op until per-distro install support lands.

config MONITOR_BOOT_PARAMS
	bool "Snapshot kernel boot parameters at workflow start and end"
	output yaml
	default y if MONITOR_SNAPSHOTS_ALL
	default n
	help
	  Capture the kernel boot-time invariants:
	    /proc/cmdline
	    /proc/version             (build banner with compiler + date)
	    /proc/sys/kernel/tainted  (taint mask)
	    /proc/sys/kernel/randomize_va_space (ASLR)

	  All four are set at boot and shouldn't change during a run;
	  drift between start.json and end.json (especially a non-zero
	  tainted) is the signal a reviewer needs.

config MONITOR_CPU_FEATURES
	bool "Snapshot CPU features and mitigations at workflow start and end"
	output yaml
	default y if MONITOR_SNAPSHOTS_ALL
	default n
	help
	  Capture static CPU state from sysfs:
	    /sys/devices/system/cpu/vulnerabilities/* (every entry,
	      auto-discovered: spectre_v1, spectre_v2, meltdown,
	      mds, srbds, retbleed, gds, srso, vmscape, ...)
	    /sys/devices/system/cpu/smt/{active,control}
	    /sys/devices/system/cpu/{online,present,possible,offline}
	    /sys/devices/system/cpu/cpu0/microcode/{version,processor_flags}

	  Microcode files are absent on emulated guests where the
	  hypervisor doesn't expose host microcode through the
	  virtualized CPU; the collector records them as null
	  gracefully.

config MONITOR_CLOCKSOURCE
	bool "Snapshot clocksource selection at workflow start and end"
	output yaml
	default y if MONITOR_SNAPSHOTS_ALL
	default n
	help
	  Capture the active and available clocksources:
	    /sys/devices/system/clocksource/clocksource0/current_clocksource
	    /sys/devices/system/clocksource/clocksource0/available_clocksource

	  Useful to detect clocksource flips mid-run (kvm-clock falling
	  back to tsc, hpet kicking in) which can dominate flaky-test
	  variance under fstests.

config MONITOR_VM_TUNING
	bool "Snapshot virtual-memory tuning at workflow start and end"
	output yaml
	default y if MONITOR_SNAPSHOTS_ALL
	default n
	help
	  Capture VM (virtual memory) tuning state:
	    /sys/kernel/mm/transparent_hugepage/{enabled,defrag,shmem_enabled}
	    /proc/sys/vm/swappiness
	    /proc/sys/vm/dirty_ratio
	    /proc/sys/vm/dirty_background_ratio
	    /proc/sys/vm/overcommit_memory
	    /proc/sys/vm/overcommit_ratio

	  THP and dirty-writeback policies materially change fs/io
	  test outcomes; capturing them per-run lets the report flag
	  unintended changes between A/B kernel comparisons.

config MONITOR_LSM
	bool "Snapshot Linux Security Module status at workflow start and end"
	output yaml
	default y if MONITOR_SNAPSHOTS_ALL
	default n
	help
	  Capture the security state from sysfs:
	    /sys/kernel/security/lsm       (active LSM list)
	    /sys/kernel/security/lockdown  (lockdown level)
	    /sys/firmware/efi              (presence flag)

	  Requires CONFIG_SECURITYFS=y and CONFIG_SECURITY_LOCKDOWN_LSM=y
	  in the guest kernel (kdevops config-qsu enables both). On
	  kernels without those, the collector records null gracefully.

config MONITOR_DMI
	bool "Snapshot DMI/firmware identity at workflow start and end"
	output yaml
	default y if MONITOR_SNAPSHOTS_ALL
	default n
	help
	  Capture the full DMI tree under /sys/devices/virtual/dmi/id/.
	  All readable scalar attributes are recorded — bios_*,
	  board_*, chassis_*, product_*, sys_vendor, modalias.

	  DMI is firmware-exposed (BIOS / UEFI), not kernel-emitted,
	  so this is mostly invariant across runs of the same guest.
	  The diff against start vs end is useful to flag a firmware
	  update mid-run on bare-metal hosts.

endmenu

# Future monitoring options can be added here
# Examples:
# - Memory pressure monitoring
# - Network traffic monitoring
# - Custom perf event monitoring

endif # ENABLE_MONITORING
```
