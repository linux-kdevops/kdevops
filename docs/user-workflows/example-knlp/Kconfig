## kconfigs/Kconfig.bringup
```kconfig
# SPDX-License-Identifier: copyleft-next-0.3.1
config BRINGUP_SUPPORTS_CXL
	bool

config KDEVOPS_ENABLE_GUESTFS
	bool
	output yaml

config KDEVOPS_ENABLE_NIXOS_FLAKE
	bool
	output yaml

config KDEVOPS_ENABLE_NIXOSFL
	bool
	output yaml

config KDEVOPS_ENABLE_NIXOSFI
	bool
	output yaml

config CLOUD_INITIALIZED
	bool
	default $(shell, test -f .cloud.initialized && echo y || echo n) = "y"

# CLI override detection for DECLARED_HOSTS which should enable SKIP_BRINGUP
config SKIP_BRINGUP_SET_BY_CLI
	bool
	default $(shell, scripts/check-cli-set-var.sh DECLARED_HOSTS)
	select SKIP_BRINGUP
	select KDEVOPS_USE_DECLARED_HOSTS

choice
	prompt "Node bring up method"
	default TERRAFORM if CLOUD_INITIALIZED
	default GUESTFS if !CLOUD_INITIALIZED

config GUESTFS
	bool "Use guestfs-tools for local virtualization via KVM and libvirt"
	select KDEVOPS_ENABLE_GUESTFS
	select EXTRA_STORAGE_SUPPORTS_LARGEIO
	help
	  This option will use libguestfs utilities to build guest images and
	  spin them up using libvirt with KVM.

config TERRAFORM
	bool "Terraform for cloud environments"
	select EXTRA_STORAGE_SUPPORTS_512
	select EXTRA_STORAGE_SUPPORTS_1K
	select EXTRA_STORAGE_SUPPORTS_2K
	select EXTRA_STORAGE_SUPPORTS_4K
	help
	  Enable this if you want to use terraform to create nodes on a cloud
	  environment such as:

	    * Azure
	    * AWS
	    * GCE

	  Enabling this option will enable installing terraform dependencies
	  when you run:

	    make deps

	  If you are not using a cloud environment just disable this.

config NIXOSFL
	bool "NixOS declarative configuration with libvirt"
	select KDEVOPS_ENABLE_NIXOSFL
	select KDEVOPS_ENABLE_NIXOS_FLAKE
	select HAVE_CUSTOM_DISTRO_HOST_PREFIX
	select HAVE_DISTRO_PREFERS_CUSTOM_HOST_PREFIX
	select EXTRA_STORAGE_SUPPORTS_512
	select EXTRA_STORAGE_SUPPORTS_1K
	select EXTRA_STORAGE_SUPPORTS_2K
	select EXTRA_STORAGE_SUPPORTS_4K
	select EXTRA_STORAGE_SUPPORTS_LARGEIO
	help
	  Use the nixos-flake library to provision VMs with libvirt.
	  Per-node Nix flakes import nixos-flake.nixosModules.backends.libvirt
	  to produce a qcow2 disk image; kdevops stages it into the libvirt
	  storage pool, defines and starts the domain, and waits for SSH.

config NIXOSFI
	bool "qsu systemd-unit toolkit for QEMU VMs (nixos-flake imageless guests)"
	select KDEVOPS_ENABLE_NIXOSFI
	select KDEVOPS_ENABLE_NIXOS_FLAKE
	select HAVE_CUSTOM_DISTRO_HOST_PREFIX
	select HAVE_DISTRO_PREFERS_CUSTOM_HOST_PREFIX
	select EXTRA_STORAGE_SUPPORTS_512
	select EXTRA_STORAGE_SUPPORTS_1K
	select EXTRA_STORAGE_SUPPORTS_2K
	select EXTRA_STORAGE_SUPPORTS_4K
	help
	  Run each guest as a systemd machine: a qemu-system@<vm>
	  service registered with systemd-machined (visible in
	  machinectl, placed in machine.slice), the model
	  systemd-vmspawn uses, from the templates in
	  scripts/qemu-system-units/. The guest closure is the
	  nixos-flake backends.imageless NixOS module (tmpfs root,
	  /nix/store and /lib/modules shared in via virtiofs); the
	  kernel comes from BOOTLINUX_DIRECT_BOOT via qemu-system-*
	  -kernel. No libvirt daemon, no qcow2.

config SKIP_BRINGUP
	bool "Skip bring up - bare metal or existing nodes"
	select EXTRA_STORAGE_SUPPORTS_512
	select EXTRA_STORAGE_SUPPORTS_1K
	select EXTRA_STORAGE_SUPPORTS_2K
	select EXTRA_STORAGE_SUPPORTS_4K
	help
	  This option will skip bring up, as you already have existing
	  systems up and available and ssh'able. This might be the case
	  if you are working with bare metal systems or systems you may
	  have already provisioned through other means.

endchoice

config LIBVIRT
	bool
	depends on GUESTFS || NIXOSFL
	default y

source "kconfigs/Kconfig.guestfs"
source "kconfigs/Kconfig.nixos_flake"
source "kconfigs/Kconfig.qsu"
source "terraform/Kconfig"
source "kconfigs/Kconfig.declared_hosts"
if LIBVIRT
source "kconfigs/Kconfig.libvirt"
endif
```

## kconfigs/Kconfig.bringup.goals
```kconfig
config HAVE_DISTRO_PREFERS_REFRESH
	bool
	default n

config HAVE_DISTRO_PREFERS_UPDATE
	bool
	default n

config HAVE_DISTRO_PREFERS_INSTALL_KDEVTOOLS
	bool
	default n

config KDEVOPS_TRY_REFRESH_REPOS
	bool "Try to refresh repositories on bringup?"
	default n if !HAVE_DISTRO_PREFERS_REFRESH
	default y if HAVE_DISTRO_PREFERS_REFRESH
	help
	  Bring up typically just consists of having the systems accessible
	  via ssh. However, most of these systems are pretty bare bones and
	  useless right after bring up, likely with stale repositories or
	  software. Enabling this option will only try to update the
	  repositories. If you require registration to update your repositories
	  that implies we will try to register your system if you enable that.
	  You will need to enable this option to install any packages through
	  the automated system on kdevops.

	  Disabling this is a good idea if all you want to do is test raw
	  bring up of kdevops.

config RHEL_REGISTER
	bool "Register the guests with Red Hat?"
	default n
	help
	  Official RHEL installations require a subscription before you can download
	  packages from their core repos. Enable this if you're deploying an official
	  RHEL cloud image (e.g. generic/rhel9).

config RHEL_ORG_ID
	string "Red Hat Organization Identifier"
	depends on RHEL_REGISTER
	default ""
	help
	  Enter the Red Hat Organizational ID for your subscription here.

config RHEL_ACTIVATION_KEY
	string "Red Hat Activation Key"
	depends on RHEL_REGISTER
	default ""
	help
	  Enter the Activation Key to use when registering systems.

config KDEVOPS_CUSTOM_YUM_REPOFILE
	string "Custom yum repo file"
	default ""
	help
	  Add a custom yum repo file to /etc/yum.repos.d before updating? Leave blank to
	  disable this feature or set to repofile path on local machine.

config KDEVOPS_TRY_UPDATE_SYSTEMS
	bool "Try to update target hosts on bringup?"
	depends on KDEVOPS_TRY_REFRESH_REPOS
	default n if !HAVE_DISTRO_PREFERS_UPDATE
	default y if HAVE_DISTRO_PREFERS_UPDATE
	help
	  Bring up typically just consists of having the systems accessible
	  via ssh. However, most of these systems are pretty bare bones and
	  useless right after bring up. Enabling this will try to update your
	  target systems to their respective latest.

config KDEVOPS_TRY_INSTALL_KDEV_TOOLS
	bool "Try to install kernel development tools on bringup?"
	depends on KDEVOPS_TRY_REFRESH_REPOS
	default n if !HAVE_DISTRO_PREFERS_INSTALL_KDEVTOOLS
	default y if HAVE_DISTRO_PREFERS_INSTALL_KDEVTOOLS
	help
	  Enabling this will try to install a slew of known packages which
	  most kernel developers might prefer to have installed on target
	  systems.

choice
	prompt "Configure an RDMA device"
	default KDEVOPS_SETUP_RDMA_NONE
	help
	  Provision an RDMA device on target nodes. The default is to
	  provision no additional RDMA devices.

config KDEVOPS_SETUP_RDMA_NONE
	bool "none"
	help
	  Do not provision an additional RDMA device on target nodes.
	  This is the default behavior.

config KDEVOPS_SETUP_RDMA_SIW
	bool "siw"
	help
	  Provision software-emulated RDMA on target nodes via the
	  kernel siw.ko driver. siw can be used with any standard
	  Ethernet device, including virtio-net devices.

	  To use this device driver, enable the CONFIG_RDMA_SIW
	  option in your test kernels.

config KDEVOPS_SETUP_RDMA_RXE
	bool "rxe"
	help
	  Provision software-emulated RDMA on target nodes via the
	  kernel rxe.ko driver. rxe can be used with any standard
	  Ethernet device, including virtio-net devices.

	  To use this device driver, enable the CONFIG_RDMA_RXE
	  option in your test kernels.

endchoice

config KDEVOPS_SETUP_KTLS
	bool "Configure ktls on the hosts with self-signed CA"
	default n
	help
	  Enabling this will have kdevops create a self-signed certificate
	  authority, and configure tlshd on the hosts to use it. This is
	  necessary for testing RPC over TLS, or NVMe over TCP.

source "kconfigs/Kconfig.nfsd"
source "kconfigs/Kconfig.smbd"
source "kconfigs/Kconfig.krb5"
```

## kconfigs/Kconfig.declared_hosts
```kconfig
# Configuration for declared hosts that skip bringup process

config KDEVOPS_USE_DECLARED_HOSTS
	bool "Use declared hosts (skip bringup process)"
	select WORKFLOW_INFER_USER_AND_GROUP
	output yaml
	help
	  Enable this option to use pre-existing hosts that you have already
	  configured with SSH access. This is useful for:

	  * Bare metal systems
	  * Pre-provisioned VMs or cloud instances
	  * Systems managed by other infrastructure tools

	  When this option is enabled:
	  - SSH keys will not be generated (assumes you already have access)
	  - Bringup and teardown operations will be skipped
	  - User and group settings will be inferred from the target hosts
	  - You must provide the list of hosts in KDEVOPS_DECLARED_HOSTS

	  This option automatically:
	  - Selects WORKFLOW_INFER_USER_AND_GROUP to detect the correct
	    user and group on the target systems
	  - Assumes SSH access is already configured

if KDEVOPS_USE_DECLARED_HOSTS

config KDEVOPS_DECLARED_HOSTS
	string "List of declared hosts"
	output yaml
	default "$(shell, echo ${DECLARED_HOSTS})"
	default ""
	help
	  Provide a list of hostnames or IP addresses for the pre-existing
	  systems you want to use. These hosts must already be accessible
	  via SSH with the appropriate keys configured.

	  Format: Space or comma-separated list
	  Example: "host1 host2 host3" or "host1,host2,host3"

	  These hosts will be used directly without any bringup process.
	  Make sure you have:
	  - SSH access configured
	  - Required packages installed
	  - Appropriate user permissions

config KDEVOPS_DECLARED_HOSTS_GROUP_VARS
	bool "Apply group variables to declared hosts"
	default y
	output yaml
	help
	  When enabled, kdevops will apply the appropriate group variables
	  to the declared hosts based on the selected workflow.

	  This ensures that declared hosts receive the same configuration
	  variables as dynamically provisioned hosts would.

endif # KDEVOPS_USE_DECLARED_HOSTS
```

## kconfigs/Kconfig.defaults
```kconfig
# Please keep in alphabetical order

config DEFAULT_BLKTESTS_URL
	string
	default "https://github.com/osandov/blktests.git"

config DEFAULT_BLKTRACE_URL
	string
	default "https://git.kernel.dk/blktrace"

config DEFAULT_DATE_ISO8601
	string
	default $(shell, date -I)

config DEFAULT_DBENCH_URL
	string
	default "https://github.com/linux-kdevops/dbench.git"

config DEFAULT_FSTESTS_GIT_URL
	string
	default "git://git.kernel.org/pub/scm/fs/xfs/xfstests-dev.git"

config DEFAULT_FSTESTS_HTTPS_URL
	string
	default "https://git.kernel.org/pub/scm/fs/xfs/xfstests-dev.git"

config DEFAULT_FSTESTS_GOOGLE_HTTPS_URL
	string
	default "https://kernel.googlesource.com/pub/scm/fs/xfs/xfstests-dev.git"

config DEFAULT_FSTESTS_KDEVOPS_GITHUB_HTTPS_URL
	string
	default "https://github.com/linux-kdevops/fstests.git"

config DEFAULT_FSTESTS_KDEVOPS_GITLAB_HTTPS_URL
	string
	default "https://gitlab.com/linux-kdevops/fstests.git"

config DEFAULT_GIT_URL
	string
	default "https://git.kernel.org/pub/scm/git/git.git"

config DEFAULT_KDEVOPS_GITHUB_HTTPS_URL
	string
	default "https://github.com/linux-kdevops/kdevops.git"

config DEFAULT_KDEVOPS_GITLAB_HTTPS_URL
	string
	default "https://gitlab.com/linux-kdevops/kdevops.git"

config DEFAULT_KDEVOPS_LINUX_HTTPS_URL
	string
	default "https://github.com/linux-kdevops/linux.git"

config DEFAULT_QEMU_GITHUB_HTTPS_URL
	string
	default "https://github.com/qemu/qemu.git"

config DEFAULT_QEMU_GITHUB_SSH_URL
	string
	default "ssh://git@github.com:qemu/qemu.git"

config DEFAULT_QEMU_GITLAB_HTTPS_URL
	string
	default "https://gitlab.com/qemu-project/qemu.git"

config DEFAULT_QEMU_GITLAB_SSH_URL
	string
	default "ssh://git@gitlab.com:qemu-project/qemu.git"

config DEFAULT_QEMU_JIC23_GITHUB_HTTPS_URL
	string
	default "https://github.com/jic23/qemu.git"

config DEFAULT_QEMU_JIC23_GITHUB_SSH_URL
	string
	default "ssh://git@github.com:jic23/qemu.git"

config DEFAULT_QEMU_JIC23_GITLAB_HTTPS_URL
	string
	default "https://gitlab.com/jic23/qemu.git"

config DEFAULT_QEMU_JIC23_GITLAB_SSH_URL
	string
	default "ssh://git@gitlab.com:jic23/qemu.git"

config DEFAULT_LINUX_NEXT_GIT_URL
	string
	default "git://git.kernel.org/pub/scm/linux/kernel/git/next/linux-next.git"

config DEFAULT_LINUX_NEXT_HTTPS_URL
	string
	default "https://git.kernel.org/pub/scm/linux/kernel/git/next/linux-next.git"

config DEFAULT_LINUX_NEXT_HTTPS_GOOGLE_URL
	string
	default "https://kernel.googlesource.com/pub/scm/linux/kernel/git/next/linux-next.git"

config DEFAULT_LTP_URL
	string
	default "https://github.com/linux-test-project/ltp.git"

config DEFAULT_MODULES_GIT
	string
	default "git://git.kernel.org/pub/scm/linux/kernel/git/modules/linux.git"

config DEFAULT_MODULES_HTTPS_GIT
	string
	default "https://git.kernel.org/pub/scm/linux/kernel/git/modules/linux.git"

config DEFAULT_MODULES_HTTPS_GOOGLE_URL
	string
	default "https://kernel.googlesource.com/pub/scm/linux/kernel/git/modules/linux.git"

config DEFAULT_MCGROF_LINUS_GIT_URL
	string
	default "https://git.kernel.org/pub/scm/linux/kernel/git/mcgrof/linux-next.git"

config DEFAULT_MCGROF_LINUS_HTTPS_URL
	string
	default "https://git.kernel.org/pub/scm/linux/kernel/git/mcgrof/linux.git"

config DEFAULT_MCGROF_LINUS_HTTPS_GOOGLE_URL
	string
	default "https://kernel.googlesource.com/pub/scm/linux/kernel/git/mcgrof/linux.git"

config DEFAULT_MCGROF_NEXT_GIT_URL
	string
	default "git://git.kernel.org/pub/scm/linux/kernel/git/mcgrof/linux-next.git"

config DEFAULT_MCGROF_NEXT_HTTPS_URL
	string
	default "https://git.kernel.org/pub/scm/linux/kernel/git/mcgrof/linux-next.git"

config DEFAULT_MCGROF_NEXT_HTTPS_GOOGLE_URL
	string
	default "https://kernel.googlesource.com/pub/scm/linux/kernel/git/mcgrof/linux-next.git"

config DEFAULT_NFSTEST_URL
	string
	default "git://git.linux-nfs.org/projects/mora/nfstest.git"

config DEFAULT_TORVALDS_GIT_URL
	string
	default "git://git.kernel.org/pub/scm/linux/kernel/git/torvalds/linux.git"

config DEFAULT_TORVALDS_HTTPS_URL
	string
	default "https://git.kernel.org/pub/scm/linux/kernel/git/torvalds/linux.git"

config DEFAULT_TORVALDS_HTTPS_GOOGLE_URL
	string
	default "https://kernel.googlesource.com/pub/scm/linux/kernel/git/torvalds/linux.git"

config DEFAULT_STABLE_GIT_URL
	string
	default "git://git.kernel.org/pub/scm/linux/kernel/git/stable/linux.git"

config DEFAULT_STABLE_HTTPS_URL
	string
	default "https://git.kernel.org/pub/scm/linux/kernel/git/stable/linux.git"

config DEFAULT_STABLE_HTTPS_GOOGLE_URL
	string
	default "https://kernel.googlesource.com/pub/scm/linux/kernel/git/stable/linux.git"

config DEFAULT_VFS_GIT_URL
	string
	default "git://git.kernel.org/pub/scm/linux/kernel/git/vfs/vfs.git"

config DEFAULT_VFS_HTTPS_URL
	string
	default "https://git.kernel.org/pub/scm/linux/kernel/git/vfs/vfs.git"

config DEFAULT_VFS_HTTPS_GOOGLE_URL
	string
	default "https://kernel.googlesource.com/pub/scm/linux/kernel/git/vfs/vfs.git"

config DEFAULT_XFS_GIT
	string
	default "git://git.kernel.org/pub/scm/fs/xfs/xfs-linux.git/"

config DEFAULT_XFS_HTTPS_GIT
	string
	default "https://git.kernel.org/pub/scm/fs/xfs/xfs-linux.git/"

config DEFAULT_XFS_HTTPS_GOOGLE_URL
	string
	default "https://kernel.googlesource.com/pub/scm/fs/xfs/xfs-linux.git/"

config DEFAULT_XFSDUMP_URL
	string
	default "https://github.com/linux-kdevops/xfsdump-dev.git"

config DEFAULT_XFSPROGS_URL
	string
	default "https://git.kernel.org/pub/scm/fs/xfs/xfsprogs-dev.git"
```
