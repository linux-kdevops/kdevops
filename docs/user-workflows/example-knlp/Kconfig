## kconfigs/Kconfig.mirror
```kconfig
if !TERRAFORM

config ENABLE_LOCAL_LINUX_MIRROR
	bool "Enable kdevops to use your localhost as a git mirror for Linux"
	default $(shell, scripts/check_mirror.sh ENABLE_LOCAL_LINUX_MIRROR)
	help
	  When doing build on Linux one of the most timely consuming operations
	  is doing a git clone on Linux. This is whether you are doing a local
	  build on your system or on the guest, either way, a git clone
	  operation on a Linux tree takes forever. You can optimize the build
	  process by using a local mirror.

	  Enabling this option let's you either just pick a locally setup up
	  mirror or let's kdevops go ahead and set up the new mirror for you.

	  Enable this option if if you want to save time with building Linux.

if ENABLE_LOCAL_LINUX_MIRROR

config USE_LOCAL_LINUX_MIRROR
	bool "Use local linux mirror"
	default $(shell, scripts/check_mirror.sh USE_LOCAL_LINUX_MIRROR)
	help
	  If you have a local Linux mirror already set up, or want to use
	  the one which kdevops lets you set up, enable this option so that
	  build targets can use it.

config LINUX_MIRROR_MOUNTED_ON_NFS
	bool
	output yaml
	default $(shell, ./scripts/check_mirror_nfs.sh /mirror)

config INSTALL_ONLY_GIT_DAEMON
	bool "Install only git daemon"
	output yaml
	default LINUX_MIRROR_MOUNTED_ON_NFS
	select MIRROR_INSTALL
	help
	  If you have your /mirror/ setup as a mount point from another NFS
	  server, you still want to set up a git daemon on the system locally
	  so that guests can take advantage and leverage your NFS server.

config MIRROR_INSTALL
	bool
	output yaml

config INSTALL_LOCAL_LINUX_MIRROR
	bool "Install local mirror setup"
	default $(shell, scripts/check_mirror.sh INSTALL_LOCAL_LINUX_MIRROR)
	depends on !LINUX_MIRROR_MOUNTED_ON_NFS
	select MIRROR_INSTALL
	help
	  If you enable this kdevops will git clone the main Linux repos needed
	  for Linux as bare git repositories and then install systemd units
	  to keep these properly updated. The repositories will be placed
	  into /mirror/ directory:

	  Kernel development trees:
	    /mirror/linux.git
	    /mirror/linux-stable.git
	    /mirror/linux-next.git
	    /mirror/kdevops-linus.git
	    /mirror/mcgrof-next.git
	    /mirror/mcgrof-linus.git

	  kdevops specific trees and kdevops git alternatives:
	    /mirror/kdevops.git
	    /mirror/kdevops/fstests.git

	  Tools:
	    /mirror/fstests.git
	    /mirror/blktests.git

	  Enabling this even if you already have the repositories does nothing
	  so it is safe to keep this enabled even after your first linux-mirror
	  setup. You can however safely also disable this option after your
	  first linux-mirror setup and just use USE_LOCAL_LINUX_MIRROR so to
	  make use of the mirror.

config MIRROR_GIT_WORKS
	bool
	default $(shell, ./scripts/test_git_firewall.sh)

config LINUX_MIRROR_NFS
	bool "Set up NFS server"
	output yaml
	depends on INSTALL_LOCAL_LINUX_MIRROR
	help
	  Enable this if you want to set up your system as an NFS server.

choice
	prompt "kdevops mirror source"
	default MIRROR_KDEVOPS_HTTPS_GITHUB
	depends on INSTALL_LOCAL_LINUX_MIRROR

config MIRROR_KDEVOPS_HTTPS_GITHUB
	bool "HTTPS (github)"
	help
	  If you enable this option then Github HTTPS will be used as the
	  source of the mirror. The URL is:

	  https://github.com/linux-kdevops/kdevops.git

config MIRROR_KDEVOPS_HTTPS_GITLAB
	bool "HTTPS (GitLab)"
	help
	  If you enable this option then GitLab HTTPS will be used as the
	  source of the mirror. The URL is:

	  https://gitlab.com/linux-kdevops/kdevops.git

endchoice

config MIRROR_KDEVOPS_URL
	string
	output yaml
	default DEFAULT_KDEVOPS_GITHUB_HTTPS_URL if MIRROR_KDEVOPS_HTTPS_GITHUB
	default DEFAULT_KDEVOPS_GITLAB_HTTPS_URL if MIRROR_KDEVOPS_HTTPS_GITLAB

choice
	prompt "Linux mirror protocol"
	default MIRROR_TORVALDS_GIT if MIRROR_GIT_WORKS
	default MIRROR_TORVALDS_HTTPS if !MIRROR_GIT_WORKS
	depends on INSTALL_LOCAL_LINUX_MIRROR

config MIRROR_TORVALDS_HTTPS
	bool "HTTPS"
	help
	  If you enable this option then HTTPS will be used as the source
	  of the mirror. The URL is:

	  https://git.kernel.org/pub/scm/linux/kernel/git/stable/linux.git

config MIRROR_TORVALDS_HTTPS_GOOGLE
	bool "HTTPS (Google)"
	help
	  If you enable this option then HTTPS will be used as the source
	  of the mirror and Google URL will be chosen. The URL is:

	  https://kernel.googlesource.com/pub/scm/linux/kernel/git/stable/linux.git

config MIRROR_TORVALDS_GIT
	bool "Git"
	depends on MIRROR_GIT_WORKS
	help
	  If you enable this option then git:// protocol will be used as the
	  source of the mirror. The URL is:

	  git://git.kernel.org/pub/scm/linux/kernel/git/stable/linux.git

endchoice

config MIRROR_TORVALDS_URL
	string
	output yaml
	default DEFAULT_TORVALDS_GIT_URL if MIRROR_TORVALDS_GIT
	default DEFAULT_TORVALDS_HTTPS_URL if MIRROR_TORVALDS_HTTPS
	default DEFAULT_TORVALDS_HTTPS_GOOGLE_URL if MIRROR_TORVALDS_HTTPS_GOOGLE

choice
	prompt "Linux kdevops's linux fork protocol/source"
	default MIRROR_KDEVOPS_LINUS_HTTPS
	depends on INSTALL_LOCAL_LINUX_MIRROR

config MIRROR_KDEVOPS_LINUS_HTTPS
	bool "HTTPS"
	help
	  If you enable this option then HTTPS will be used as the source
	  of the mirror. The URL is:

	  https://git.kernel.org/pub/scm/linux/kernel/git/mcgrof/linux-next.git

endchoice

config MIRROR_KDEVOPS_LINUS_URL
	string
	output yaml
	default DEFAULT_KDEVOPS_LINUX_HTTPS_URL if MIRROR_KDEVOPS_LINUS_HTTPS

choice
	prompt "Linux Next mirror protocol/source"
	default MIRROR_NEXT_GIT if MIRROR_GIT_WORKS
	default MIRROR_NEXT_HTTPS if !MIRROR_GIT_WORKS
	depends on INSTALL_LOCAL_LINUX_MIRROR

config MIRROR_NEXT_HTTPS
	bool "HTTPS"
	help
	  If you enable this option then HTTPS will be used as the source
	  of the mirror. The URL is:

	  https://git.kernel.org/pub/scm/linux/kernel/git/next/linux-next.git

config MIRROR_NEXT_HTTPS_GOOGLE
	bool "HTTPS (Google)"
	help
	  If you enable this option then HTTPS will be used as the source
	  of the mirror and Google URL will be chosen. The URL is:

	  https://kernel.googlesource.com/pub/scm/linux/kernel/git/stable/linux.git

config MIRROR_NEXT_GIT
	bool "Git"
	depends on MIRROR_GIT_WORKS
	help
	  If you enable this option then Git protocol will be used as the
	  source of the mirror. The URL is:

	  git://git.kernel.org/pub/scm/linux/kernel/git/next/linux-next.git

endchoice

config MIRROR_NEXT_URL
	string
	output yaml
	default DEFAULT_LINUX_NEXT_GIT_URL if MIRROR_NEXT_GIT
	default DEFAULT_LINUX_NEXT_HTTPS_URL if MIRROR_NEXT_HTTPS
	default DEFAULT_LINUX_NEXT_HTTPS_GOOGLE_URL if MIRROR_NEXT_HTTPS_GOOGLE

choice
	prompt "Linux mcgrof's linux-next fork protocol/source"
	default MIRROR_MCGROF_GIT if MIRROR_GIT_WORKS
	default MIRROR_MCGROF_HTTPS if !MIRROR_GIT_WORKS
	depends on INSTALL_LOCAL_LINUX_MIRROR

config MIRROR_MCGROF_HTTPS
	bool "HTTPS"
	help
	  If you enable this option then HTTPS will be used as the source
	  of the mirror. The URL is:

	  https://git.kernel.org/pub/scm/linux/kernel/git/mcgrof/linux-next.git

config MIRROR_MCGROF_HTTPS_GOOGLE
	bool "HTTPS (Google)"
	help
	  If you enable this option then HTTPS will be used as the source
	  of the mirror and Google URL will be chosen. The URL is:

	  https://kernel.googlesource.com/pub/scm/linux/kernel/git/mcgrof/linux-next.git

config MIRROR_MCGROF_GIT
	bool "Git"
	depends on MIRROR_GIT_WORKS
	help
	  If you enable this option then Git protocol will be used as the
	  source of the mirror. The URL is:

	  git://git.kernel.org/pub/scm/linux/kernel/git/mcgrof/linux-next.git

endchoice

config MIRROR_MCGROF_URL
	string
	output yaml
	default DEFAULT_MCGROF_NEXT_GIT_URL if MIRROR_MCGROF_GIT
	default DEFAULT_MCGROF_NEXT_HTTPS_URL if MIRROR_MCGROF_HTTPS
	default DEFAULT_MCGROF_NEXT_HTTPS_GOOGLE_URL if MIRROR_MCGROF_HTTPS_GOOGLE

choice
	prompt "Linux mcgrof's linux fork protocol/source"
	default MIRROR_MCGROF_LINUS_GIT if MIRROR_GIT_WORKS
	default MIRROR_MCGROF_LINUS_HTTPS if !MIRROR_GIT_WORKS
	depends on INSTALL_LOCAL_LINUX_MIRROR

config MIRROR_MCGROF_LINUS_HTTPS
	bool "HTTPS"
	help
	  If you enable this option then HTTPS will be used as the source
	  of the mirror. The URL is:

	  https://git.kernel.org/pub/scm/linux/kernel/git/mcgrof/linux-next.git

config MIRROR_MCGROF_LINUS_HTTPS_GOOGLE
	bool "HTTPS (Google)"
	help
	  If you enable this option then HTTPS will be used as the source
	  of the mirror and Google URL will be chosen. The URL is:

	  https://kernel.googlesource.com/pub/scm/linux/kernel/git/mcgrof/linux-next.git

config MIRROR_MCGROF_LINUS_GIT
	bool "Git"
	depends on MIRROR_GIT_WORKS
	help
	  If you enable this option then Git protocol will be used as the
	  source of the mirror. The URL is:

	  git://git.kernel.org/pub/scm/linux/kernel/git/mcgrof/linux-next.git

endchoice

config MIRROR_MCGROF_LINUS_URL
	string
	output yaml
	default DEFAULT_MCGROF_LINUS_HTTPS_URL if MIRROR_MCGROF_LINUS_GIT
	default DEFAULT_MCGROF_LINUS_HTTPS_URL if MIRROR_MCGROF_LINUS_HTTPS
	default DEFAULT_MCGROF_LINUS_HTTPS_GOOGLE_URL if MIRROR_MCGROF_LINUS_HTTPS_GOOGLE

choice
	prompt "Linux modules kernel tree"
	default MIRROR_MODULES_GIT if MIRROR_GIT_WORKS
	default MIRROR_MODULES_HTTPS if !MIRROR_GIT_WORKS
	depends on INSTALL_LOCAL_LINUX_MIRROR

config MIRROR_MODULES_HTTPS
	bool "HTTPS"
	help
	  If you enable this option then HTTPS will be used as the source
	  of the mirror. The URL is:

	  https://git.kernel.org/pub/scm/linux/kernel/git/modules/linux.git

config MIRROR_MODULES_HTTPS_GOOGLE
	bool "HTTPS (Google)"
	help
	  If you enable this option then HTTPS will be used as the source
	  of the mirror and Google URL will be chosen. The URL is:

	  https://kernel.googlesource.com/pub/scm/linux/kernel/git/modules/linux.git

config MIRROR_MODULES_GIT
	bool "Git"
	depends on MIRROR_GIT_WORKS
	help
	  If you enable this option then Git protocol will be used as the
	  source of the mirror. The URL is:

	  git://git.kernel.org/pub/scm/linux/kernel/git/modules/linux.git

endchoice

config MIRROR_MODULES_URL
	string
	output yaml
	default DEFAULT_MODULES_GIT if MIRROR_MODULES_GIT
	default DEFAULT_MODULES_HTTPS_GIT if MIRROR_MODULES_HTTPS
	default DEFAULT_MODULES_HTTPS_GOOGLE_URL if MIRROR_MODULES_HTTPS_GOOGLE

choice
	prompt "Linux stable mirror protocol/source"
	default MIRROR_STABLE_GIT if MIRROR_GIT_WORKS
	default MIRROR_STABLE_HTTPS if !MIRROR_GIT_WORKS
	depends on INSTALL_LOCAL_LINUX_MIRROR

config MIRROR_STABLE_HTTPS
	bool "HTTPS"
	help
	  If you enable this option then HTTPS will be used as the source
	  of the mirror. The URL is:

	  https://git.kernel.org/pub/scm/linux/kernel/git/stable/linux.git

config MIRROR_STABLE_HTTPS_GOOGLE
	bool "HTTPS (Google)"
	help
	  If you enable this option then HTTPS will be used as the source
	  of the mirror and Google URL will be chosen. The URL is:

          https://kernel.googlesource.com/pub/scm/linux/kernel/git/stable/linux.git

config MIRROR_STABLE_GIT
	bool "Git"
	depends on MIRROR_GIT_WORKS
	help
	  If you enable this option then Git protocol will be used as the
	  source of the mirror. The URL is:

	  git://git.kernel.org/pub/scm/linux/kernel/git/stable/linux.git

endchoice

config MIRROR_STABLE_URL
	string
	output yaml
	default DEFAULT_STABLE_GIT_URL if MIRROR_STABLE_GIT
	default DEFAULT_STABLE_HTTPS_URL if MIRROR_STABLE_HTTPS
	default DEFAULT_STABLE_HTTPS_GOOGLE_URL if MIRROR_STABLE_HTTPS_GOOGLE

choice
	prompt "Linux stable rc mirror protocol/source"
	default MIRROR_STABLE_RC_GIT if MIRROR_GIT_WORKS
	default MIRROR_STABLE_RC_HTTPS if !MIRROR_GIT_WORKS
	depends on INSTALL_LOCAL_LINUX_MIRROR

config MIRROR_STABLE_RC_HTTPS
	bool "HTTPS (kernel.org)"
	help
	  If you enable this option then the mirror will use HTTPS to access
	  the linux-stable-rc repository on git.kernel.org. The full URL is:

	  https://git.kernel.org/pub/scm/linux/kernel/git/stable/linux-stable-rc.git"

config MIRROR_STABLE_RC_HTTPS_GOOGLE
	bool "HTTPS (Google)"
	help
	  If you enable this option then the mirror will use HTTPS to access
	  the linux-stable-rc repository on kernel.googlesource.com The full
	  URL is:

	  https://kernel.googlesource.com/pub/scm/linux/kernel/git/stable/linux-stable-rc.git"

config MIRROR_STABLE_RC_GIT
	bool "Git (kernel.org)"
	depends on MIRROR_GIT_WORKS
	help
	  If you enable this option then the mirror will use the GIT protocol
	  to access the linux-stable-rc repository on git.kernel.org. The
	  full URL is:

	  git://git.kernel.org/pub/scm/linux/kernel/git/stable/linux-stable-rc.git"

endchoice

config MIRROR_STABLE_RC_URL
	string
	output yaml
	default DEFAULT_STABLE_RC_GIT_URL if MIRROR_STABLE_RC_GIT
	default DEFAULT_STABLE_RC_HTTPS_URL if MIRROR_STABLE_RC_HTTPS
	default DEFAULT_STABLE_RC_HTTPS_GOOGLE_URL if MIRROR_STABLE_RC_HTTPS_GOOGLE

choice
	prompt "Linux xfs kernel tree"
	default MIRROR_XFS_GIT if MIRROR_GIT_WORKS
	default MIRROR_XFS_HTTPS if !MIRROR_GIT_WORKS
	depends on INSTALL_LOCAL_LINUX_MIRROR

config MIRROR_XFS_HTTPS
	bool "HTTPS"
	help
	  If you enable this option then HTTPS will be used as the source
	  of the mirror. The URL is:

	  https://git.kernel.org/pub/scm/fs/xfs/xfs-linux.git

config MIRROR_XFS_HTTPS_GOOGLE
	bool "HTTPS (Google)"
	help
	  If you enable this option then HTTPS will be used as the source
	  of the mirror and Google URL will be chosen. The URL is:

	  https://kernel.googlesource.com/pub/scm/fs/xfs/xfs-linux.git

config MIRROR_XFS_GIT
	bool "Git"
	depends on MIRROR_GIT_WORKS
	help
	  If you enable this option then Git protocol will be used as the
	  source of the mirror. The URL is:

	  git://git.kernel.org/pub/scm/fs/xfs/xfs-linux.git

endchoice

config MIRROR_XFS_URL
	string
	output yaml
	default DEFAULT_XFS_GIT if MIRROR_XFS_GIT
	default DEFAULT_XFS_HTTPS_GIT if MIRROR_XFS_HTTPS
	default DEFAULT_XFS_HTTPS_GOOGLE_URL if MIRROR_XFS_HTTPS_GOOGLE

choice
	prompt "QEMU mirror protocol/source"
	default MIRROR_QEMU_HTTPS_GITLAB
	depends on INSTALL_LOCAL_LINUX_MIRROR

config MIRROR_QEMU_HTTPS_GITLAB
	bool "HTTPS (GitLab)"
	help
	  If you enable this option then GitLab HTTPS will be used as the
	  source of the mirror. The URL is:

	  https://gitlab.com/qemu-project/qemu.git

config MIRROR_QEMU_SSH_GITLAB
	bool "SSH (GitLab)"
	help
	  If you enable this option then GitLab SSH will be used as the source
	  of the mirror. The URL is:

	  ssh://git@gitlab.com:qemu-project/qemu.git

config MIRROR_QEMU_HTTPS_GITHUB
	bool "HTTPS (GitHub)"
	help
	  If you enable this option then GitHub HTTPS will be used as the
	  source of the mirror. The URL is:

	  https://github.com/qemu/qemu.git

config MIRROR_QEMU_SSH_GITHUB
	bool "SSH (GitHub)"
	help
	  If you enable this option then GitHub SSH will be used as the source
	  of the mirror. The URL is:

	  ssh://git@github.com:qemu/qemu.git
endchoice

config MIRROR_QEMU_URL
	string
	output yaml
	default DEFAULT_QEMU_GITHUB_HTTPS_URL if MIRROR_QEMU_HTTPS_GITHUB
	default DEFAULT_QEMU_GITHUB_SSH_URL if MIRROR_QEMU_SSH_GITHUB
	default DEFAULT_QEMU_GITLAB_HTTPS_URL if MIRROR_QEMU_HTTPS_GITLAB
	default DEFAULT_QEMU_GITLAB_SSH_URL if MIRROR_QEMU_SSH_GITLAB

choice
	prompt "QEMU jic23 mirror protocol/source"
	default MIRROR_QEMU_JIC23_HTTPS_GITLAB
	depends on INSTALL_LOCAL_LINUX_MIRROR

config MIRROR_QEMU_JIC23_HTTPS_GITLAB
	bool "HTTPS (GitLab)"
	help
	  If you enable this option then GitLab HTTPS will be used as the
	  source of the mirror. The URL is:

	  https://gitlab.com/jic23/qemu.git

config MIRROR_QEMU_JIC23_SSH_GITLAB
	bool "SSH (GitLab)"
	help
	  If you enable this option then GitLab SSH will be used as the source
	  of the mirror. The URL is:

	  ssh://git@gitlab.com:jic23/qemu.git

config MIRROR_QEMU_JIC23_HTTPS_GITHUB
	bool "HTTPS (GitHub)"
	help
	  If you enable this option then GitHub HTTPS will be used as the
	  source of the mirror. The URL is:

	  https://github.com/jic23/qemu.git

config MIRROR_QEMU_JIC23_SSH_GITHUB
	bool "SSH (GitHub)"
	help
	  If you enable this option then GitHub SSH will be used as the source
	  of the mirror. The URL is:

	  ssh://git@github.com:jic23/qemu.git
endchoice

config MIRROR_QEMU_JIC23_URL
	string
	output yaml
	default DEFAULT_QEMU_JIC23_GITHUB_HTTPS_URL if MIRROR_QEMU_JIC23_HTTPS_GITHUB
	default DEFAULT_QEMU_JIC23_GITHUB_SSH_URL if MIRROR_QEMU_JIC23_SSH_GITHUB
	default DEFAULT_QEMU_JIC23_GITLAB_HTTPS_URL if MIRROR_QEMU_JIC23_HTTPS_GITLAB
	default DEFAULT_QEMU_JIC23_GITLAB_SSH_URL if MIRROR_QEMU_JIC23_SSH_GITLAB

choice
	prompt "Tools - xfstests-dev.git mirror protocol/source"
	default MIRROR_FSTESTS_GIT if MIRROR_GIT_WORKS
	default MIRROR_FSTESTS_HTTPS if !MIRROR_GIT_WORKS
	depends on INSTALL_LOCAL_LINUX_MIRROR

config MIRROR_FSTESTS_GIT
	bool "Git"
	depends on MIRROR_GIT_WORKS
	help
	  If you enable this option then git:// protocol will be used as the
	  source of the mirror. The URL is:

	  git://git.kernel.org/pub/scm/fs/xfs/xfstests-dev.git

config MIRROR_FSTESTS_HTTPS
	bool "HTTPS"
	help
	  If you enable this option then GitLab HTTPS will be used as the
	  source of the mirror. The URL is:

	  https://git.kernel.org/pub/scm/fs/xfs/xfstests-dev.git

config MIRROR_FSTESTS_HTTPS_GOOGLE
	bool "HTTPS (Google)"
	help
	  If you enable this option then Google HTTPS will be used as the source
	  of the mirror. The URL is:

	  https://kernel.googlesource.com/pub/scm/fs/xfs/xfstests-dev.git

endchoice

config MIRROR_FSTESTS_URL
	string
	output yaml
	default DEFAULT_FSTESTS_GIT_URL if MIRROR_FSTESTS_GIT
	default DEFAULT_FSTESTS_HTTPS_URL if MIRROR_FSTESTS_HTTPS
	default DEFAULT_FSTESTS_GOOGLE_HTTPS_URL if MIRROR_FSTESTS_HTTPS_GOOGLE

choice
	prompt "Tools - kdevops/fstests.git mirror protocol/source"
	default MIRROR_KDEVOPS_FSTESTS_HTTPS_GITHUB
	default MIRROR_KDEVOPS_FSTESTS_HTTPS_GITLAB
	depends on INSTALL_LOCAL_LINUX_MIRROR

config MIRROR_KDEVOPS_FSTESTS_HTTPS_GITHUB
	bool "HTTPS (GitHub)"
	help
	  If you enable this option then GitHub HTTPS will be used as the
	  source of the mirror. The URL is:

	  https://github.com/linux-kdevops/fstests.git

config MIRROR_KDEVOPS_FSTESTS_HTTPS_GITLAB
	bool "HTTPS (GitLab)"
	help
	  If you enable this option then GitLab HTTPS will be used as the
	  source of the mirror. The URL is:

	  https://gitlab.com/linux-kdevops/fstests.git

endchoice

config MIRROR_KDEVOPS_FSTESTS_URL
	string
	output yaml
	default DEFAULT_FSTESTS_KDEVOPS_GITHUB_HTTPS_URL if MIRROR_KDEVOPS_FSTESTS_HTTPS_GITHUB
	default DEFAULT_FSTESTS_KDEVOPS_GITLAB_HTTPS_URL if MIRROR_KDEVOPS_FSTESTS_HTTPS_GITLAB

choice
	prompt "Linux vfs kernel tree"
	default MIRROR_VFS_GIT if MIRROR_GIT_WORKS
	default MIRROR_VFS_HTTPS if !MIRROR_GIT_WORKS
	depends on INSTALL_LOCAL_LINUX_MIRROR

config MIRROR_VFS_HTTPS
	bool "HTTPS"
	help
	  If you enable this option then HTTPS will be used as the source
	  of the mirror. The URL is:

	  https://git.kernel.org/pub/scm/linux/kernel/git/vfs/vfs.git

config MIRROR_VFS_HTTPS_GOOGLE
	bool "HTTPS (Google)"
	help
	  If you enable this option then HTTPS will be used as the source
	  of the mirror and Google URL will be chosen. The URL is:

	  https://kernel.googlesource.com/pub/scm/linux/kernel/git/vfs/vfs.git

config MIRROR_VFS_GIT
	bool "Git"
	depends on MIRROR_GIT_WORKS
	help
	  If you enable this option then Git protocol will be used as the
	  source of the mirror. The URL is:

	  git://git.kernel.org/pub/scm/linux/kernel/git/vfs/vfs.git

endchoice

config MIRROR_VFS_URL
	string
	output yaml
	default DEFAULT_VFS_GIT_URL if MIRROR_VFS_GIT
	default DEFAULT_VFS_HTTPS_URL if MIRROR_VFS_HTTPS
	default DEFAULT_VFS_HTTPS_GOOGLE_URL if MIRROR_VFS_HTTPS_GOOGLE

config MIRROR_BLKTESTS_URL
	string
	output yaml
	default DEFAULT_BLKTESTS_URL

config MIRROR_XFSPROGS_URL
	string
	output yaml
	default DEFAULT_XFSPROGS_URL

choice
	prompt "Tools - mmtests.git mirror protocol/source"
	default MIRROR_MMTESTS_HTTPS_GITHUB
	depends on INSTALL_LOCAL_LINUX_MIRROR

config MIRROR_MMTESTS_HTTPS_GITHUB
	bool "HTTPS (GitHub)"
	help
	  If you enable this option then GitHub HTTPS will be used as the
	  source of the mirror. The URL is:

	  https://github.com/gormanm/mmtests.git

endchoice

config MIRROR_MMTESTS_URL
	string
	output yaml
	default DEFAULT_MMTESTS_GITHUB_HTTPS_URL if MIRROR_MMTESTS_HTTPS_GITHUB

config INSTALL_NIX_CACHE_MIRROR
	bool "Install Nix binary cache mirror"
	output yaml
	depends on INSTALL_LOCAL_LINUX_MIRROR
	help
	  Enable this to set up a local Nix binary cache mirror for all guests.
	  This will significantly speed up NixOS VM builds by caching downloaded
	  packages locally.

	  When enabled, this creates:
	  - A local Nix binary cache at /mirror/nix-cache/
	  - An nginx-based cache server on port 8080
	  - Automatic synchronization from cache.nixos.org

	  This saves bandwidth and speeds up NixOS builds dramatically as the
	  initial build requires downloading ~679 packages (685MB).

	  The cache will be available to all VMs and systems in your network
	  at: http://mirror-host:8080/

choice
	prompt "Nix cache mirror source"
	default MIRROR_NIX_CACHE_NIXOS_ORG
	depends on INSTALL_NIX_CACHE_MIRROR

config MIRROR_NIX_CACHE_NIXOS_ORG
	bool "cache.nixos.org (official)"
	help
	  Use the official Nix binary cache at cache.nixos.org as the upstream
	  source for the mirror.

config MIRROR_NIX_CACHE_NIXOS_ORG_FALLBACK
	bool "cache.nixos.org with fastly CDN fallback"
	help
	  Use cache.nixos.org with additional fastly CDN endpoints as fallbacks
	  for better reliability and performance.

endchoice

config MIRROR_NIX_CACHE_UPSTREAM_URL
	string
	output yaml
	default "https://cache.nixos.org" if MIRROR_NIX_CACHE_NIXOS_ORG
	default "https://cache.nixos.org https://nixos.cachix.org" if MIRROR_NIX_CACHE_NIXOS_ORG_FALLBACK

config NIX_CACHE_MIRROR_PORT
	int "Nix cache mirror nginx port"
	output yaml
	default 8080
	depends on INSTALL_NIX_CACHE_MIRROR
	help
	  The port for the local nginx server that will serve the Nix binary cache.
	  Default is 8080. Ensure this port is available and not blocked by firewall.

config NIX_CACHE_MIRROR_PATH
	string "Nix cache mirror storage path"
	output yaml
	default "/mirror/nix-cache"
	depends on INSTALL_NIX_CACHE_MIRROR
	help
	  Local filesystem path where the Nix binary cache will be stored.
	  This should be on a filesystem with sufficient space as the cache
	  can grow to several GB over time.

config ENABLE_DOCKER_MIRROR
	bool "Enable Docker registry mirror support"
	default $(shell, scripts/check_docker_mirror.sh ENABLE_DOCKER_MIRROR)
	help
	  Enable Docker registry mirror support to cache container images locally.
	  This option enables the Docker mirror infrastructure if /mirror/docker/
	  directory exists.

config USE_DOCKER_MIRROR
	bool "Use Docker registry mirror"
	output yaml
	default $(shell, scripts/check_docker_mirror.sh USE_DOCKER_MIRROR)
	depends on ENABLE_DOCKER_MIRROR
	help
	  Automatically use the Docker registry mirror if it's running and accessible.
	  This will configure workflows to use localhost:5000 as the registry mirror.

config INSTALL_DOCKER_MIRROR
	bool "Install Docker registry mirror"
	output yaml
	default $(shell, scripts/check_docker_mirror.sh INSTALL_DOCKER_MIRROR)
	depends on ENABLE_DOCKER_MIRROR
	help
	  Enable this to set up a local Docker registry mirror for all guests
	  and workflows that use Docker containers. This will significantly
	  speed up container deployments by caching Docker images locally.

	  When enabled, this creates:
	  - A local Docker registry mirror at /mirror/docker/
	  - A Docker registry server on port 5000 (configurable)
	  - Automatic caching of pulled images
	  - Support for offline operation with cached images

	  This is particularly useful for workflows that use Docker containers
	  such as:
	  - MinIO object storage
	  - Milvus vector database
	  - AI/ML workflows with containerized services
	  - Database benchmarking with sysbench

	  The mirror will be available at: http://localhost:5000/

config DOCKER_MIRROR_PORT
	int "Docker registry mirror port"
	output yaml
	default 5000
	depends on INSTALL_DOCKER_MIRROR
	help
	  The port for the local Docker registry mirror server.
	  Default is 5000. Ensure this port is available and not blocked by firewall.

config DOCKER_MIRROR_PATH
	string "Docker registry mirror storage path"
	output yaml
	default "/mirror/docker"
	depends on INSTALL_DOCKER_MIRROR
	help
	  Local filesystem path where the Docker registry mirror will store images.
	  This should be on a filesystem with sufficient space as Docker images
	  can consume significant storage (several GB to tens of GB depending on
	  the workflows you use).

config DOCKER_MIRROR_PULL_THROUGH_CACHE
	bool "Enable pull-through cache mode"
	output yaml
	default y
	depends on INSTALL_DOCKER_MIRROR
	help
	  Enable pull-through cache mode for the Docker registry mirror.
	  When enabled, the registry will automatically cache images as they
	  are pulled through it, acting as a transparent proxy to Docker Hub
	  and other registries.

	  This is the recommended mode as it requires no changes to image
	  names and transparently caches all pulled images.

menuconfig DOCKER_MIRROR_PRELOAD_IMAGES
	bool "Preload Docker images for offline operation"
	default y
	depends on INSTALL_DOCKER_MIRROR
	help
	  Enable this to preload specific Docker images into the registry mirror
	  for offline operation. This ensures that commonly used images are
	  available even without internet connectivity.

	  When enabled, the selected images will be pulled and cached during
	  the mirror setup process.

if DOCKER_MIRROR_PRELOAD_IMAGES

config DOCKER_MIRROR_PRELOAD_MINIO
	bool "Preload MinIO container image"
	output yaml
	default y
	help
	  Preload the MinIO object storage container image.
	  Image: quay.io/minio/minio:latest

config DOCKER_MIRROR_MINIO_IMAGE
	string "MinIO container image"
	output yaml
	default "quay.io/minio/minio:latest"
	depends on DOCKER_MIRROR_PRELOAD_MINIO
	help
	  The MinIO container image to preload into the Docker registry mirror.

config DOCKER_MIRROR_PRELOAD_MILVUS
	bool "Preload Milvus vector database images"
	output yaml
	default y
	help
	  Preload the Milvus vector database container images including:
	  - Milvus standalone server
	  - etcd (for metadata storage)
	  - MinIO (for object storage)

config DOCKER_MIRROR_MILVUS_IMAGE
	string "Milvus container image"
	output yaml
	default "milvusdb/milvus:v2.4.5"
	depends on DOCKER_MIRROR_PRELOAD_MILVUS
	help
	  The Milvus standalone container image to preload.

config DOCKER_MIRROR_MILVUS_ETCD_IMAGE
	string "Milvus etcd container image"
	output yaml
	default "quay.io/coreos/etcd:v3.5.5"
	depends on DOCKER_MIRROR_PRELOAD_MILVUS
	help
	  The etcd container image used by Milvus for metadata storage.

config DOCKER_MIRROR_MILVUS_MINIO_IMAGE
	string "Milvus MinIO container image"
	output yaml
	default "minio/minio:RELEASE.2023-03-20T20-16-18Z"
	depends on DOCKER_MIRROR_PRELOAD_MILVUS
	help
	  The MinIO container image used by Milvus for object storage.

config DOCKER_MIRROR_PRELOAD_POSTGRES
	bool "Preload PostgreSQL container image"
	output yaml
	default y
	help
	  Preload the PostgreSQL database container image for database
	  benchmarking workflows.

config DOCKER_MIRROR_POSTGRES_IMAGE
	string "PostgreSQL container image"
	output yaml
	default "postgres:16-alpine"
	depends on DOCKER_MIRROR_PRELOAD_POSTGRES
	help
	  The PostgreSQL container image to preload.

config DOCKER_MIRROR_PRELOAD_MYSQL
	bool "Preload MySQL container image"
	output yaml
	default y
	help
	  Preload the MySQL database container image for database
	  benchmarking workflows.

config DOCKER_MIRROR_MYSQL_IMAGE
	string "MySQL container image"
	output yaml
	default "mysql:8.0"
	depends on DOCKER_MIRROR_PRELOAD_MYSQL
	help
	  The MySQL container image to preload.

config DOCKER_MIRROR_PRELOAD_MARIADB
	bool "Preload MariaDB container image"
	output yaml
	default y
	help
	  Preload the MariaDB database container image for database
	  benchmarking workflows.

config DOCKER_MIRROR_MARIADB_IMAGE
	string "MariaDB container image"
	output yaml
	default "mariadb:11"
	depends on DOCKER_MIRROR_PRELOAD_MARIADB
	help
	  The MariaDB container image to preload.

config DOCKER_MIRROR_PRELOAD_REDIS
	bool "Preload Redis container image"
	output yaml
	default y
	help
	  Preload the Redis in-memory database container image.

config DOCKER_MIRROR_REDIS_IMAGE
	string "Redis container image"
	output yaml
	default "redis:7-alpine"
	depends on DOCKER_MIRROR_PRELOAD_REDIS
	help
	  The Redis container image to preload.

config DOCKER_MIRROR_PRELOAD_ELASTICSEARCH
	bool "Preload Elasticsearch container image"
	output yaml
	default y
	help
	  Preload the Elasticsearch search engine container image.

config DOCKER_MIRROR_ELASTICSEARCH_IMAGE
	string "Elasticsearch container image"
	output yaml
	default "docker.elastic.co/elasticsearch/elasticsearch:8.14.0"
	depends on DOCKER_MIRROR_PRELOAD_ELASTICSEARCH
	help
	  The Elasticsearch container image to preload.

config DOCKER_MIRROR_PRELOAD_VLLM
	bool "Preload vLLM container images"
	output yaml
	default y
	help
	  Preload vLLM (Large Language Model serving) container images.

config DOCKER_MIRROR_VLLM_IMAGE
	string "vLLM container image"
	output yaml
	default "vllm/vllm-openai:latest"
	depends on DOCKER_MIRROR_PRELOAD_VLLM
	help
	  The vLLM container image for serving large language models.

config DOCKER_MIRROR_VLLM_CPU_IMAGE
	string "vLLM CPU container image"
	output yaml
	default "openeuler/vllm-cpu:latest"
	depends on DOCKER_MIRROR_PRELOAD_VLLM
	help
	  The vLLM CPU-optimized container image for serving large language models
	  on CPU-only systems.

config DOCKER_MIRROR_PRELOAD_CUSTOM
	bool "Preload custom Docker images"
	output yaml
	default n
	help
	  Enable this to specify additional custom Docker images to preload
	  into the registry mirror.

config DOCKER_MIRROR_CUSTOM_IMAGES
	string "Custom Docker images (space-separated)"
	output yaml
	default ""
	depends on DOCKER_MIRROR_PRELOAD_CUSTOM
	help
	  Space-separated list of additional Docker images to preload.
	  Example: "nginx:alpine ubuntu:22.04 python:3.11-slim"

	  These images will be pulled and cached during mirror setup.

endif # DOCKER_MIRROR_PRELOAD_IMAGES

# Docker mirror 9P mount configuration
# Enable 9P mount for Docker registry mirror to provide high-performance
# access to cached Docker images from VMs
config DOCKER_MIRROR_9P
	bool "Enable Docker mirror 9P mount"
	output yaml
	depends on LIBVIRT && !GUESTFS_LACKS_9P
	default $(shell, test -d /mirror/docker && echo y || echo n)
	help
	  Enable 9P filesystem mount for Docker registry mirror access.
	  This provides high-performance access to the Docker mirror
	  cache from guest VMs, similar to the Linux build 9P mount.

	  This option uses intelligent heuristics to auto-detect when
	  Docker mirror 9P should be enabled:
	  - Automatically enabled if /mirror/docker directory exists
	  - Works with any workflow that uses Docker containers
	  - Provides transparent, high-performance access to cached images

	  When enabled, the /mirror/docker directory on the host will
	  be mounted as a 9P filesystem in guest VMs, allowing direct
	  access to cached Docker images and registry data.

if DOCKER_MIRROR_9P

menu "Docker mirror 9P configuration"

config DOCKER_MIRROR_9P_HOST_PATH
	string "Docker mirror 9P host path"
	output yaml
	default "/mirror/docker"
	help
	  The host directory path that contains the Docker registry mirror
	  data. This directory will be mounted via 9P filesystem in guest VMs.

	  This should match the directory where your Docker registry mirror
	  stores its cached data and configuration.

config DOCKER_MIRROR_9P_MOUNT_TAG
	string "Docker mirror 9P mount tag"
	output yaml
	default "kdevops_9p_docker_mirror"
	help
	  The 9P mount tag used to identify this mount in the guest VM.
	  This tag is used by the guest to mount the shared directory.

config DOCKER_MIRROR_9P_FSDEV
	string "Docker mirror 9P fsdev ID"
	output yaml
	default "kdevops_docker_mirror_fsdev"
	help
	  The filesystem device ID used by libvirt for the 9P mount.
	  This must be unique across all 9P mounts in the VM.

config DOCKER_MIRROR_9P_SECURITY_MODEL
	string "Docker mirror 9P security model"
	output yaml
	default "none"
	help
	  The security model to use for the 9P mount.
	  Options: none, passthrough, mapped, mapped-xattr, mapped-file

config DOCKER_MIRROR_9P_DRIVER
	string "Docker mirror 9P driver"
	output yaml
	default "virtio-9p-pci"
	help
	  The 9P driver to use for the mount.

endmenu

endif # DOCKER_MIRROR_9P

endif # ENABLE_LOCAL_LINUX_MIRROR
endif # TERRAFORM
```
