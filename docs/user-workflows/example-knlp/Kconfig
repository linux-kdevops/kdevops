## kconfigs/workflows/Kconfig.bootlinux
```kconfig
# SPDX-License-Identifier: copyleft-next-0.3.1

config HAVE_BOOTLINUX_TREE_LINUS_USER_REFS
	bool
	default $(shell, scripts/check_file_empty.sh workflows/linux/refs/user/Kconfig.linus)

config HAVE_BOOTLINUX_TREE_NEXT_USER_REFS
	bool
	default $(shell, scripts/check_file_empty.sh workflows/linux/refs/user/Kconfig.next)

config HAVE_BOOTLINUX_TREE_STABLE_USER_REFS
	bool
	default $(shell, scripts/check_file_empty.sh workflows/linux/refs/user/Kconfig.stable)

config HAVE_BOOTLINUX_TREE_MCGROF_LINUS_USER_REFS
	bool
	default $(shell, scripts/check_file_empty.sh workflows/linux/refs/user/Kconfig.mcgrof-linus)

config HAVE_BOOTLINUX_TREE_MCGROF_NEXT_USER_REFS
	bool
	default $(shell, scripts/check_file_empty.sh workflows/linux/refs/user/Kconfig.mcgrof-next)

config HAVE_BOOTLINUX_TREE_BTRFS_DEVEL_USER_REFS
	bool
	default $(shell, scripts/check_file_empty.sh workflows/linux/refs/user/Kconfig.btrfs-devel)

config HAVE_BOOTLINUX_TREE_CEL_LINUX_USER_REFS
	bool
	default $(shell, scripts/check_file_empty.sh workflows/linux/refs/user/Kconfig.cel-linux)

config HAVE_BOOTLINUX_TREE_JLAYTON_LINUX_USER_REFS
	bool
	default $(shell, scripts/check_file_empty.sh workflows/linux/refs/user/Kconfig.jlayton-linux)

config HAVE_BOOTLINUX_TREE_KDEVOPS_LINUS_USER_REFS
	bool
	default $(shell, scripts/check_file_empty.sh workflows/linux/refs/user/Kconfig.kdevops-linus)
```

## kconfigs/workflows/Kconfig.demo
```kconfig
# SPDX-License-Identifier: copyleft-next-0.3.1
source "workflows/demos/reboot-limit/Kconfig"
```

## kconfigs/workflows/Kconfig.shared
```kconfig
menu "Shared workflow data partition"
source "kconfigs/workflows/Kconfig.data_partition"
endmenu

config WORKFLOW_RESULTS_WIPE_NO_PROMPT
	bool "Skip the pre-baseline results-wipe confirmation prompt"
	output yaml
	default n
	help
	  Workflows that share their per-(VM, kernel) results back to
	  the controller (currently fstests on the qsu backend; the
	  same shape is planned for blktests and the other qsu-driven
	  workflows) prompt once before wiping the prior contents of
	  workflows/<workflow>/results/<vm>/<kernel>/ at the start of
	  each baseline run. The prompt is a guard against losing
	  un-archived results when re-running on the same kernel, but
	  it also blocks unattended runs (CI loops, overnight A/B
	  sweeps, scripted reruns).

	  Setting this to y skips the prompt for every workflow that
	  honors it; the wipe still runs, just without the confirmation
	  step. Setting it to n keeps the prompt; one-shot bypasses
	  remain available via
	  `--extra-vars workflow_results_wipe_no_prompt=true` for cases
	  where the .config default is n but a single invocation needs
	  to be unattended.

	  Has no effect on workflows that wipe silently today (libvirt
	  fstests, blktests-on-libvirt, and similar) — those paths do
	  not run the confirmation task at all, so the value is ignored
	  there.

config WORKFLOW_XFSPROGS_GIT
	string "The xfsprogs git tree to clone (closure-using backends)"
	output yaml
	default ""
	help
	  Optional. When set on a closure-using backend (today: qsu /
	  qemu-system-units; tomorrow: any backend that builds the
	  guest userland from a Nix overlay), the in-guest xfsprogs
	  package is rebuilt against this source tree instead of the
	  version nixpkgs ships. Mirrors FSTESTS_GIT in shape but
	  scoped at the workflow level because xfsprogs is system
	  userland — every workflow that touches XFS reaches for it
	  (fstests via xfs_io / xfs_repair / xfs_healer / xfs_scrub,
	  blktests via xfs_io for setup, mmtests for mkfs.xfs flag
	  experiments, and the guest itself for mkfs at bringup).

	  Value forms:

	    * a local path  (e.g. /home/user/src/xfsprogs-dev)
	    * an http(s) URL of a git tree
	    * a git+ URL form

	  Use this to pick up xfsprogs features that have not yet
	  reached the nixpkgs release nixpkgs is pinned at — most
	  notably the xfs_healer utility and its bundled
	  xfs_healer@.service / xfs_healer_start.service systemd
	  templates, which live in djwong's xfsprogs-dev for-next
	  branch under healer/ but are not yet in any release tag.

	  The value flows through extra_vars.yaml as
	  workflow_xfsprogs_git, gets rendered into the per-VM
	  flake.nix as the xfsprogs-src flake input, and the per-VM
	  default.nix overrides the nixpkgs xfsprogs derivation's
	  src to that input. Same refresh path that FSTESTS_GIT uses
	  for xfstests applies here for xfsprogs.

	  Leave empty to use whatever xfsprogs nixpkgs has.

	  Has no effect on the libvirt path — that backend installs
	  xfsprogs from distro packages, not the closure.

config WORKFLOW_XFSPROGS_GIT_VERSION
	string "The xfsprogs git tree version (closure-using backends)"
	output yaml
	default "HEAD"
	help
	  Branch, tag, or commit to check out from
	  WORKFLOW_XFSPROGS_GIT. Ignored when WORKFLOW_XFSPROGS_GIT
	  is empty (the nixpkgs default applies).

	  For djwong's xfsprogs-dev for-next branch carrying
	  xfs_healer the value to use is "for-next". Pin a specific
	  commit hash for reproducibility.

config WORKFLOW_KDEVOPS_GIT_SET_BY_CLI
	bool
	select HAVE_CUSTOM_KDEVOPS_GIT
	default $(shell, scripts/check-cli-set-var.sh GUEST_KDEVOPS_REPO)

config WORKFLOW_KDEVOPS_GIT_VERSION_SET_BY_CLI
	bool
	select HAVE_CUSTOM_KDEVOPS_GIT_VERSION
	default $(shell, scripts/check-cli-set-var.sh GUEST_KDEVOPS_REF)

config HAVE_CUSTOM_KDEVOPS_GIT
	bool
	default n

config HAVE_CUSTOM_KDEVOPS_GIT_DATA
	bool
	default n

config HAVE_CUSTOM_KDEVOPS_DIR
	bool
	default n

config WORKFLOW_MAKE_CMD_OVERRIDE
	bool "Override default make command"
	default n
	help
	  We support different workflows which use the make command to build
	  source code on the target systems. You can override here the default
	  make command used to build on the target systems. By default we use:

	    {{ make }} -j{{ ansible_processor_vcpus }}

	  However this is known to not work as expected with containers.
	  The fix is in commit 34db57a47f875d11c4068567b9ec7ace174ec4cf
	  ("introduce fact "ansible_processor_nproc": number of usable
	  vcpus #66569") but it will be a while before we see this propagate.
	  This will be needed for containers. In the meantime you can
	  override the make command with this option.

if WORKFLOW_MAKE_CMD_OVERRIDE

config WORKFLOW_MAKE_CMD
	string "The make command to use when building"
	default "make -j 2" if TERRAFORM_AWS_INSTANCE_M5AD_LARGE
	default "make -j 4" if TERRAFORM_AWS_INSTANCE_M5AD_XLARGE
	default "make -j 8" if TERRAFORM_AWS_INSTANCE_M5AD_2XLARGE
	default "make -j 16" if TERRAFORM_AWS_INSTANCE_M5AD_4XLARGE
	default "make -j 1" if TERRAFORM_AZURE_VM_SIZE_STANDARD_DS1_V2
	default "make -j 4" if TERRAFORM_AZURE_VM_SIZE_STANDARD_DS3_V2
	help
	  The actual make command to use when building Linux. You want to
	  optimize this as per the number of cores you have.

endif

config WORKFLOW_KDEVOPS_GIT_CUSTOM
	bool "Enable custom git tree of kdevops to clone on targets"
	select HAVE_CUSTOM_KDEVOPS_GIT
	help
	  Enable custom kdevops git tree to clone on targets.

if WORKFLOW_KDEVOPS_GIT_CUSTOM

config WORKFLOW_KDEVOPS_GIT
	string "Git tree of kdevops to clone on targets"
	default CUSTOM_KDEVOPS_GIT if HAVE_CUSTOM_KDEVOPS_GIT
	help
	  Some workflows want to also clone a version of kdevops on each target.
	  An example of this is when using the fstests workflow, which carries
	  a set of expunge lists to track known failures. Upon new failures the
	  local expunge list grows, and so a 'git diff' against the kdevops git
	  tree will reveal if there are any regressions against the known
	  baseline.

config WORKFLOW_KDEVOPS_GIT_VERSION
	string "Git tree version (branch/tag/commit) of kdevops to clone on targets"
	default CUSTOM_KDEVOPS_GIT_VERSION if HAVE_CUSTOM_KDEVOPS_GIT_VERSION
	help
	  Specify the verison of the custom kdevops git repository to check out
	  on each target.
endif # WORKFLOW_KDEVOPS_GIT_CUSTOM


if !WORKFLOW_KDEVOPS_GIT_CUSTOM

config HAVE_MIRROR_KDEVOPS
	bool
	depends on USE_LIBVIRT_MIRROR
	default $(shell, scripts/check_mirror_present.sh /mirror/kdevops.git)

config WORKFLOW_KDEVOPS_GIT
	string
	default "https://github.com/linux-kdevops/kdevops.git" if !GIT_ALTERNATIVES && !HAVE_CUSTOM_KDEVOPS_GIT && !WORKFLOW_KDEVOPS_GIT_SET_BY_CLI
	default "https://github.com/linux-kdevops/kdevops.git" if GIT_LINUX_KDEVOPS_GITHUB && !HAVE_MIRROR_KDEVOPS
	default "https://gitlab.com/linux-kdevops/kdevops.git" if GIT_LINUX_KDEVOPS_GITLAB && !HAVE_MIRROR_KDEVOPS
	default $(shell, scripts/append-makefile-vars.sh git:// $(KDEVOPS_DEFAULT_BRIDGE_IP_GUESTFS) /mirror/kdevops.git) if HAVE_MIRROR_KDEVOPS && GUESTFS && !WORKFLOW_KDEVOPS_GIT_SET_BY_CLI
	default $(shell, ./scripts/append-makefile-vars.sh $(GUEST_KDEVOPS_REPO)) if WORKFLOW_KDEVOPS_GIT_SET_BY_CLI
	help
	  Some workflows want to also clone a version of kdevops on each target.
	  An example of this is when using the fstests workflow, which carries
	  a set of expunge lists to track known failures. Upon new failures the
	  local expunge list grows, and so a 'git diff' against the kdevops git
	  tree will reveal if there are any regressions against the known
	  baseline.

config WORKFLOW_KDEVOPS_GIT_VERSION
	string
	default "HEAD" if !WORKFLOW_KDEVOPS_GIT_VERSION_SET_BY_CLI
	default $(shell, ./scripts/append-makefile-vars.sh $(GUEST_KDEVOPS_REF)) if WORKFLOW_KDEVOPS_GIT_VERSION_SET_BY_CLI
	help
	  Specify the verison of the custom kdevops git repository to check out
	  on each target.

endif # !WORKFLOW_KDEVOPS_GIT_CUSTOM

config WORKFLOW_KDEVOPS_GIT_DATA
	string "The destination directory where to clone the git tree"
	default "{{data_path}}/kdevops" if !HAVE_CUSTOM_KDEVOPS_GIT_DATA
	default CUSTOM_KDEVOPS_GIT_DATA if HAVE_CUSTOM_KDEVOPS_GIT_DATA
	help
	  This is the target location of where to clone the above git tree.
	  Note that {{data_path}} corresponds to the location set by the
	  configuration option CONFIG_WORKFLOW_DATA_PATH above.

config WORKFLOW_KDEVOPS_DIR
	string
	default WORKFLOW_KDEVOPS_GIT_DATA if !HAVE_CUSTOM_KDEVOPS_DIR
	default CUSTOM_KDEVOPS_DIR if HAVE_CUSTOM_KDEVOPS_DIR

config WORKFLOW_KOTD_ENABLE
	bool "Enable KOTD - Kernel of the day reving"
	depends on WORKFLOW_LINUX_DISTRO
	default n
	help
	  When doing target testing on a Linux distribution it is often useful
	  to be able to update the distribution kernel to the latest available
	  version for a release. This may be as simple as an update of a package
	  however distributions may also have special repositories designed to
	  be updated more regularly than the general release repository.
	  Enabling this option will add such kotd repository if the distribution
	  had one, and as a last step will try to install the very latest kernel
	  available for the distribution.

	  This may be useful in combination of using a kdevops kernel-ci loop:
	  once steady state has been achieved one can simply update the kernel
	  and re-run the kernel-ci loop to ensure no regressions have been
	  found on the latest kernel.

config HAVE_DISTRO_CUSTOM_KOTD_REPO
	bool "Distro has custom KOTD repo"
	default n
	help
	  Enable this to be able to specify the custom KOTD repo for your Linux
	  distribution.

config CUSTOM_DISTRO_KOTD_REPO
	string "Distribution KOTD repository"
	depends on WORKFLOW_KOTD_ENABLE
	depends on HAVE_DISTRO_CUSTOM_KOTD_REPO
	help
	  The URL of the custom KOTD repo for your Linux distribution.

config CUSTOM_DISTRO_KOTD_REPO_NAME
	string "Distribution KOTD repository name"
	depends on WORKFLOW_KOTD_ENABLE
	depends on HAVE_DISTRO_CUSTOM_KOTD_REPO
	help
	  The name of the custom KOTD repo for your Linux distribution.
```
