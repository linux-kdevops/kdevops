## terraform/Kconfig
```kconfig
if TERRAFORM

menu "Terraform cloud provider configuration"
source "terraform/Kconfig.providers"
endmenu

menu "Terraform ssh configuration"
source "terraform/Kconfig.ssh"
endmenu

config TERRAFORM_PRIVATE_NET
	bool "Add a private network for the guests"
	depends on TERRAFORM_AZURE
	default y
	help
	  This option adds a private network between the various guests
	  on a separate interface from the public network. This is useful
	  if you want to run a workflow that involves communications
	  between the guests. The guests will determine their IPv4 address
	  via DHCP.

config TERRAFORM_PRIVATE_NET_PREFIX
	string "Network prefix for private network"
	default "10.0.3.0"
	depends on TERRAFORM_PRIVATE_NET
	help
	  Network prefix of the private network. It's recommended to use
	  RFC1918 addresses or something that won't conflict with
	  globally-routable addresses.

config TERRAFORM_PRIVATE_NET_MASK
	int "Network mask for private network"
	default 24
	depends on TERRAFORM_PRIVATE_NET
	help
	  Length of the network mask to use for the private network.

choice
	prompt "Infrastructure as Code tool"
	default TERRAFORM_USE_TERRAFORM
	help
	  Choose whether to use Terraform or OpenTofu for infrastructure
	  provisioning. OpenTofu is an open-source fork of Terraform that
	  maintains compatibility with Terraform configurations.

config TERRAFORM_USE_TERRAFORM
	bool "Use Terraform"
	output yaml
	help
	  Use HashiCorp Terraform for infrastructure provisioning.
	  Terraform is the original infrastructure as code tool.

config TERRAFORM_USE_OPENTOFU
	bool "Use OpenTofu"
	output yaml
	help
	  Use OpenTofu for infrastructure provisioning. OpenTofu is an
	  open-source fork of Terraform maintained by the Linux Foundation
	  that provides a community-driven alternative while maintaining
	  compatibility with Terraform configurations.

endchoice

config TERRAFORM_BINARY_PATH
	string "Path to Terraform or OpenTofu binary"
	default "/usr/bin/terraform" if TERRAFORM_USE_TERRAFORM
	default "/usr/local/bin/tofu" if TERRAFORM_USE_OPENTOFU
	output yaml
	help
	  Specify the path to the Terraform or OpenTofu binary. The default
	  is set based on your Infrastructure as Code tool choice above.
	  Override this if your binary is installed in a different location,
	  such as /usr/bin/terraform or /usr/bin/tofu.

endif # TERRAFORM
```

## terraform/Kconfig.providers
```kconfig
choice
	prompt "Choose your cloud provider"
	default TERRAFORM_LAMBDALABS if CLOUD_INITIALIZED
	default TERRAFORM_AWS

config TERRAFORM_GCE
	bool "GCE - Google Cloud Engine"
	depends on TARGET_ARCH_X86_64
	help
	  Enabling this means you are going to use GCE for your cloud solution.

config TERRAFORM_AWS
	bool "AWS - Amazon Web Services"
	depends on TARGET_ARCH_X86_64 || TARGET_ARCH_ARM64
	help
	  Enabling this means you are going to use AWS for your cloud solution.

config TERRAFORM_AZURE
	bool "Azure"
	depends on TARGET_ARCH_X86_64
	select TERRAFORM_PRIVATE_NET
	help
	  Enabling this means you are going to use Azure for your cloud
	  solution. Note that Azure requires a private network for the
	  guests.

config TERRAFORM_OCI
	bool "OCI - Oracle Cloud Infrastructure"
	depends on TARGET_ARCH_X86_64
	help
	  Enabling this means you are going to use OCI for your cloud
	  solution.

config TERRAFORM_OPENSTACK
	bool "OpenStack"
	help
	  Enabling this means you are going to use OpenStack for your cloud
	  solution.

config TERRAFORM_LAMBDALABS
	bool "Lambda Labs"
	depends on TARGET_ARCH_X86_64
	help
	  Enabling this means you are going to use Lambda Labs for your cloud
	  solution. Lambda Labs provides GPU-accelerated instances optimized
	  for machine learning and high-performance computing workloads.

config TERRAFORM_RCLOUD
	bool "rcloud - Local Private Cloud"
	help
	  Enabling this means you are going to use rcloud as your cloud
	  solution. rcloud is a local private cloud that provides a REST API
	  for VM management through libvirt, similar to public cloud providers.

	  This requires a running rcloud server (see defconfig-rcloud).
	  Users can then provision VMs through the rcloud API using the
	  standard Terraform workflow, treating rcloud as a local cloud provider.

endchoice

source "terraform/gce/Kconfig"
source "terraform/aws/Kconfig"
source "terraform/azure/Kconfig"
source "terraform/oci/Kconfig"
source "terraform/openstack/Kconfig"
source "terraform/lambdalabs/Kconfig"
source "terraform/rcloud/Kconfig"
```

## terraform/Kconfig.ssh
```kconfig
config TERRAFORM_SSH_USER_INFER
	bool "Infer the ssh user name"
	default y if !TERRAFORM_LAMBDALABS
	default n if TERRAFORM_LAMBDALABS
	help
	  If enabled and you are running 'make menuconfig' as user sonia,
	  then use "sonia" as the ssh user name.

	  Note: This is automatically disabled for Lambda Labs since they
	  don't support custom SSH users.

config TERRAFORM_SSH_CONFIG_USER
	string "The username to create on the target systems"
	default $(shell, echo $USER) if TERRAFORM_SSH_USER_INFER && !TERRAFORM_LAMBDALABS
	default "ubuntu" if TERRAFORM_LAMBDALABS
	default "admin" if !TERRAFORM_SSH_USER_INFER && !TERRAFORM_LAMBDALABS
	help
	  The SSH username Ansible will use to connect to its target
	  nodes. Generally this username has to match a user that is
	  pre-created when terraform provisions a cloud instance.

config TERRAFORM_SSH_CONFIG_PUBKEY_FILE
	string "File containing Ansible's ssh public key"
	default "~/.ssh/kdevops_terraform_$(shell, echo $(TOPDIR_PATH) | sha256sum | cut -c1-8).pub"
	help
	  The filename of the file containing an ssh public key
	  Ansible is to use to manage its target nodes. The
	  matching private key should be located in a file using
	  the same basename (without the ".pub").

	  The filename includes an 8-character hash of the current
	  directory path, allowing multiple kdevops installations to
	  use separate SSH keys without conflicts.

config TERRAFORM_SSH_CONFIG_GENKEY
	bool "Should we create a new random key for you?"
	default y
	help
	  If enabled we will create a new ssh key for you, to be used to log in
	  to the systems created by terraform. If the file already exists we
	  won't overwrite to it, uness you enable the next option.

	  Enabling this is highly encouraged, given the security concerns of
	  old development keys lingering around for too long. Development
	  systems aren't always on the most trusted systems, and since the
	  target systems are ephemeral, if you use a key you typically use
	  to log in to more important systems you are putting that key at
	  risk. By encouraging the ssh keys to be just as ephemeral as the
	  development systems created, we we ensuring there is no leakage of
	  valuable ssh keys.

	  You are encouraged to be running haveged on your local system.

if TERRAFORM_SSH_CONFIG_GENKEY

config TERRAFORM_SSH_CONFIG_GENKEY_OVERWRITE
	bool "Should we destroy any existing key if the file already exists?"
	default y
	help
	  If enabled we will destroy your old key if it existed. This is
	  highly encouraged. You don't want to keep old keys around forever
	  for all your development ephemeral systems.

config TERRAFORM_SSH_CONFIG_GENKEY_EMPTY_PASSPHRASE
	bool "Should we create the key with an empty passphrase?"
	default y
	help
	  If enabled your ssh key will not have an associated passphrase with
	  it. This is fine if you are just using ephemeral development systems.

endif # TERRAFORM_SSH_CONFIG_GENKEY
```

## terraform/aws/Kconfig
```kconfig
# AWS provider configuration
#
# This file sources static wrapper files which in turn source
# dynamically generated Kconfig menu data. Run 'make cloud-config-aws'
# to populate Kconfig.*.generated with current AWS resource information.

if TERRAFORM_AWS

menu "Resource Location"
source "terraform/aws/kconfigs/Kconfig.location"
endmenu
menu "Compute"
source "terraform/aws/kconfigs/Kconfig.instance"
source "terraform/aws/kconfigs/Kconfig.ami"
endmenu
menu "Storage"
source "terraform/aws/kconfigs/Kconfig.storage"
endmenu
menu "Identity & Access"
source "terraform/aws/kconfigs/Kconfig.identity"
endmenu

endif # TERRAFORM_AWS
```

## terraform/aws/kconfigs/Kconfig.ami
```kconfig
# AWS AMI (Amazon Machine Image) configuration
#
# This file is a static wrapper that sources dynamically generated
# AMI and distribution choices. The generated content is created by
# running 'make cloud-config-aws'.
#
# Pattern: This follows the Lambda Labs approach where static wrapper
# files (tracked in git) source .generated files (ignored by git).

# Source the generated AMI configuration
# If the file doesn't exist yet, Kconfig will silently skip it
source "terraform/aws/kconfigs/Kconfig.ami.generated"
```

## terraform/aws/kconfigs/Kconfig.compute
```kconfig
choice
	prompt "Linux distribution"
	default TERRAFORM_AWS_DISTRO_DEBIAN
	help
	  Select a popular Linux distribution to install on your
	  instances, or use the "Custom AMI image" selection to
	  choose an image that is off the beaten path.

config TERRAFORM_AWS_DISTRO_AMAZON
	bool "Amazon Linux"

config TERRAFORM_AWS_DISTRO_DEBIAN
	bool "Debian"

config TERRAFORM_AWS_DISTRO_FEDORA
	bool "Fedora Core"

config TERRAFORM_AWS_DISTRO_RHEL
	bool "Red Hat Enterprise Linux"

config TERRAFORM_AWS_DISTRO_SLES
	bool "Suse Linux Enterprise Server"

config TERRAFORM_AWS_DISTRO_CUSTOM
	bool "Custom AMI image"

endchoice

config TERRAFORM_AWS_AMI_ARCH
	string
	output yaml
	default "x86_64" if TARGET_ARCH_X86_64
	default "arm64" if TARGET_ARCH_ARM64

source "terraform/aws/kconfigs/distros/Kconfig.amazon"
source "terraform/aws/kconfigs/distros/Kconfig.debian"
source "terraform/aws/kconfigs/distros/Kconfig.fedora"
source "terraform/aws/kconfigs/distros/Kconfig.rhel"
source "terraform/aws/kconfigs/distros/Kconfig.sles"
source "terraform/aws/kconfigs/distros/Kconfig.custom"
```

## terraform/aws/kconfigs/Kconfig.gpu-amis.static
```kconfig
# GPU-optimized AMIs (default - AWS CLI not available)

# GPU AMI Override - only shown for GPU instances
config TERRAFORM_AWS_USE_GPU_AMI
    bool "Use GPU-optimized AMI instead of standard distribution"
    depends on TERRAFORM_AWS_IS_GPU_INSTANCE
    output yaml
    default n
    help
      Enable this to use a GPU-optimized AMI with pre-installed NVIDIA drivers,
      CUDA, and ML frameworks instead of the standard distribution AMI.
      Note: AWS CLI is not available, showing default options.

if TERRAFORM_AWS_USE_GPU_AMI

choice
    prompt "GPU-optimized AMI selection"
    default TERRAFORM_AWS_GPU_AMI_DEEP_LEARNING
    depends on TERRAFORM_AWS_IS_GPU_INSTANCE
    help
      Select which GPU-optimized AMI to use for your GPU instance.

config TERRAFORM_AWS_GPU_AMI_DEEP_LEARNING
    bool "AWS Deep Learning AMI (Ubuntu 22.04)"
    help
      Pre-configured with NVIDIA drivers, CUDA, and ML frameworks.

config TERRAFORM_AWS_GPU_AMI_CUSTOM
    bool "Custom GPU AMI"

endchoice

if TERRAFORM_AWS_GPU_AMI_DEEP_LEARNING

config TERRAFORM_AWS_GPU_AMI_NAME
    string
    output yaml
    default "Deep Learning OSS Nvidia Driver AMI GPU PyTorch*Ubuntu 22.04*"

config TERRAFORM_AWS_GPU_AMI_OWNER
    string
    output yaml
    default "amazon"

endif # TERRAFORM_AWS_GPU_AMI_DEEP_LEARNING

if TERRAFORM_AWS_GPU_AMI_CUSTOM

config TERRAFORM_AWS_GPU_AMI_ID
    string "Custom GPU AMI ID"
    output yaml
    help
      Specify the AMI ID for your custom GPU image.

endif # TERRAFORM_AWS_GPU_AMI_CUSTOM

endif # TERRAFORM_AWS_USE_GPU_AMI

# GPU instance detection (static)
config TERRAFORM_AWS_IS_GPU_INSTANCE
    bool
    output yaml
    default y if TERRAFORM_AWS_INSTANCE_TYPE_G6E
    default y if TERRAFORM_AWS_INSTANCE_TYPE_G6
    default y if TERRAFORM_AWS_INSTANCE_TYPE_G5
    default y if TERRAFORM_AWS_INSTANCE_TYPE_G5G
    default y if TERRAFORM_AWS_INSTANCE_TYPE_G4DN
    default y if TERRAFORM_AWS_INSTANCE_TYPE_G4AD
    default y if TERRAFORM_AWS_INSTANCE_TYPE_P5
    default y if TERRAFORM_AWS_INSTANCE_TYPE_P5EN
    default y if TERRAFORM_AWS_INSTANCE_TYPE_P4D
    default y if TERRAFORM_AWS_INSTANCE_TYPE_P4DE
    default y if TERRAFORM_AWS_INSTANCE_TYPE_P3
    default y if TERRAFORM_AWS_INSTANCE_TYPE_P3DN
    default n
    help
      Automatically detected based on selected instance type.
      This indicates whether the selected instance has GPU support.
```

## terraform/aws/kconfigs/Kconfig.identity
```kconfig
config TERRAFORM_AWS_PROFILE
	string "AWS authentication profile to use"
	output yaml
	default "default"
	help
	  This option sets the value of the terraform provider's
	  aws_profile argument. An AWS profile specifies the IAM
	  user and secret key that both terraform and the "aws"
	  command line utility use to authenticate to AWS.

	  AWS profiles are set up in ~/.aws/credentials using the
	  "aws configure" command. You may also edit this file by
	  hand, if you're daring.

	  The default value of this Kconfig option selects the
	  "default" profile, which is fine when using only a single
	  AWS profile. Change the value of this option to select an
	  alternate profile / login credentials.
```

## terraform/aws/kconfigs/Kconfig.instance
```kconfig
# AWS EC2 instance type configuration
#
# This file is a static wrapper that sources dynamically generated
# instance type choices. The generated content is created by running
# 'make cloud-config-aws'.
#
# Pattern: This follows the Lambda Labs approach where static wrapper
# files (tracked in git) source .generated files (ignored by git).

# Source the generated instance type configuration
# If the file doesn't exist yet, Kconfig will silently skip it
source "terraform/aws/kconfigs/Kconfig.instance.generated"
```

## terraform/aws/kconfigs/Kconfig.location
```kconfig
# AWS region/location configuration
#
# This file is a static wrapper that sources dynamically generated
# region choices. The generated content is created by running
# 'make cloud-config-aws'.
#
# Pattern: This follows the Lambda Labs approach where static wrapper
# files (tracked in git) source .generated files (ignored by git).

# Source the generated location configuration
# If the file doesn't exist yet, Kconfig will silently skip it
source "terraform/aws/kconfigs/Kconfig.location.generated"
```
