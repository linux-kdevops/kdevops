## terraform/aws/kconfigs/Kconfig.location.default
```kconfig
choice
	prompt "AWS region"
	default TERRAFORM_AWS_REGION_US_EAST_1
	help
	  Use this option to select the AWS region that hosts your
	  compute and storage resources. If you do not explicitly
	  specify a region, the US West (Oregon) region is the
	  default.

	  Once selected, you can stick with the default AV zone
	  chosen by kdevops, or use:

	    aws ec2 describe-availability-zones --region <region-name>

	  to list the Availability Zones that are enabled for your
	  AWS account. Enter your selection from this list using the
	  TERRAFORM_AWS_AV_ZONE menu.

	  If you wish to expand on the region list, send a patch after
	  reading this list:

	  https://docs.aws.amazon.com/general/latest/gr/rande.html

	  Note that if you change region the AMI may change as well even
	  for the same distribution. At least that applies to Amazon EC2
	  optimized images. Use the AWS console, to set that up it will
	  ask you for your credentials and then a region. Before adding
	  an entry for ami image be sure you are on the region and then
	  query with something like:

	  aws ec2 describe-images --image-ids ami-0efa651876de2a5ce

	  For instance, this AMI belongs to us-west-2 only. us-east* have
	  other AMIs for the same Amazon 2023 EC2 image. The output from
	  here tells me:

	  "OwnerId": "137112412989"

	  And that is what value to use for ami-0efa651876de2a5ce
	  for the TERRAFORM_AWS_AMI_OWNER. To get the ami-* for your regions
	  just go to your EC2 console, that console will be associated with
	  a region already. You have to change regions if you want to look
	  for AMIs in other regions. There are for example two different
	  ami-* values for Amazon Linux 2023 for different regions. However
	  they values can be same. For example below are the us-west-2 queries
	  for Amazon Linux 2023 for x86_64 and then for ARM64.

	  aws ec2 describe-images --image-ids ami-0efa651876de2a5ce | grep OwnerId
	    "OwnerId": "137112412989",
	  aws ec2 describe-images --image-ids ami-0699f753302dd8b00 | grep OwnerId
	    "OwnerId": "137112412989",

config TERRAFORM_AWS_REGION_AP_NORTHEAST_1
	bool "ap-northeast-1"
	help
	  Use the ap-northeast-1 region.

config TERRAFORM_AWS_REGION_AP_NORTHEAST_2
	bool "ap-northeast-2"
	help
	  Use the ap-northeast-2 region.

config TERRAFORM_AWS_REGION_AP_NORTHEAST_3
	bool "ap-northeast-3"
	help
	  Use the ap-northeast-3 region.

config TERRAFORM_AWS_REGION_AP_SOUTH_1
	bool "ap-south-1"
	help
	  Use the ap-south-1 region.

config TERRAFORM_AWS_REGION_AP_SOUTHEAST_1
	bool "ap-southeast-1"
	help
	  Use the ap-southeast-1 region.

config TERRAFORM_AWS_REGION_AP_SOUTHEAST_2
	bool "ap-southeast-2"
	help
	  Use the ap-southeast-2 region.

config TERRAFORM_AWS_REGION_CA_CENTRAL_1
	bool "ca-central-1"
	help
	  Use the ca-central-1 region.

config TERRAFORM_AWS_REGION_EU_CENTRAL_1
	bool "eu-central-1"
	help
	  Use the eu-central-1 region.

config TERRAFORM_AWS_REGION_EU_NORTH_1
	bool "eu-north-1"
	help
	  Use the eu-north-1 region.

config TERRAFORM_AWS_REGION_EU_WEST_1
	bool "eu-west-1"
	help
	  Use the eu-west-1 region.

config TERRAFORM_AWS_REGION_EU_WEST_2
	bool "eu-west-2"
	help
	  Use the eu-west-2 region.

config TERRAFORM_AWS_REGION_EU_WEST_3
	bool "eu-west-3"
	help
	  Use the eu-west-3 region.

config TERRAFORM_AWS_REGION_SA_EAST_1
	bool "sa-east-1"
	help
	  Use the sa-east-1 region.

config TERRAFORM_AWS_REGION_US_EAST_1
	bool "us-east-1"
	help
	  Use the us-east-1 region.

config TERRAFORM_AWS_REGION_US_EAST_2
	bool "us-east-2"
	help
	  Use the us-east-2 region.

config TERRAFORM_AWS_REGION_US_WEST_1
	bool "us-west-1"
	help
	  Use the us-west-1 region.

config TERRAFORM_AWS_REGION_US_WEST_2
	bool "us-west-2"
	help
	  Use the us-west-2 region.

endchoice

config TERRAFORM_AWS_REGION
	string
	output yaml
	default "ap-northeast-1" if TERRAFORM_AWS_REGION_AP_NORTHEAST_1
	default "ap-northeast-2" if TERRAFORM_AWS_REGION_AP_NORTHEAST_2
	default "ap-northeast-3" if TERRAFORM_AWS_REGION_AP_NORTHEAST_3
	default "ap-south-1" if TERRAFORM_AWS_REGION_AP_SOUTH_1
	default "ap-southeast-1" if TERRAFORM_AWS_REGION_AP_SOUTHEAST_1
	default "ap-southeast-2" if TERRAFORM_AWS_REGION_AP_SOUTHEAST_2
	default "ca-central-1" if TERRAFORM_AWS_REGION_CA_CENTRAL_1
	default "eu-central-1" if TERRAFORM_AWS_REGION_EU_CENTRAL_1
	default "eu-north-1" if TERRAFORM_AWS_REGION_EU_NORTH_1
	default "eu-west-1" if TERRAFORM_AWS_REGION_EU_WEST_1
	default "eu-west-2" if TERRAFORM_AWS_REGION_EU_WEST_2
	default "eu-west-3" if TERRAFORM_AWS_REGION_EU_WEST_3
	default "sa-east-1" if TERRAFORM_AWS_REGION_SA_EAST_1
	default "us-east-1" if TERRAFORM_AWS_REGION_US_EAST_1
	default "us-east-2" if TERRAFORM_AWS_REGION_US_EAST_2
	default "us-west-1" if TERRAFORM_AWS_REGION_US_WEST_1
	default "us-west-2" if TERRAFORM_AWS_REGION_US_WEST_2


if TERRAFORM_AWS_REGION_AP_NORTHEAST_1

choice
	prompt "AWS availability zone"

config TERRAFORM_AWS_AV_ZONE_AP_NORTHEAST_1A
	bool "ap-northeast-1a"
	help
	  Use the ap-northeast-1a availability zone.

config TERRAFORM_AWS_AV_ZONE_AP_NORTHEAST_1C
	bool "ap-northeast-1c"
	help
	  Use the ap-northeast-1c availability zone.

config TERRAFORM_AWS_AV_ZONE_AP_NORTHEAST_1D
	bool "ap-northeast-1d"
	help
	  Use the ap-northeast-1d availability zone.

endchoice

config TERRAFORM_AWS_AV_ZONE
	string
	output yaml
	default "ap-northeast-1a" if TERRAFORM_AWS_AV_ZONE_AP_NORTHEAST_1A
	default "ap-northeast-1c" if TERRAFORM_AWS_AV_ZONE_AP_NORTHEAST_1C
	default "ap-northeast-1d" if TERRAFORM_AWS_AV_ZONE_AP_NORTHEAST_1D

endif # TERRAFORM_AWS_REGION_AP_NORTHEAST_1

if TERRAFORM_AWS_REGION_AP_NORTHEAST_2

choice
	prompt "AWS availability zone"

config TERRAFORM_AWS_AV_ZONE_AP_NORTHEAST_2A
	bool "ap-northeast-2a"
	help
	  Use the ap-northeast-2a availability zone.

config TERRAFORM_AWS_AV_ZONE_AP_NORTHEAST_2B
	bool "ap-northeast-2b"
	help
	  Use the ap-northeast-2b availability zone.

config TERRAFORM_AWS_AV_ZONE_AP_NORTHEAST_2C
	bool "ap-northeast-2c"
	help
	  Use the ap-northeast-2c availability zone.

config TERRAFORM_AWS_AV_ZONE_AP_NORTHEAST_2D
	bool "ap-northeast-2d"
	help
	  Use the ap-northeast-2d availability zone.

endchoice

config TERRAFORM_AWS_AV_ZONE
	string
	output yaml
	default "ap-northeast-2a" if TERRAFORM_AWS_AV_ZONE_AP_NORTHEAST_2A
	default "ap-northeast-2b" if TERRAFORM_AWS_AV_ZONE_AP_NORTHEAST_2B
	default "ap-northeast-2c" if TERRAFORM_AWS_AV_ZONE_AP_NORTHEAST_2C
	default "ap-northeast-2d" if TERRAFORM_AWS_AV_ZONE_AP_NORTHEAST_2D

endif # TERRAFORM_AWS_REGION_AP_NORTHEAST_2

if TERRAFORM_AWS_REGION_AP_NORTHEAST_3

choice
	prompt "AWS availability zone"

config TERRAFORM_AWS_AV_ZONE_AP_NORTHEAST_3A
	bool "ap-northeast-3a"
	help
	  Use the ap-northeast-3a availability zone.

config TERRAFORM_AWS_AV_ZONE_AP_NORTHEAST_3B
	bool "ap-northeast-3b"
	help
	  Use the ap-northeast-3b availability zone.

config TERRAFORM_AWS_AV_ZONE_AP_NORTHEAST_3C
	bool "ap-northeast-3c"
	help
	  Use the ap-northeast-3c availability zone.

endchoice

config TERRAFORM_AWS_AV_ZONE
	string
	output yaml
	default "ap-northeast-3a" if TERRAFORM_AWS_AV_ZONE_AP_NORTHEAST_3A
	default "ap-northeast-3b" if TERRAFORM_AWS_AV_ZONE_AP_NORTHEAST_3B
	default "ap-northeast-3c" if TERRAFORM_AWS_AV_ZONE_AP_NORTHEAST_3C

endif # TERRAFORM_AWS_REGION_AP_NORTHEAST_3

if TERRAFORM_AWS_REGION_AP_SOUTH_1

choice
	prompt "AWS availability zone"

config TERRAFORM_AWS_AV_ZONE_AP_SOUTH_1A
	bool "ap-south-1a"
	help
	  Use the ap-south-1a availability zone.

config TERRAFORM_AWS_AV_ZONE_AP_SOUTH_1B
	bool "ap-south-1b"
	help
	  Use the ap-south-1b availability zone.

config TERRAFORM_AWS_AV_ZONE_AP_SOUTH_1C
	bool "ap-south-1c"
	help
	  Use the ap-south-1c availability zone.

endchoice

config TERRAFORM_AWS_AV_ZONE
	string
	output yaml
	default "ap-south-1a" if TERRAFORM_AWS_AV_ZONE_AP_SOUTH_1A
	default "ap-south-1b" if TERRAFORM_AWS_AV_ZONE_AP_SOUTH_1B
	default "ap-south-1c" if TERRAFORM_AWS_AV_ZONE_AP_SOUTH_1C

endif # TERRAFORM_AWS_REGION_AP_SOUTH_1

if TERRAFORM_AWS_REGION_AP_SOUTHEAST_1

choice
	prompt "AWS availability zone"

config TERRAFORM_AWS_AV_ZONE_AP_SOUTHEAST_1A
	bool "ap-southeast-1a"
	help
	  Use the ap-southeast-1a availability zone.

config TERRAFORM_AWS_AV_ZONE_AP_SOUTHEAST_1B
	bool "ap-southeast-1b"
	help
	  Use the ap-southeast-1b availability zone.

config TERRAFORM_AWS_AV_ZONE_AP_SOUTHEAST_1C
	bool "ap-southeast-1c"
	help
	  Use the ap-southeast-1c availability zone.

endchoice

config TERRAFORM_AWS_AV_ZONE
	string
	output yaml
	default "ap-southeast-1a" if TERRAFORM_AWS_AV_ZONE_AP_SOUTHEAST_1A
	default "ap-southeast-1b" if TERRAFORM_AWS_AV_ZONE_AP_SOUTHEAST_1B
	default "ap-southeast-1c" if TERRAFORM_AWS_AV_ZONE_AP_SOUTHEAST_1C

endif # TERRAFORM_AWS_REGION_AP_SOUTHEAST_1

if TERRAFORM_AWS_REGION_AP_SOUTHEAST_2

choice
	prompt "AWS availability zone"

config TERRAFORM_AWS_AV_ZONE_AP_SOUTHEAST_2A
	bool "ap-southeast-2a"
	help
	  Use the ap-southeast-2a availability zone.

config TERRAFORM_AWS_AV_ZONE_AP_SOUTHEAST_2B
	bool "ap-southeast-2b"
	help
	  Use the ap-southeast-2b availability zone.

config TERRAFORM_AWS_AV_ZONE_AP_SOUTHEAST_2C
	bool "ap-southeast-2c"
	help
	  Use the ap-southeast-2c availability zone.

endchoice

config TERRAFORM_AWS_AV_ZONE
	string
	output yaml
	default "ap-southeast-2a" if TERRAFORM_AWS_AV_ZONE_AP_SOUTHEAST_2A
	default "ap-southeast-2b" if TERRAFORM_AWS_AV_ZONE_AP_SOUTHEAST_2B
	default "ap-southeast-2c" if TERRAFORM_AWS_AV_ZONE_AP_SOUTHEAST_2C

endif # TERRAFORM_AWS_REGION_AP_SOUTHEAST_2

if TERRAFORM_AWS_REGION_CA_CENTRAL_1

choice
	prompt "AWS availability zone"

config TERRAFORM_AWS_AV_ZONE_CA_CENTRAL_1A
	bool "ca-central-1a"
	help
	  Use the ca-central-1a availability zone.

config TERRAFORM_AWS_AV_ZONE_CA_CENTRAL_1B
	bool "ca-central-1b"
	help
	  Use the ca-central-1b availability zone.

config TERRAFORM_AWS_AV_ZONE_CA_CENTRAL_1D
	bool "ca-central-1d"
	help
	  Use the ca-central-1d availability zone.

endchoice

config TERRAFORM_AWS_AV_ZONE
	string
	output yaml
	default "ca-central-1a" if TERRAFORM_AWS_AV_ZONE_CA_CENTRAL_1A
	default "ca-central-1b" if TERRAFORM_AWS_AV_ZONE_CA_CENTRAL_1B
	default "ca-central-1d" if TERRAFORM_AWS_AV_ZONE_CA_CENTRAL_1D

endif # TERRAFORM_AWS_REGION_CA_CENTRAL_1

if TERRAFORM_AWS_REGION_EU_CENTRAL_1

choice
	prompt "AWS availability zone"

config TERRAFORM_AWS_AV_ZONE_EU_CENTRAL_1A
	bool "eu-central-1a"
	help
	  Use the eu-central-1a availability zone.

config TERRAFORM_AWS_AV_ZONE_EU_CENTRAL_1B
	bool "eu-central-1b"
	help
	  Use the eu-central-1b availability zone.

config TERRAFORM_AWS_AV_ZONE_EU_CENTRAL_1C
	bool "eu-central-1c"
	help
	  Use the eu-central-1c availability zone.

endchoice

config TERRAFORM_AWS_AV_ZONE
	string
	output yaml
	default "eu-central-1a" if TERRAFORM_AWS_AV_ZONE_EU_CENTRAL_1A
	default "eu-central-1b" if TERRAFORM_AWS_AV_ZONE_EU_CENTRAL_1B
	default "eu-central-1c" if TERRAFORM_AWS_AV_ZONE_EU_CENTRAL_1C

endif # TERRAFORM_AWS_REGION_EU_CENTRAL_1

if TERRAFORM_AWS_REGION_EU_NORTH_1

choice
	prompt "AWS availability zone"

config TERRAFORM_AWS_AV_ZONE_EU_NORTH_1A
	bool "eu-north-1a"
	help
	  Use the eu-north-1a availability zone.

config TERRAFORM_AWS_AV_ZONE_EU_NORTH_1B
	bool "eu-north-1b"
	help
	  Use the eu-north-1b availability zone.

config TERRAFORM_AWS_AV_ZONE_EU_NORTH_1C
	bool "eu-north-1c"
	help
	  Use the eu-north-1c availability zone.

endchoice

config TERRAFORM_AWS_AV_ZONE
	string
	output yaml
	default "eu-north-1a" if TERRAFORM_AWS_AV_ZONE_EU_NORTH_1A
	default "eu-north-1b" if TERRAFORM_AWS_AV_ZONE_EU_NORTH_1B
	default "eu-north-1c" if TERRAFORM_AWS_AV_ZONE_EU_NORTH_1C

endif # TERRAFORM_AWS_REGION_EU_NORTH_1

if TERRAFORM_AWS_REGION_EU_WEST_1

choice
	prompt "AWS availability zone"

config TERRAFORM_AWS_AV_ZONE_EU_WEST_1A
	bool "eu-west-1a"
	help
	  Use the eu-west-1a availability zone.

config TERRAFORM_AWS_AV_ZONE_EU_WEST_1B
	bool "eu-west-1b"
	help
	  Use the eu-west-1b availability zone.

config TERRAFORM_AWS_AV_ZONE_EU_WEST_1C
	bool "eu-west-1c"
	help
	  Use the eu-west-1c availability zone.

endchoice

config TERRAFORM_AWS_AV_ZONE
	string
	output yaml
	default "eu-west-1a" if TERRAFORM_AWS_AV_ZONE_EU_WEST_1A
	default "eu-west-1b" if TERRAFORM_AWS_AV_ZONE_EU_WEST_1B
	default "eu-west-1c" if TERRAFORM_AWS_AV_ZONE_EU_WEST_1C

endif # TERRAFORM_AWS_REGION_EU_WEST_1

if TERRAFORM_AWS_REGION_EU_WEST_2

choice
	prompt "AWS availability zone"

config TERRAFORM_AWS_AV_ZONE_EU_WEST_2A
	bool "eu-west-2a"
	help
	  Use the eu-west-2a availability zone.

config TERRAFORM_AWS_AV_ZONE_EU_WEST_2B
	bool "eu-west-2b"
	help
	  Use the eu-west-2b availability zone.

config TERRAFORM_AWS_AV_ZONE_EU_WEST_2C
	bool "eu-west-2c"
	help
	  Use the eu-west-2c availability zone.

endchoice

config TERRAFORM_AWS_AV_ZONE
	string
	output yaml
	default "eu-west-2a" if TERRAFORM_AWS_AV_ZONE_EU_WEST_2A
	default "eu-west-2b" if TERRAFORM_AWS_AV_ZONE_EU_WEST_2B
	default "eu-west-2c" if TERRAFORM_AWS_AV_ZONE_EU_WEST_2C

endif # TERRAFORM_AWS_REGION_EU_WEST_2

if TERRAFORM_AWS_REGION_EU_WEST_3

choice
	prompt "AWS availability zone"

config TERRAFORM_AWS_AV_ZONE_EU_WEST_3A
	bool "eu-west-3a"
	help
	  Use the eu-west-3a availability zone.

config TERRAFORM_AWS_AV_ZONE_EU_WEST_3B
	bool "eu-west-3b"
	help
	  Use the eu-west-3b availability zone.

config TERRAFORM_AWS_AV_ZONE_EU_WEST_3C
	bool "eu-west-3c"
	help
	  Use the eu-west-3c availability zone.

endchoice

config TERRAFORM_AWS_AV_ZONE
	string
	output yaml
	default "eu-west-3a" if TERRAFORM_AWS_AV_ZONE_EU_WEST_3A
	default "eu-west-3b" if TERRAFORM_AWS_AV_ZONE_EU_WEST_3B
	default "eu-west-3c" if TERRAFORM_AWS_AV_ZONE_EU_WEST_3C

endif # TERRAFORM_AWS_REGION_EU_WEST_3

if TERRAFORM_AWS_REGION_SA_EAST_1

choice
	prompt "AWS availability zone"

config TERRAFORM_AWS_AV_ZONE_SA_EAST_1A
	bool "sa-east-1a"
	help
	  Use the sa-east-1a availability zone.

config TERRAFORM_AWS_AV_ZONE_SA_EAST_1B
	bool "sa-east-1b"
	help
	  Use the sa-east-1b availability zone.

config TERRAFORM_AWS_AV_ZONE_SA_EAST_1C
	bool "sa-east-1c"
	help
	  Use the sa-east-1c availability zone.

endchoice

config TERRAFORM_AWS_AV_ZONE
	string
	output yaml
	default "sa-east-1a" if TERRAFORM_AWS_AV_ZONE_SA_EAST_1A
	default "sa-east-1b" if TERRAFORM_AWS_AV_ZONE_SA_EAST_1B
	default "sa-east-1c" if TERRAFORM_AWS_AV_ZONE_SA_EAST_1C

endif # TERRAFORM_AWS_REGION_SA_EAST_1

if TERRAFORM_AWS_REGION_US_EAST_1

choice
	prompt "AWS availability zone"

config TERRAFORM_AWS_AV_ZONE_US_EAST_1A
	bool "us-east-1a"
	help
	  Use the us-east-1a availability zone.

config TERRAFORM_AWS_AV_ZONE_US_EAST_1B
	bool "us-east-1b"
	help
	  Use the us-east-1b availability zone.

config TERRAFORM_AWS_AV_ZONE_US_EAST_1C
	bool "us-east-1c"
	help
	  Use the us-east-1c availability zone.

config TERRAFORM_AWS_AV_ZONE_US_EAST_1D
	bool "us-east-1d"
	help
	  Use the us-east-1d availability zone.

config TERRAFORM_AWS_AV_ZONE_US_EAST_1E
	bool "us-east-1e"
	help
	  Use the us-east-1e availability zone.

config TERRAFORM_AWS_AV_ZONE_US_EAST_1F
	bool "us-east-1f"
	help
	  Use the us-east-1f availability zone.

endchoice

config TERRAFORM_AWS_AV_ZONE
	string
	output yaml
	default "us-east-1a" if TERRAFORM_AWS_AV_ZONE_US_EAST_1A
	default "us-east-1b" if TERRAFORM_AWS_AV_ZONE_US_EAST_1B
	default "us-east-1c" if TERRAFORM_AWS_AV_ZONE_US_EAST_1C
	default "us-east-1d" if TERRAFORM_AWS_AV_ZONE_US_EAST_1D
	default "us-east-1e" if TERRAFORM_AWS_AV_ZONE_US_EAST_1E
	default "us-east-1f" if TERRAFORM_AWS_AV_ZONE_US_EAST_1F

endif # TERRAFORM_AWS_REGION_US_EAST_1

if TERRAFORM_AWS_REGION_US_EAST_2

choice
	prompt "AWS availability zone"

config TERRAFORM_AWS_AV_ZONE_US_EAST_2A
	bool "us-east-2a"
	help
	  Use the us-east-2a availability zone.

config TERRAFORM_AWS_AV_ZONE_US_EAST_2B
	bool "us-east-2b"
	help
	  Use the us-east-2b availability zone.

config TERRAFORM_AWS_AV_ZONE_US_EAST_2C
	bool "us-east-2c"
	help
	  Use the us-east-2c availability zone.

endchoice

config TERRAFORM_AWS_AV_ZONE
	string
	output yaml
	default "us-east-2a" if TERRAFORM_AWS_AV_ZONE_US_EAST_2A
	default "us-east-2b" if TERRAFORM_AWS_AV_ZONE_US_EAST_2B
	default "us-east-2c" if TERRAFORM_AWS_AV_ZONE_US_EAST_2C

endif # TERRAFORM_AWS_REGION_US_EAST_2

if TERRAFORM_AWS_REGION_US_WEST_1

choice
	prompt "AWS availability zone"

config TERRAFORM_AWS_AV_ZONE_US_WEST_1A
	bool "us-west-1a"
	help
	  Use the us-west-1a availability zone.

config TERRAFORM_AWS_AV_ZONE_US_WEST_1C
	bool "us-west-1c"
	help
	  Use the us-west-1c availability zone.

endchoice

config TERRAFORM_AWS_AV_ZONE
	string
	output yaml
	default "us-west-1a" if TERRAFORM_AWS_AV_ZONE_US_WEST_1A
	default "us-west-1c" if TERRAFORM_AWS_AV_ZONE_US_WEST_1C

endif # TERRAFORM_AWS_REGION_US_WEST_1

if TERRAFORM_AWS_REGION_US_WEST_2

choice
	prompt "AWS availability zone"

config TERRAFORM_AWS_AV_ZONE_US_WEST_2A
	bool "us-west-2a"
	help
	  Use the us-west-2a availability zone.

config TERRAFORM_AWS_AV_ZONE_US_WEST_2B
	bool "us-west-2b"
	help
	  Use the us-west-2b availability zone.

config TERRAFORM_AWS_AV_ZONE_US_WEST_2C
	bool "us-west-2c"
	help
	  Use the us-west-2c availability zone.

config TERRAFORM_AWS_AV_ZONE_US_WEST_2D
	bool "us-west-2d"
	help
	  Use the us-west-2d availability zone.

endchoice

config TERRAFORM_AWS_AV_ZONE
	string
	output yaml
	default "us-west-2a" if TERRAFORM_AWS_AV_ZONE_US_WEST_2A
	default "us-west-2b" if TERRAFORM_AWS_AV_ZONE_US_WEST_2B
	default "us-west-2c" if TERRAFORM_AWS_AV_ZONE_US_WEST_2C
	default "us-west-2d" if TERRAFORM_AWS_AV_ZONE_US_WEST_2D

endif # TERRAFORM_AWS_REGION_US_WEST_2
```
