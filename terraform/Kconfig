## terraform/aws/kconfigs/distros/Kconfig.fedora
```kconfig
if TERRAFORM_AWS_DISTRO_FEDORA

config TERRAFORM_AWS_AMI_OWNER
	string
	output yaml
	default "125523088429" # Community Platform Engineering

if TARGET_ARCH_X86_64

choice
	prompt "Fedora Core release"
	default TERRAFORM_AWS_FEDORA40_X86_64

config TERRAFORM_AWS_FEDORA40_X86_64
	bool "Fedora 40 (x86_64)"

config TERRAFORM_AWS_FEDORA41_X86_64
	bool "Fedora 41 (x86_64)"

endchoice

config TERRAFORM_AWS_NS
	string
	output yaml
	default "Fedora-Cloud-Base-AmazonEC2.x86_64-40-*" if TERRAFORM_AWS_FEDORA40_X86_64
	default "Fedora-Cloud-Base-AmazonEC2.x86_64-41-*" if TERRAFORM_AWS_FEDORA41_X86_64

endif # TARGET_ARCH_X86_64

if TARGET_ARCH_ARM64

choice
	prompt "Fedora Core release"
	default TERRAFORM_AWS_FEDORA40_ARM64

config TERRAFORM_AWS_FEDORA40_ARM64
	bool "Fedora 40 (arm64)"

config TERRAFORM_AWS_FEDORA41_ARM64
	bool "Fedora 41 (arm64"

endchoice

config TERRAFORM_AWS_NS
	string
	output yaml
	default "Fedora-Cloud-Base-AmazonEC2.aarch64-40-*" if TERRAFORM_AWS_FEDORA40_ARM64
	default "Fedora-Cloud-Base-AmazonEC2.aarch64-41-*" if TERRAFORM_AWS_FEDORA41_ARM64

endif # TARGET_ARCH_ARM64

endif # TERRAFORM_AWS_DISTRO_FEDORA
```

## terraform/aws/kconfigs/distros/Kconfig.oracle
```kconfig
if TERRAFORM_AWS_DISTRO_OL

config TERRAFORM_AWS_AMI_OWNER
	string
	output yaml
	default "amazon"

if TARGET_ARCH_X86_64

choice
	prompt "Oracle Linux release"
	default TERRAFORM_AWS_OL9_X86_64

config TERRAFORM_AWS_OL8_X86_64
	bool "Oracle Linux 8 (x86)"

config TERRAFORM_AWS_OL9_X86_64
	bool "Oracle Linux 9 (x86)"

endchoice

config TERRAFORM_AWS_NS
	string
	output yaml
	default "Oracle-Linux-8.*x86_64-*" if TERRAFORM_AWS_OL8_X86_64
	default "Oracle-Linux-9.*x86_64-*" if TERRAFORM_AWS_OL9_X86_64

endif # TARGET_ARCH_X86_64

if TARGET_ARCH_ARM64

choice
	prompt "Oracle Linux release"
	default TERRAFORM_AWS_OL9_ARM64

config TERRAFORM_AWS_OL9_ARM64
	bool "Oracle Linux 9 (arm64)"

endchoice

config TERRAFORM_AWS_NS
	string
	output yaml
	default "Oracle-Linux-9.*arm64-*" if TERRAFORM_AWS_OL9_ARM64

endif # TARGET_ARCH_ARM64

endif # TERRAFORM_AWS_DISTRO_OL
```

## terraform/aws/kconfigs/distros/Kconfig.rhel
```kconfig
if TERRAFORM_AWS_DISTRO_RHEL

config TERRAFORM_AWS_AMI_OWNER
	string
	output yaml
	default "amazon"

if TARGET_ARCH_X86_64

choice
	prompt "Red Hat Enterprise Linux release"
	default TERRAFORM_AWS_RHEL9_X86_64

config TERRAFORM_AWS_RHEL8_X86_64
	bool "Red Hat Enterprise Linux 8 (x86)"

config TERRAFORM_AWS_RHEL9_X86_64
	bool "Red Hat Enterprise Linux 9 (x86)"

config TERRAFORM_AWS_RHEL10_X86_64
	bool "Red Hat Enterprise Linux 10 (x86)"

endchoice

config TERRAFORM_AWS_NS
	string
	output yaml
	default "RHEL-8.*x86_64-*" if TERRAFORM_AWS_RHEL8_X86_64
	default "RHEL-9.*x86_64-*" if TERRAFORM_AWS_RHEL9_X86_64
	default "RHEL-10.*x86_64-*" if TERRAFORM_AWS_RHEL10_X86_64

endif # TARGET_ARCH_X86_64

if TARGET_ARCH_ARM64

choice
	prompt "Red Hat Enterprise Linux release"
	default TERRAFORM_AWS_RHEL9_ARM64

config TERRAFORM_AWS_RHEL9_ARM64
	bool "Red Hat Enterprise Linux 9 (arm64)"

config TERRAFORM_AWS_RHEL10_ARM64
	bool "Red Hat Enterprise Linux 10 (arm64)"

endchoice

config TERRAFORM_AWS_NS
	string
	output yaml
	default "RHEL-9.*arm64-*" if TERRAFORM_AWS_RHEL9_ARM64
	default "RHEL-10.*arm64-*" if TERRAFORM_AWS_RHEL10_ARM64

endif # TARGET_ARCH_ARM64

endif # TERRAFORM_AWS_DISTRO_RHEL
```

## terraform/aws/kconfigs/distros/Kconfig.sles
```kconfig
if TERRAFORM_AWS_DISTRO_SLES

config TERRAFORM_AWS_AMI_OWNER
	string
	output yaml
	default "amazon"

if TARGET_ARCH_X86_64

choice
	prompt "Suse Linux Enterprise Server release"
	default TERRAFORM_AWS_SLES15_SP4_X86_64

config TERRAFORM_AWS_SLES15_SP4_X86_64
	bool "SUSE Linux Enterprise Server 15 SP4 (x86)"

config TERRAFORM_AWS_SLES15_SP5_X86_64
	bool "SUSE Linux Enterprise Server 15 SP5 (x86)"

endchoice

config TERRAFORM_AWS_NS
	string
	output yaml
	default "suse-sles-15-sp4-*x86_64" if TERRAFORM_AWS_SLES15_SP4_X86_64
	default "suse-sles-15-sp5-*x86_64" if TERRAFORM_AWS_SLES15_SP5_X86_64

endif # TARGET_ARCH_X86_64

if TARGET_ARCH_ARM64

choice
	prompt "Suse Linux Enterprise Server release"
	default TERRAFORM_AWS_SLES15_SP4_ARM64

config TERRAFORM_AWS_SLES15_SP4_ARM64
	bool "SUSE Linux Enterprise Server 15 SP4 (arm64)"

config TERRAFORM_AWS_SLES15_SP5_ARM64
	bool "SUSE Linux Enterprise Server 15 SP5 (arm64)"

endchoice

config TERRAFORM_AWS_NS
	string
	output yaml
	default "suse-sles-15-sp4-*arm64" if TERRAFORM_AWS_SLE15_SP4_ARM64
	default "suse-sles-15-sp5-*arm64" if TERRAFORM_AWS_SLE15_SP5_ARM64

endif # TARGET_ARCH_ARM64

endif # TERRAFORM_AWS_DISTRO_SLES
```

## terraform/aws/kconfigs/instance-types/Kconfig.a1.static
```kconfig
# AWS A1 instance sizes (dynamically generated)

choice
	prompt "Instance size for A1 family"
	default TERRAFORM_AWS_INSTANCE_A1_MEDIUM
	help
	  Select the specific instance size within the A1 family.

config TERRAFORM_AWS_INSTANCE_A1_MEDIUM
	bool "a1.medium"
	help
	  vCPUs: 1
	  Memory: 2.0 GB
	  Network: Up to 10 Gigabit
	  Price: pricing varies

config TERRAFORM_AWS_INSTANCE_A1_LARGE
	bool "a1.large"
	help
	  vCPUs: 2
	  Memory: 4.0 GB
	  Network: Up to 10 Gigabit
	  Price: pricing varies

config TERRAFORM_AWS_INSTANCE_A1_XLARGE
	bool "a1.xlarge"
	help
	  vCPUs: 4
	  Memory: 8.0 GB
	  Network: Up to 10 Gigabit
	  Price: pricing varies

config TERRAFORM_AWS_INSTANCE_A1_2XLARGE
	bool "a1.2xlarge"
	help
	  vCPUs: 8
	  Memory: 16.0 GB
	  Network: Up to 10 Gigabit
	  Price: pricing varies

config TERRAFORM_AWS_INSTANCE_A1_METAL
	bool "a1.metal"
	help
	  vCPUs: 16
	  Memory: 32.0 GB
	  Network: Up to 10 Gigabit
	  Price: pricing varies

config TERRAFORM_AWS_INSTANCE_A1_4XLARGE
	bool "a1.4xlarge"
	help
	  vCPUs: 16
	  Memory: 32.0 GB
	  Network: Up to 10 Gigabit
	  Price: pricing varies

endchoice

config TERRAFORM_AWS_A1_SIZE
	string
	default "a1.medium" if TERRAFORM_AWS_INSTANCE_A1_MEDIUM
	default "a1.large" if TERRAFORM_AWS_INSTANCE_A1_LARGE
	default "a1.xlarge" if TERRAFORM_AWS_INSTANCE_A1_XLARGE
	default "a1.2xlarge" if TERRAFORM_AWS_INSTANCE_A1_2XLARGE
	default "a1.metal" if TERRAFORM_AWS_INSTANCE_A1_METAL
	default "a1.4xlarge" if TERRAFORM_AWS_INSTANCE_A1_4XLARGE
	default "a1.medium"
```

## terraform/aws/kconfigs/instance-types/Kconfig.c1.static
```kconfig
# AWS C1 instance sizes (dynamically generated)

choice
	prompt "Instance size for C1 family"
	default TERRAFORM_AWS_INSTANCE_C1_MEDIUM
	help
	  Select the specific instance size within the C1 family.

config TERRAFORM_AWS_INSTANCE_C1_MEDIUM
	bool "c1.medium"
	help
	  vCPUs: 2
	  Memory: 1.7 GB
	  Network: Moderate
	  Price: pricing varies
	  Instance storage: 350 GB

config TERRAFORM_AWS_INSTANCE_C1_XLARGE
	bool "c1.xlarge"
	help
	  vCPUs: 8
	  Memory: 7.0 GB
	  Network: High
	  Price: pricing varies
	  Instance storage: 1680 GB

endchoice

config TERRAFORM_AWS_C1_SIZE
	string
	default "c1.medium" if TERRAFORM_AWS_INSTANCE_C1_MEDIUM
	default "c1.xlarge" if TERRAFORM_AWS_INSTANCE_C1_XLARGE
	default "c1.medium"
```
