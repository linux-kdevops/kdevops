## terraform/aws/kconfigs/Kconfig.location.static
```kconfig
# AWS regions (dynamically generated)

choice
    prompt "AWS region"
    default TERRAFORM_AWS_REGION_USEAST1
    help
      Select the AWS region for your deployment.
      Note: Not all instance types are available in all regions.

# US Regions
config TERRAFORM_AWS_REGION_US_EAST_1
	bool "US East (N. Virginia)"
	help
	  Region: US East (N. Virginia)

config TERRAFORM_AWS_REGION_US_EAST_2
	bool "US East (Ohio)"
	help
	  Region: US East (Ohio)

config TERRAFORM_AWS_REGION_US_WEST_1
	bool "US West (N. California)"
	help
	  Region: US West (N. California)

config TERRAFORM_AWS_REGION_US_WEST_2
	bool "US West (Oregon)"
	help
	  Region: US West (Oregon)


# Europe Regions
config TERRAFORM_AWS_REGION_EU_CENTRAL_1
	bool "Europe (Frankfurt)"
	help
	  Region: Europe (Frankfurt)

config TERRAFORM_AWS_REGION_EU_NORTH_1
	bool "Europe (Stockholm)"
	help
	  Region: Europe (Stockholm)

config TERRAFORM_AWS_REGION_EU_WEST_1
	bool "Europe (Ireland)"
	help
	  Region: Europe (Ireland)

config TERRAFORM_AWS_REGION_EU_WEST_2
	bool "Europe (London)"
	help
	  Region: Europe (London)

config TERRAFORM_AWS_REGION_EU_WEST_3
	bool "Europe (Paris)"
	help
	  Region: Europe (Paris)


# Asia Pacific Regions
config TERRAFORM_AWS_REGION_AP_NORTHEAST_1
	bool "Asia Pacific (Tokyo)"
	help
	  Region: Asia Pacific (Tokyo)

config TERRAFORM_AWS_REGION_AP_NORTHEAST_2
	bool "Asia Pacific (Seoul)"
	help
	  Region: Asia Pacific (Seoul)

config TERRAFORM_AWS_REGION_AP_NORTHEAST_3
	bool "Ap Northeast 3"
	help
	  Region: Ap Northeast 3

config TERRAFORM_AWS_REGION_AP_SOUTH_1
	bool "Asia Pacific (Mumbai)"
	help
	  Region: Asia Pacific (Mumbai)

config TERRAFORM_AWS_REGION_AP_SOUTHEAST_1
	bool "Asia Pacific (Singapore)"
	help
	  Region: Asia Pacific (Singapore)

config TERRAFORM_AWS_REGION_AP_SOUTHEAST_2
	bool "Asia Pacific (Sydney)"
	help
	  Region: Asia Pacific (Sydney)


# Other Regions
config TERRAFORM_AWS_REGION_CA_CENTRAL_1
	bool "Canada (Central)"
	help
	  Region: Canada (Central)

config TERRAFORM_AWS_REGION_SA_EAST_1
	bool "South America (São Paulo)"
	help
	  Region: South America (São Paulo)


endchoice

config TERRAFORM_AWS_REGION
    string
	default "ap-south-1" if TERRAFORM_AWS_REGION_AP_SOUTH_1
	default "eu-north-1" if TERRAFORM_AWS_REGION_EU_NORTH_1
	default "eu-west-3" if TERRAFORM_AWS_REGION_EU_WEST_3
	default "eu-west-2" if TERRAFORM_AWS_REGION_EU_WEST_2
	default "eu-west-1" if TERRAFORM_AWS_REGION_EU_WEST_1
	default "ap-northeast-3" if TERRAFORM_AWS_REGION_AP_NORTHEAST_3
	default "ap-northeast-2" if TERRAFORM_AWS_REGION_AP_NORTHEAST_2
	default "ap-northeast-1" if TERRAFORM_AWS_REGION_AP_NORTHEAST_1
	default "ca-central-1" if TERRAFORM_AWS_REGION_CA_CENTRAL_1
	default "sa-east-1" if TERRAFORM_AWS_REGION_SA_EAST_1
	default "ap-southeast-1" if TERRAFORM_AWS_REGION_AP_SOUTHEAST_1
	default "ap-southeast-2" if TERRAFORM_AWS_REGION_AP_SOUTHEAST_2
	default "eu-central-1" if TERRAFORM_AWS_REGION_EU_CENTRAL_1
	default "us-east-1" if TERRAFORM_AWS_REGION_US_EAST_1
	default "us-east-2" if TERRAFORM_AWS_REGION_US_EAST_2
	default "us-west-1" if TERRAFORM_AWS_REGION_US_WEST_1
	default "us-west-2" if TERRAFORM_AWS_REGION_US_WEST_2
	default "us-east-1"
```

## terraform/aws/kconfigs/Kconfig.network
```kconfig
# Network and VPC configuration

config TERRAFORM_AWS_CREATE_VPC
	bool "Create new VPC"
	default n
	output yaml
	help
	  Create a new VPC for the kdevops instances. If disabled, instances
	  will be created in the default VPC for the region.

	  Disable this if you've reached your VPC limit or want to use an
	  existing VPC. When disabled, ensure your default VPC has appropriate
	  subnets and internet gateway configured.

config TERRAFORM_AWS_ASSIGN_PUBLIC_IP
	bool "Assign public IP to instances"
	default y
	output yaml
	help
	  Assign a public IP address to instances. This is required for
	  SSH access from outside the VPC.
```

## terraform/aws/kconfigs/Kconfig.ssh
```kconfig
# AWS SSH Key Management Configuration

choice
	prompt "AWS SSH key management strategy"
	default TERRAFORM_AWS_SSH_KEY_UNIQUE
	help
	  Choose how SSH keys are managed for AWS instances.

	  Unique key (recommended): Each kdevops project directory gets its own
	  SSH key, preventing conflicts when using multiple kdevops instances.

	  Shared key: Use the same key name across all projects (less secure,
	  risk of overwriting keys and locking out existing instances).

config TERRAFORM_AWS_SSH_KEY_UNIQUE
	bool "Use unique SSH key per project directory (recommended)"
	help
	  Generate a unique SSH key name for each kdevops project directory.
	  The key name will be based on the directory path, ensuring no conflicts
	  between different kdevops deployments.

	  Example: kdevops-aws-projectname-a1b2c3d4

	  This prevents accidentally overwriting SSH keys in AWS when using
	  kdevops in multiple directories, which would lock you out of
	  existing instances.

config TERRAFORM_AWS_SSH_KEY_SHARED
	bool "Use shared SSH key name (legacy/risky)"
	help
	  Use a fixed SSH key name that you specify. This is less secure
	  and can lead to accidental key overwrites if you use kdevops in
	  multiple directories with different keys.

	  WARNING: Using the same key name with different public keys will
	  replace the key in AWS and lock you out of existing instances!

endchoice

config TERRAFORM_AWS_SSH_KEY_NAME_CUSTOM
	string "Custom SSH key name (only for shared mode)"
	default "kdevops_aws_key"
	depends on TERRAFORM_AWS_SSH_KEY_SHARED
	help
	  Specify the custom SSH key name to use when in shared mode.

	  WARNING: If this key already exists in AWS with a different
	  public key, it will be replaced, potentially locking you out
	  of existing instances!

config TERRAFORM_AWS_SSH_KEY_NAME
	string
	output yaml
	default $(shell, python3 scripts/aws_ssh_key_name.py 2>/dev/null || echo "kdevops-aws-fallback") if TERRAFORM_AWS_SSH_KEY_UNIQUE
	default TERRAFORM_AWS_SSH_KEY_NAME_CUSTOM if TERRAFORM_AWS_SSH_KEY_SHARED
	help
	  The actual SSH key name that will be used in AWS.
	  When using unique mode, this is automatically generated based on
	  the current directory path.

config TERRAFORM_AWS_SSH_PUBKEY_FILE
	string
	output yaml
	default $(shell, python3 scripts/aws_ssh_key_name.py --pubkey-path 2>/dev/null || echo "~/.ssh/kdevops_terraform.pub") if TERRAFORM_AWS_SSH_KEY_UNIQUE
	default "~/.ssh/kdevops_terraform.pub" if TERRAFORM_AWS_SSH_KEY_SHARED
	help
	  Path to the SSH public key file.
	  When using unique mode, this path includes the directory-specific
	  key name to avoid conflicts.

config TERRAFORM_AWS_SSH_PRIVKEY_FILE
	string
	output yaml
	default $(shell, python3 scripts/aws_ssh_key_name.py --path 2>/dev/null || echo "~/.ssh/kdevops_terraform") if TERRAFORM_AWS_SSH_KEY_UNIQUE
	default "~/.ssh/kdevops_terraform" if TERRAFORM_AWS_SSH_KEY_SHARED
	help
	  Path to the SSH private key file.
	  When using unique mode, this path includes the directory-specific
	  key name to avoid conflicts.
```

## terraform/aws/kconfigs/Kconfig.storage
```kconfig
choice
	prompt "Number of EBS volumes"
	default TERRAFORM_AWS_EBS_VOLUMES_PER_INSTANCE_4

config TERRAFORM_AWS_EBS_VOLUMES_PER_INSTANCE_0
	bool "0"

config TERRAFORM_AWS_EBS_VOLUMES_PER_INSTANCE_1
	bool "1"

config TERRAFORM_AWS_EBS_VOLUMES_PER_INSTANCE_2
	bool "2"

config TERRAFORM_AWS_EBS_VOLUMES_PER_INSTANCE_3
	bool "3"

config TERRAFORM_AWS_EBS_VOLUMES_PER_INSTANCE_4
	bool "4"

config TERRAFORM_AWS_EBS_VOLUMES_PER_INSTANCE_5
	bool "5"

config TERRAFORM_AWS_EBS_VOLUMES_PER_INSTANCE_6
	bool "6"

config TERRAFORM_AWS_EBS_VOLUMES_PER_INSTANCE_7
	bool "7"

config TERRAFORM_AWS_EBS_VOLUMES_PER_INSTANCE_8
	bool "8"

config TERRAFORM_AWS_EBS_VOLUMES_PER_INSTANCE_9
	bool "9"

config TERRAFORM_AWS_EBS_VOLUMES_PER_INSTANCE_10
	bool "10"

endchoice

config TERRAFORM_AWS_EBS_VOLUMES_PER_INSTANCE
	int
	output yaml
	default 0 if TERRAFORM_AWS_EBS_VOLUMES_PER_INSTANCE_0
	default 1 if TERRAFORM_AWS_EBS_VOLUMES_PER_INSTANCE_1
	default 2 if TERRAFORM_AWS_EBS_VOLUMES_PER_INSTANCE_2
	default 3 if TERRAFORM_AWS_EBS_VOLUMES_PER_INSTANCE_3
	default 4 if TERRAFORM_AWS_EBS_VOLUMES_PER_INSTANCE_4
	default 5 if TERRAFORM_AWS_EBS_VOLUMES_PER_INSTANCE_5
	default 6 if TERRAFORM_AWS_EBS_VOLUMES_PER_INSTANCE_6
	default 7 if TERRAFORM_AWS_EBS_VOLUMES_PER_INSTANCE_7
	default 8 if TERRAFORM_AWS_EBS_VOLUMES_PER_INSTANCE_8
	default 9 if TERRAFORM_AWS_EBS_VOLUMES_PER_INSTANCE_9
	default 10 if TERRAFORM_AWS_EBS_VOLUMES_PER_INSTANCE_10

choice
	prompt "Device type for all EBS volumes"
	default TERRAFORM_AWS_EBS_VOLUME_TYPE_GP2
	help
	  This setting specifies the type of device to provision
	  for EBS volumes attached to kdevops instances.

config TERRAFORM_AWS_EBS_VOLUME_TYPE_GP2
	bool "gp2"
	help
	  All extra EBS volumes are "General Purpose SSD volumes",
	  version 2.

config TERRAFORM_AWS_EBS_VOLUME_TYPE_GP3
	bool "gp3"
	help
	  All extra EBS volumes are "General Purpose SSD volumes",
	  version 3.

config TERRAFORM_AWS_EBS_VOLUME_TYPE_IO1
	bool "io1"
	help
	  All extra EBS volumes are "Provisioned IOPS SSD volumes"
	  version 1.

config TERRAFORM_AWS_EBS_VOLUME_TYPE_IO2
	bool "io2"
	help
	  All extra EBS volumes are "Provisioned IOPS SSD volumes"
	  version 2.

endchoice

config TERRAFORM_AWS_EBS_VOLUME_TYPE
	string
	output yaml
	default "gp2" if TERRAFORM_AWS_EBS_VOLUME_TYPE_GP2
	default "gp3" if TERRAFORM_AWS_EBS_VOLUME_TYPE_GP3
	default "io1" if TERRAFORM_AWS_EBS_VOLUME_TYPE_IO1
	default "io2" if TERRAFORM_AWS_EBS_VOLUME_TYPE_IO2

if TERRAFORM_AWS_EBS_VOLUME_TYPE_GP3 || TERRAFORM_AWS_EBS_VOLUME_TYPE_IO1 || TERRAFORM_AWS_EBS_VOLUME_TYPE_IO2

config TERRAFORM_AWS_EBS_VOLUME_IOPS
	int "IOPS provisioned for EBS volumes"
	output yaml
	default 3000
	help
	  This setting specifies the IOPS to be provisioned for each
	  extra EBS volume.

endif # TERRAFORM_AWS_EBS_VOLUME_TYPE_GP3 || TERRAFORM_AWS_EBS_ ...

if TERRAFORM_AWS_EBS_VOLUME_TYPE_GP3 || TERRAFORM_AWS_EBS_VOLUME_TYPE_IO1

config TERRAFORM_AWS_EBS_VOLUME_THROUGHPUT
	int "Throughput provisioned for EBS volumes"
	output yaml
	default 125
	range 125 1000
	help
	  This setting specifies the maximum throughput, in
	  megabytes per second, to be provisioned for each extra EBS
	  volume. The maximum setting allowed by AWS varies with the
	  number and type of EBS volumes attached to each instance.

endif # TERRAFORM_AWS_EBS_VOLUME_TYPE_GP3 || TERRAFORM_AWS_EBS_VOLUME_TYPE_IO1

choice
	prompt "Volume size for all EBS volumes"
	default TERRAFORM_AWS_EBS_VOLUME_SIZE_32G

config TERRAFORM_AWS_EBS_VOLUME_SIZE_4G
	bool "4G"
	help
	  Use 4 GiB EBS volumes.

config TERRAFORM_AWS_EBS_VOLUME_SIZE_8G
	bool "8G"
	help
	  Use 8 GiB EBS volumes.

config TERRAFORM_AWS_EBS_VOLUME_SIZE_16G
	bool "16G"
	help
	  Use 16 GiB EBS volumes.

config TERRAFORM_AWS_EBS_VOLUME_SIZE_32G
	bool "32G"
	help
	  Use 32 GiB EBS volumes.

config TERRAFORM_AWS_EBS_VOLUME_SIZE_64G
	bool "64G"
	help
	  Use 64 GiB EBS volumes.

config TERRAFORM_AWS_EBS_VOLUME_SIZE_128G
	bool "128G"
	help
	  Use 128 GiB EBS volumes.

config TERRAFORM_AWS_EBS_VOLUME_SIZE_256G
	bool "256G"
	help
	  Use 256 GiB EBS volumes.

config TERRAFORM_AWS_EBS_VOLUME_SIZE_512G
	bool "512G"
	help
	  Use 512 GiB EBS volumes.

config TERRAFORM_AWS_EBS_VOLUME_SIZE_1024G
	bool "1024G"
	help
	  Use 1024 GiB EBS volumes.

config TERRAFORM_AWS_EBS_VOLUME_SIZE_2048G
	bool "2048G"
	help
	  Use 2048 GiB EBS volumes.

config TERRAFORM_AWS_EBS_VOLUME_SIZE_3078G
	bool "3078G"
	help
	  Use 3078 GiB EBS volumes.

config TERRAFORM_AWS_EBS_VOLUME_SIZE_4096G
	bool "4096G"
	help
	  Use 4096 GiB EBS volumes.

endchoice

config TERRAFORM_AWS_EBS_VOLUME_SIZE
	int
	output yaml
	default 4 if TERRAFORM_AWS_EBS_VOLUME_SIZE_4G
	default 8 if TERRAFORM_AWS_EBS_VOLUME_SIZE_8G
	default 16 if TERRAFORM_AWS_EBS_VOLUME_SIZE_16G
	default 32 if TERRAFORM_AWS_EBS_VOLUME_SIZE_32G
	default 64 if TERRAFORM_AWS_EBS_VOLUME_SIZE_64G
	default 128 if TERRAFORM_AWS_EBS_VOLUME_SIZE_128G
	default 256 if TERRAFORM_AWS_EBS_VOLUME_SIZE_256G
	default 512 if TERRAFORM_AWS_EBS_VOLUME_SIZE_512G
	default 1024 if TERRAFORM_AWS_EBS_VOLUME_SIZE_1024G
	default 2048 if TERRAFORM_AWS_EBS_VOLUME_SIZE_2048G
	default 3078 if TERRAFORM_AWS_EBS_VOLUME_SIZE_3078G
	default 4096 if TERRAFORM_AWS_EBS_VOLUME_SIZE_4096G

config TERRAFORM_AWS_DATA_VOLUME_DEVICE_FILE_NAME
	string "Data volume's device file name"
	output yaml
	default "/dev/disk/kdevops/extra-volume-00"
	help
	  This option sets the name of the block device on each
	  target node that is to be used for the /data file system.

config TERRAFORM_AWS_SPARSE_VOLUME_DEVICE_FILE_NAME
	string "Sparse volume's device file name"
	output yaml
	default "/dev/disk/kdevops/extra-volume-01"
	help
	  This option sets the name of the block device on each
	  target node that can be used for the fstests sparse device
	  tests.
```

## terraform/aws/kconfigs/distros/Kconfig.amazon
```kconfig
if TERRAFORM_AWS_DISTRO_AMAZON

config TERRAFORM_AWS_AMI_OWNER
	string
	output yaml
	default "amazon"

if TARGET_ARCH_X86_64

choice
	prompt "Amazon Linux release"
	default TERRAFORM_AWS_AMI_AMAZON_X86_64

config TERRAFORM_AWS_AMI_AMAZON_X86_64
	bool "Amazon Linux 2023 (x86)"

endchoice

config TERRAFORM_AWS_NS
	string
	output yaml
	default "al2023-*-x86_64" if TERRAFORM_AWS_AMI_AMAZON_X86_64

endif # TARGET_ARCH_X86_64

if TARGET_ARCH_ARM64

choice
	prompt "Amazon Linux release"
	default TERRAFORM_AWS_AMI_AMAZON_ARM64

config TERRAFORM_AWS_AMI_AMAZON_ARM64
	bool "Amazon Linux 2023 (arm64)"

endchoice

config TERRAFORM_AWS_NS
	string
	output yaml
	default "al2023-*-arm64" if TERRAFORM_AWS_AMI_AMAZON_ARM64

endif # TARGET_ARCH_ARM64

endif # TERRAFORM_AWS_DISTRO_AMAZON
```

## terraform/aws/kconfigs/distros/Kconfig.custom
```kconfig
if TERRAFORM_AWS_DISTRO_CUSTOM

config TERRAFORM_AWS_AMI_OWNER
	string "AWS AMI owner or owner alias"
	output yaml
	default "amazon"
	help
	  The owner is a string of digits that represents a
	  collection of published images to search, such as
	  "137112412989". Sometimes the publisher also provides
	  an alias, which is a human-readable name of that
	  collection, such as "aws-marketplace".

config TERRAFORM_AWS_NS
	string "AWS AMI name search expression"
	output yaml
	help
	  This option sets a custom aws image search expression to
	  use. Using this filter glob lets us get the latest AMI for
	  your preferred OS release.

	  To get filter values you can first setup aws cli:

	  https://docs.aws.amazon.com/cli/latest/userguide/cli-chap-configure.html#cli-quick-configuration

	  Get your image ami id, for debian 9 amd64 on the us-west1 this is
	  ami-0adbaf2e0ce044437 so you can run:

	  aws ec2 describe-images --image-ids ami-0adbaf2e0ce044437 | grep Name

	  For details:

	  https://docs.aws.amazon.com/cli/latest/reference/ec2/describe-images.html

endif # TERRAFORM_AWS_DISTRO_CUSTOM
```

## terraform/aws/kconfigs/distros/Kconfig.debian
```kconfig
if TERRAFORM_AWS_DISTRO_DEBIAN

config TERRAFORM_AWS_AMI_OWNER
	string
	output yaml
	default "amazon"

if TARGET_ARCH_X86_64

choice
	prompt "Debian Linux release"
	default TERRAFORM_AWS_NS_DEBIAN_12_X86_64

config TERRAFORM_AWS_NS_DEBIAN_11_X86_64
	bool "Debian 11 Bullseye (x86)"

config TERRAFORM_AWS_NS_DEBIAN_12_X86_64
	bool "Debian 12 Bookworm (x86)"

endchoice

config TERRAFORM_AWS_NS
	string
	output yaml
	default "debian-11-amd64-*" if TERRAFORM_AWS_NS_DEBIAN_11_X86_64
	default "debian-12-amd64-*" if TERRAFORM_AWS_NS_DEBIAN_12_X86_64

endif # TARGET_ARCH_X86_64

if TARGET_ARCH_ARM64

choice
	prompt "Debian Linux release"
	default TERRAFORM_AWS_NS_DEBIAN_12_ARM64

config TERRAFORM_AWS_NS_DEBIAN_11_ARM64
	bool "Debian 11 Bullseye (arm64)"

config TERRAFORM_AWS_NS_DEBIAN_12_ARM64
	bool "Debian 12 Bookworm (arm64)"

endchoice

config TERRAFORM_AWS_NS
	string
	default "debian-11-arm64-*" if TERRAFORM_AWS_NS_DEBIAN_11_ARM64
	default "debian-12-arm64-*" if TERRAFORM_AWS_NS_DEBIAN_12_ARM64

endif # TARGET_ARCH_ARM64

endif # TERRAFORM_AWS_DISTRO_DEBIAN
```
