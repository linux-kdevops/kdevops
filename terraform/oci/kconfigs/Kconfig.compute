## terraform/oci/kconfigs/Kconfig.compute
```kconfig
choice
	prompt "OCI shape family"
	default TERRAFORM_OCI_SHAPE_FAMILY_FLEX
	help
	  This option selects the class of virtual hardware (CPUs and
	  memory) to provision for each target node. Most CPU
	  architectures, including x86, run two threads per physical
	  core, so one OCPU is the equal of two vCPUs for x86-based
	  compute.

	  Which shapes are available is limited by your subscription
	  and what hardware has been deployed in your selected region.

config TERRAFORM_OCI_SHAPE_FAMILY_FLEX
	bool "Flex shapes"
	help
	  A flexible shape is a virtual machine that lets you
	  customize the number of OCPUs and the amount of memory
	  per instance. The network bandwidth and number of VNICs
	  scale proportionately with the number of OCPUs.

config TERRAFORM_OCI_SHAPE_FAMILY_GENERIC
	bool "Generic shapes"
	help
	  These shapes are recommended for developers who do not
	  require a specific model of CPU for their workflows.

config TERRAFORM_OCI_SHAPE_FAMILY_BARE_METAL
	bool "Bare metal"
	help
	  A bare metal shape is a whole physical machine without
	  virtualization. This gives deterministic performance
	  characteristics but is less configurable than a flex
	  shape.

endchoice

source "terraform/oci/kconfigs/shapes/Kconfig.flex"
source "terraform/oci/kconfigs/shapes/Kconfig.generic"
source "terraform/oci/kconfigs/shapes/Kconfig.bm"

choice
	prompt "Distribution"
	default TERRAFORM_OCI_OPERATING_SYSTEM_ORACLE_LINUX
	help
	  Select the Linux distribution to install on each instance.

config TERRAFORM_OCI_OPERATING_SYSTEM_ORACLE_LINUX
	bool "Oracle Linux"
	help
	  Select this if you want to use a release of Oracle Linux
	  as the operating system in your instances.

config TERRAFORM_OCI_OPERATING_SYSTEM_UBUNTU
	bool "Ubuntu"
	help
	  Select this if you want to use a release of Ubuntu Linux
	  as the operating system in your instances.

config TERRAFORM_OCI_OPERATING_SYSTEM_CUSTOM
	bool "Custom image OCID"
	help
	  Select this if you want to enter a specific OCID for
	  an OS image. Use this if you wish to use a custom or
	  marketplace image not included in the fixed choices in
	  this menu.

	  The image you specify must reside in the same region as
	  your instances.

	  More image choices are available:

	  https://docs.oracle.com/en-us/iaas/images/

endchoice

source "terraform/oci/kconfigs/images/Kconfig.OracleLinux"
source "terraform/oci/kconfigs/images/Kconfig.Ubuntu"
source "terraform/oci/kconfigs/images/Kconfig.custom"
```

## terraform/oci/kconfigs/Kconfig.identity
```kconfig
config TERRAFORM_OCI_TENANCY_OCID
	string "OCI tenant OCID"
	help
	  The OCI ID of the tenancy to use.
	  Read this:
	  https://docs.oracle.com/en-us/iaas/Content/API/SDKDocs/terraformproviderconfiguration.htm

config TERRAFORM_OCI_CONFIG_FILE_PROFILE
	string "Authentication profile entry"
	output yaml
	default "DEFAULT"
	help
	  Authentication secrets are stored in ~/.oci/config. That
	  file may contain more than one entry/identity. Select the
	  entry in ~/.oci/config that kdevops uses to
	  authenticate to OCI. Examples:

	  https://docs.oracle.com/en-us/iaas/Content/API/Concepts/sdkconfig.htm
```

## terraform/oci/kconfigs/Kconfig.image
```kconfig
choice
	prompt "Distribution"
	default TERRAFORM_OCI_OPERATING_SYSTEM_ORACLE_LINUX
	help
	  Select the Linux distribution to install on each instance.

config TERRAFORM_OCI_OPERATING_SYSTEM_ORACLE_LINUX
	bool "Oracle Linux"
	help
	  Select this if you want to use a release of Oracle Linux
	  as the operating system in your instances.

config TERRAFORM_OCI_OPERATING_SYSTEM_UBUNTU
	bool "Ubuntu"
	help
	  Select this if you want to use a release of Ubuntu Linux
	  as the operating system in your instances.

config TERRAFORM_OCI_OPERATING_SYSTEM_CUSTOM
	bool "Custom image OCID"
	help
	  Select this if you want to enter a specific OCID for
	  an OS image. Use this if you wish to use a custom or
	  marketplace image not included in the fixed choices in
	  this menu.

	  The image you specify must reside in the same region as
	  your instances.

	  More image choices are available:

	  https://docs.oracle.com/en-us/iaas/images/

endchoice

source "terraform/oci/kconfigs/images/Kconfig.OracleLinux"
source "terraform/oci/kconfigs/images/Kconfig.Ubuntu"
source "terraform/oci/kconfigs/images/Kconfig.custom"
```

## terraform/oci/kconfigs/Kconfig.location
```kconfig
choice
	prompt "OCI Region"
	default TERRAFORM_OCI_REGION_ORD
	help
	  A region is a collection of geographically co-located data
	  centers that share data and hardware resources. For more
	  information:

	  https://docs.oracle.com/en-us/iaas/Content/General/Concepts/regions.htm

	  Using this menu, select the region in which you wish to
	  deploy your kdevops resources. Your tenancy must be
	  subscribed to the region you select here. Use:

	    $ oci iam region-subscription list

	  for a list of regions to which your tenancy subscribes.

config TERRAFORM_OCI_REGION_HYD
	bool "India South (Hyderabad)"

config TERRAFORM_OCI_REGION_BOM
	bool "India West (Mumbai)"

config TERRAFORM_OCI_REGION_YUL
	bool "Canada Southeast (Montreal)"

config TERRAFORM_OCI_REGION_YYZ
	bool "Canada Southeast (Toronto)"

config TERRAFORM_OCI_REGION_IAD
	bool "US East (Ashburn)"

config TERRAFORM_OCI_REGION_ORD
	bool "US Midwest (Chicago)"

config TERRAFORM_OCI_REGION_PHX
	bool "US West (Phoenix)"

config TERRAFORM_OCI_REGION_SJC
	bool "US West (San Jose)"

endchoice

if TERRAFORM_OCI_REGION_HYD

config TERRAFORM_OCI_REGION
	string
	output yaml
	default "ap-hyderabad-1"

choice
	prompt "Availability Domain"
	default TERRAFORM_OCI_REGION_HYD_AD1
	help
	  The number of the Availability Domain. This number
	  corresponds to the integer at the end of the Availability
	  Domain name.

	  The OCI Fault Domain is chosen automatically.

config TERRAFORM_OCI_REGION_HYD_AD1
	bool "1"

endchoice

config TERRAFORM_OCI_AD_NUMBER
	int
	output yaml
	default 1 if TERRAFORM_OCI_REGION_HYD_1_AD1

endif # TERRAFORM_OCI_REGION_HYD_1

if TERRAFORM_OCI_REGION_BOM

config TERRAFORM_OCI_REGION
	string
	output yaml
	default "ap-mumbai-1"
choice
	prompt "Availability Domain"
	default TERRAFORM_OCI_REGION_BOM_AD1
	help
	  The number of the Availability Domain. This number
	  corresponds to the integer at the end of the Availability
	  Domain name.

	  The OCI Fault Domain is chosen automatically.

config TERRAFORM_OCI_REGION_BOM_AD1
	bool "1"

endchoice

config TERRAFORM_OCI_AD_NUMBER
	int
	output yaml
	default 1 if TERRAFORM_OCI_REGION_BOM_AD1

endif # TERRAFORM_OCI_REGION_BOM

if TERRAFORM_OCI_REGION_YUL

config TERRAFORM_OCI_REGION
	string
	output yaml
	default "ca-montreal-1"

choice
	prompt "Availability Domain"
	default TERRAFORM_OCI_REGION_YUL_AD1
	help
	  The number of the Availability Domain. This number
	  corresponds to the integer at the end of the Availability
	  Domain name.

	  The OCI Fault Domain is chosen automatically.

config TERRAFORM_OCI_REGION_YUL_AD1
	bool "1"

endchoice

config TERRAFORM_OCI_AD_NUMBER
	int
	output yaml
	default 1 if TERRAFORM_OCI_REGION_YUL_AD1

endif # TERRAFORM_OCI_REGION_YUL

if TERRAFORM_OCI_REGION_YYZ

config TERRAFORM_OCI_REGION
	string
	output yaml
	default "ca-toronto-1"

choice
	prompt "Availability Domain"
	default TERRAFORM_OCI_REGION_YYZ_AD1
	help
	  The number of the Availability Domain. This number
	  corresponds to the integer at the end of the Availability
	  Domain name.

	  The OCI Fault Domain is chosen automatically.

config TERRAFORM_OCI_REGION_YYZ_AD1
	bool "1"

endchoice

config TERRAFORM_OCI_AD_NUMBER
	int
	output yaml
	default 1 if TERRAFORM_OCI_REGION_YYZ_AD1

endif # TERRAFORM_OCI_REGION_YYZ

if TERRAFORM_OCI_REGION_IAD

config TERRAFORM_OCI_REGION
	string
	output yaml
	default "us-ashburn-1"

choice
	prompt "Availability Domain"
	default TERRAFORM_OCI_REGION_IAD_AD1
	help
	  The number of the Availability Domain. This number
	  corresponds to the integer at the end of the Availability
	  Domain name.

	  The OCI Fault Domain is chosen automatically.

config TERRAFORM_OCI_REGION_IAD_AD1
	bool "1"

config TERRAFORM_OCI_REGION_IAD_AD2
	bool "2"

config TERRAFORM_OCI_REGION_IAD_AD3
	bool "3"

endchoice

config TERRAFORM_OCI_AD_NUMBER
	int
	output yaml
	default 1 if TERRAFORM_OCI_REGION_IAD_AD1
	default 2 if TERRAFORM_OCI_REGION_IAD_AD2
	default 3 if TERRAFORM_OCI_REGION_IAD_AD3

endif # TERRAFORM_OCI_REGION_IAD

if TERRAFORM_OCI_REGION_ORD

config TERRAFORM_OCI_REGION
	string
	output yaml
	default "us-chicago-1"

choice
	prompt "Availability Domain"
	default TERRAFORM_OCI_REGION_ORD_AD1
	help
	  The number of the Availability Domain. This number
	  corresponds to the integer at the end of the Availability
	  Domain name.

	  The OCI Fault Domain is chosen automatically.

config TERRAFORM_OCI_REGION_ORD_AD1
	bool "1"

config TERRAFORM_OCI_REGION_ORD_AD2
	bool "2"

config TERRAFORM_OCI_REGION_ORD_AD3
	bool "3"

endchoice

config TERRAFORM_OCI_AD_NUMBER
	int
	output yaml
	default 1 if TERRAFORM_OCI_REGION_ORD_AD1
	default 2 if TERRAFORM_OCI_REGION_ORD_AD2
	default 3 if TERRAFORM_OCI_REGION_ORD_AD3

endif # TERRAFORM_OCI_REGION_ORD

if TERRAFORM_OCI_REGION_PHX

config TERRAFORM_OCI_REGION
	string
	output yaml
	default "us-phoenix-1"

choice
	prompt "Availability Domain"
	default TERRAFORM_OCI_REGION_PHX_AD1
	help
	  The number of the Availability Domain. This number
	  corresponds to the integer at the end of the Availability
	  Domain name.

	  The OCI Fault Domain is chosen automatically.

config TERRAFORM_OCI_REGION_PHX_AD1
	bool "1"

config TERRAFORM_OCI_REGION_PHX_AD2
	bool "2"

config TERRAFORM_OCI_REGION_PHX_AD3
	bool "3"

endchoice

config TERRAFORM_OCI_AD_NUMBER
	int
	output yaml
	default 1 if TERRAFORM_OCI_REGION_PHX_AD1
	default 2 if TERRAFORM_OCI_REGION_PHX_AD2
	default 3 if TERRAFORM_OCI_REGION_PHX_AD3

endif # TERRAFORM_OCI_REGION_PHX

if TERRAFORM_OCI_REGION_SJC

config TERRAFORM_OCI_REGION
	string
	output yaml
	default "us-sanjose-1"

choice
	prompt "Availability Domain"
	default TERRAFORM_OCI_REGION_SJC_AD1
	help
	  The number of the Availability Domain. This number
	  corresponds to the integer at the end of the Availability
	  Domain name.

	  The OCI Fault Domain is chosen automatically.

config TERRAFORM_OCI_REGION_SJC_AD1
	bool "1"

endchoice

config TERRAFORM_OCI_AD_NUMBER
	int
	output yaml
	default 1 if TERRAFORM_OCI_REGION_SJC_AD1

endif # TERRAFORM_OCI_REGION_SJC

config TERRAFORM_OCI_COMPARTMENT_NAME
	string "OCI compartment name"
	output yaml
	help
	  The compartment name where your instances are to be created.
```

## terraform/oci/kconfigs/Kconfig.location.default
```kconfig
choice
	prompt "OCI Region"
	default TERRAFORM_OCI_REGION_ORD
	help
	  A region is a collection of geographically co-located data
	  centers that share data and hardware resources. For more
	  information:

	  https://docs.oracle.com/en-us/iaas/Content/General/Concepts/regions.htm

	  Using this menu, select the region in which you wish to
	  deploy your kdevops resources. Your tenancy must be
	  subscribed to the region you select here. Use:

	    $ oci iam region-subscription list

	  for a list of regions to which your tenancy subscribes.

config TERRAFORM_OCI_REGION_YYZ
	bool "Canada Southeast (Toronto)"

config TERRAFORM_OCI_REGION_IAD
	bool "US East (Ashburn)"

config TERRAFORM_OCI_REGION_ORD
	bool "US Midwest (Chicago)"

endchoice

if TERRAFORM_OCI_REGION_YYZ

config TERRAFORM_OCI_REGION
	string
	output yaml
	default "ca-toronto-1"

choice
	prompt "Availability Domain"
	default TERRAFORM_OCI_REGION_YYZ_AD1
	help
	  The number of the Availability Domain. This number
	  corresponds to the integer at the end of the Availability
	  Domain name.

	  The OCI Fault Domain is chosen automatically.

config TERRAFORM_OCI_REGION_YYZ_AD1
	bool "1"

endchoice

config TERRAFORM_OCI_AD_NUMBER
	int
	output yaml
	default 1 if TERRAFORM_OCI_REGION_YYZ_AD1

endif # TERRAFORM_OCI_REGION_YYZ

if TERRAFORM_OCI_REGION_IAD

config TERRAFORM_OCI_REGION
	string
	output yaml
	default "us-ashburn-1"

choice
	prompt "Availability Domain"
	default TERRAFORM_OCI_REGION_IAD_AD1
	help
	  The number of the Availability Domain. This number
	  corresponds to the integer at the end of the Availability
	  Domain name.

	  The OCI Fault Domain is chosen automatically.

config TERRAFORM_OCI_REGION_IAD_AD1
	bool "1"

config TERRAFORM_OCI_REGION_IAD_AD2
	bool "2"

config TERRAFORM_OCI_REGION_IAD_AD3
	bool "3"

endchoice

config TERRAFORM_OCI_AD_NUMBER
	int
	output yaml
	default 1 if TERRAFORM_OCI_REGION_IAD_AD1
	default 2 if TERRAFORM_OCI_REGION_IAD_AD2
	default 3 if TERRAFORM_OCI_REGION_IAD_AD3

endif # TERRAFORM_OCI_REGION_IAD

if TERRAFORM_OCI_REGION_ORD

config TERRAFORM_OCI_REGION
	string
	output yaml
	default "us-chicago-1"

choice
	prompt "Availability Domain"
	default TERRAFORM_OCI_REGION_ORD_AD1
	help
	  The number of the Availability Domain. This number
	  corresponds to the integer at the end of the Availability
	  Domain name.

	  The OCI Fault Domain is chosen automatically.

config TERRAFORM_OCI_REGION_ORD_AD1
	bool "1"

config TERRAFORM_OCI_REGION_ORD_AD2
	bool "2"

config TERRAFORM_OCI_REGION_ORD_AD3
	bool "3"

endchoice

config TERRAFORM_OCI_AD_NUMBER
	int
	output yaml
	default 1 if TERRAFORM_OCI_REGION_ORD_AD1
	default 2 if TERRAFORM_OCI_REGION_ORD_AD2
	default 3 if TERRAFORM_OCI_REGION_ORD_AD3

endif # TERRAFORM_OCI_REGION_ORD

config TERRAFORM_OCI_COMPARTMENT_NAME
	string "OCI compartment name"
	output yaml
	help
	  The compartment name where your instances are to be created.
```

## terraform/oci/kconfigs/Kconfig.network
```kconfig
config TERRAFORM_OCI_ASSIGN_PUBLIC_IP
	bool "Assign public IP address to each instance"
	output yaml
	default y
	help
	  Enable this setting if a public IP address should be
	  assigned to each instance. Leave it unset to prevent your
	  instances from being accessible on the public internet.

config TERRAFORM_OCI_USE_EXISTING_VCN
	bool "Attach instances to an existing VCN"
	output yaml
	default y
	help
	  If your tenancy administrator prefers to create and secure
	  the network resources used within a compartment, or your
	  tenancy has special networking requirements, enable this
	  option. Then enter the OCID of the existing subnet in the
	  TERRAFORM_OCI_SUBNET_OCID option below. kdevops will join
	  its compute instances to that subnet.

	  Disable this option if you'd like kdevops to create a
	  secure VPN and subnet automatically.

if TERRAFORM_OCI_USE_EXISTING_VCN

config TERRAFORM_OCI_SUBNET_OCID
	string "OCI Subnet OCID"
	output yaml
	help
	  If there is a long-lived VNC and subnet already available
	  to which to attach kdevops compute instances, specify the
	  OCID of this subnet via this option.

	  kdevops does not manage this resource. Before running
	  "make bringup", the subnet must already exist and your OCI
	  user must have permission to attach to it.

endif # TERRAFORM_OCI_USE_EXISTING_VCN
```
