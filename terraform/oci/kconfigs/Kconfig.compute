## terraform/oci/kconfigs/shapes/Kconfig.generic
```kconfig
if TERRAFORM_OCI_SHAPE_FAMILY_GENERIC

choice
	prompt "OCI shape"
	default TERRAFORM_OCI_SHAPE_VM_STANDARD_X86_GENERIC
	help
	  Select the basic hardware capabilities that are in each
	  instance.

config TERRAFORM_OCI_SHAPE_VM_STANDARD_X86_GENERIC
	bool "VM.Standard.x86.Generic"
	depends on TARGET_ARCH_X86_64

endchoice

config TERRAFORM_OCI_SHAPE
	string
	output yaml
	default "VM.Standard.x86.Generic" if TERRAFORM_OCI_SHAPE_VM_STANDARD_X86_GENERIC

config TERRAFORM_OCI_INSTANCE_FLEX_OCPUS
	int "Instance CPU count"
	output yaml
	default 2
	help
	  The Oracle CPU (OCPU) represents physical CPU cores and is
	  the unit of measurement for CPUs on x86 CPUs (AMD and
	  Intel) and Arm CPUs (OCI Ampere Compute). A virtual CPU
	  (vCPU), the industry-standard for measuring compute
	  resources, represents one execution thread of a physical
	  CPU core.

	  Most CPU architectures, including x86, runs two threads
	  per physical core, so one OCPU is the equal of two vCPUs
	  for x86-based compute. For OCI Compute, the minimum unit
	  of provisioning starts from one OCPU on both X86 (Intel
	  and AMD) and OCI Ampere Compute processors.

config TERRAFORM_OCI_INSTANCE_FLEX_MEMORY_IN_GBS
	int "Instance memory size"
	output yaml
	default 4
	help
	  Memory per instance, in GiBs. The minimum value for this
	  setting is a multiple of the number of OCPUS in each
	  instance.

endif # TERRAFORM_OCI_SHAPE_FAMILY_GENERIC
```

## terraform/rcloud/Kconfig
```kconfig
if TERRAFORM_RCLOUD

config TERRAFORM_RCLOUD_API_URL
	string "rcloud API server URL"
	default "http://localhost:8765"
	help
	  The URL of the rcloud REST API server. This should point to a running
	  rcloud server instance that was set up using defconfig-rcloud.

	  Default is http://localhost:8765 for local development and testing.

	  For remote rcloud servers, use: http://server-hostname:8765

config TERRAFORM_RCLOUD_BASE_IMAGE
	string "Base image name to use for VMs"
	default "debian-13-generic-amd64-daily"
	help
	  The name of the base image to use when creating VMs through rcloud.
	  This must match a base image that exists in the rcloud server's
	  base image directory (typically /xfs1/libvirt/guestfs/base_images/).

	  The base images are created on the rcloud server using guestfs
	  (see defconfig-rcloud).

endif # TERRAFORM_RCLOUD
```

## workflows/ai/Kconfig
```kconfig
if KDEVOPS_WORKFLOW_ENABLE_AI

choice
	prompt "What type of AI testing do you want to run?"
	default AI_TESTS_VECTOR_DATABASE

config AI_TESTS_VECTOR_DATABASE
	bool "Vector database performance tests"
	select KDEVOPS_BASELINE_AND_DEV
	output yaml
	help
	  Run vector database performance analysis tests.
	  This includes testing various vector dimensions, batch sizes,
	  and query patterns to generate performance profiles for AI workloads.

	  A/B testing is enabled to compare performance across different
	  configurations using baseline and development nodes.

endchoice

# Vector Database Configuration
if AI_TESTS_VECTOR_DATABASE

choice
	prompt "Select vector database system"
	default AI_VECTOR_DB_MILVUS

config AI_VECTOR_DB_MILVUS
	bool "Milvus - Open-source vector database"
	output yaml
	help
	  Milvus is a cloud-native vector database built for scalable
	  similarity search and AI applications. It provides high
	  performance vector indexing and querying capabilities.

endchoice

# Milvus-specific configuration
if AI_VECTOR_DB_MILVUS

# CLI override support for CI testing
config AI_VECTOR_DB_MILVUS_QUICK_TEST_SET_BY_CLI
	bool
	output yaml
	default $(shell, scripts/check-cli-set-var.sh AI_VECTOR_DB_MILVUS_QUICK_TEST)

config AI_VECTOR_DB_MILVUS_QUICK_TEST
	bool "Enable quick test mode for CI/demo"
	default y if AI_VECTOR_DB_MILVUS_QUICK_TEST_SET_BY_CLI
	output yaml
	help
	  Quick test mode reduces dataset sizes and runtime for rapid validation.
	  This is useful for CI pipelines and demonstrations.

# Milvus runs in Docker containers only
config AI_VECTOR_DB_MILVUS_DOCKER
	bool
	output yaml
	default y
	help
	  Milvus runs inside Docker containers with embedded etcd and MinIO storage.
	  Native installation is not supported due to complex build requirements.

config AI_VECTOR_DB_MILVUS_VERSION
	string "Milvus version"
	output yaml
	default "2.3.0"
	help
	  The version of Milvus to install and use.

config AI_VECTOR_DB_MILVUS_PORT
	int "Milvus server port"
	output yaml
	default 19530
	help
	  The port number where Milvus server is listening.
	  Default is 19530 for standard Milvus deployment.

config AI_VECTOR_DB_MILVUS_COLLECTION_NAME
	string "Default collection name"
	output yaml
	default "benchmark_collection"
	help
	  The default collection name to use for benchmarking tests.

config AI_VECTOR_DB_MILVUS_DIMENSION
	int "Vector dimension"
	output yaml
	default 768
	range 1 4096
	help
	  The dimension of vectors to use in benchmarks.
	  Common dimensions: 128, 384, 768, 1536

config AI_VECTOR_DB_MILVUS_DATASET_SIZE
	int "Dataset size (number of vectors)"
	output yaml
	default 100000 if AI_VECTOR_DB_MILVUS_QUICK_TEST
	default 1000000
	help
	  The number of vectors to insert for benchmarking.
	  Quick test mode uses smaller dataset for faster execution.

config AI_VECTOR_DB_MILVUS_BATCH_SIZE
	int "Batch size for insertions"
	output yaml
	default 10000
	help
	  The batch size to use when inserting vectors.

config AI_VECTOR_DB_MILVUS_NUM_QUERIES
	int "Number of search queries"
	output yaml
	default 1000 if AI_VECTOR_DB_MILVUS_QUICK_TEST
	default 10000
	help
	  The number of search queries to execute during benchmarking.

if AI_VECTOR_DB_MILVUS_DOCKER
source "workflows/ai/Kconfig.docker"
endif # AI_VECTOR_DB_MILVUS_DOCKER

if AI_VECTOR_DB_MILVUS_NATIVE
source "workflows/ai/Kconfig.native"
endif # AI_VECTOR_DB_MILVUS_NATIVE

endif # AI_VECTOR_DB_MILVUS

endif # AI_TESTS_VECTOR_DATABASE

# Common AI Benchmark Configuration
config AI_BENCHMARK_RESULTS_DIR
	string "Benchmark results directory"
	output yaml
	default "/data/ai-benchmark"
	help
	  Directory where benchmark results will be stored.

config AI_BENCHMARK_ENABLE_GRAPHING
	bool "Enable performance graphing"
	output yaml
	default y
	help
	  Generate performance graphs and visualizations from benchmark results.

config AI_BENCHMARK_ITERATIONS
	int "Number of benchmark iterations"
	output yaml
	default 3 if AI_VECTOR_DB_MILVUS_QUICK_TEST
	default 5
	range 1 100
	help
	  The number of iterations to run for each benchmark configuration.
	  Multiple iterations help ensure consistent results.

# Multi-filesystem configuration
config AI_MULTIFS_ENABLE
	bool "Enable multi-filesystem benchmarking"
	output yaml
	default n
	help
	  Run AI benchmarks across multiple filesystem configurations
	  to compare performance characteristics.

if AI_MULTIFS_ENABLE
source "workflows/ai/Kconfig.multifs"
endif

config AI_ENABLE_FUTURE_COMPONENTS
	bool "Enable future AI components (placeholder)"
	output yaml
	default n
	help
	  This is a placeholder for future AI components that will be
	  added to the workflow:
	  - Language Models (LLMs)
	  - Embedding Services
	  - Training Infrastructure
	  - Inference Servers
	  - RAG (Retrieval Augmented Generation) pipelines

endif # KDEVOPS_WORKFLOW_ENABLE_AI
```

## workflows/ai/Kconfig.docker
```kconfig
choice
	prompt "Which Milvus container image to use?"
	default AI_VECTOR_DB_MILVUS_CONTAINER_IMAGE_2_5

config AI_VECTOR_DB_MILVUS_CONTAINER_IMAGE_2_5
	bool "milvusdb/milvus:v2.5.10"
	output yaml
	help
	  Use the latest stable Milvus 2.5.x release with enhanced
	  performance and stability features.

config AI_VECTOR_DB_MILVUS_CONTAINER_IMAGE_2_4
	bool "milvusdb/milvus:v2.4.17"
	output yaml
	help
	  Use Milvus 2.4.x for compatibility with existing workloads
	  or when specific 2.4 features are required.

endchoice

config AI_VECTOR_DB_MILVUS_CONTAINER_IMAGE_STRING
	string
	output yaml
	default "milvusdb/milvus:v2.5.10" if AI_VECTOR_DB_MILVUS_CONTAINER_IMAGE_2_5
	default "milvusdb/milvus:v2.4.17" if AI_VECTOR_DB_MILVUS_CONTAINER_IMAGE_2_4

config AI_VECTOR_DB_MILVUS_CONTAINER_NAME
	string "The local Milvus container name"
	default "milvus-ai-benchmark"
	output yaml
	help
	  Set the name for the Milvus Docker container.

config AI_VECTOR_DB_MILVUS_ETCD_CONTAINER_IMAGE_STRING
	string "etcd container image"
	output yaml
	default "quay.io/coreos/etcd:v3.5.18" if AI_VECTOR_DB_MILVUS_CONTAINER_IMAGE_2_5
	default "quay.io/coreos/etcd:v3.5.5" if AI_VECTOR_DB_MILVUS_CONTAINER_IMAGE_2_4
	help
	  The etcd container image to use for Milvus metadata storage.

config AI_VECTOR_DB_MILVUS_ETCD_CONTAINER_NAME
	string "The local etcd container name"
	default "milvus-etcd"
	output yaml
	help
	  Set the name for the etcd Docker container.

config AI_VECTOR_DB_MILVUS_MINIO_CONTAINER_IMAGE_STRING
	string "MinIO container image"
	output yaml
	default "minio/minio:RELEASE.2023-03-20T20-16-18Z"
	help
	  The MinIO container image to use for Milvus object storage.

config AI_VECTOR_DB_MILVUS_MINIO_CONTAINER_NAME
	string "The local MinIO container name"
	default "milvus-minio"
	output yaml
	help
	  Set the name for the MinIO Docker container.

config AI_VECTOR_DB_MILVUS_MINIO_ACCESS_KEY
	string "MinIO access key"
	output yaml
	default "minioadmin"
	help
	  Access key for MinIO object storage.

config AI_VECTOR_DB_MILVUS_MINIO_SECRET_KEY
	string "MinIO secret key"
	output yaml
	default "minioadmin"
	help
	  Secret key for MinIO object storage.

config AI_VECTOR_DB_MILVUS_DOCKER_DATA_PATH
	string "Host path for persistent data storage"
	output yaml
	default "/data/milvus/data"
	help
	  Directory on the host where Milvus data will be persisted.
	  This includes vector data, metadata, and logs.

config AI_VECTOR_DB_MILVUS_DOCKER_ETCD_DATA_PATH
	string "Host path for etcd data storage"
	output yaml
	default "/data/milvus/etcd"
	help
	  Directory on the host where etcd data will be persisted.

config AI_VECTOR_DB_MILVUS_DOCKER_MINIO_DATA_PATH
	string "Host path for MinIO data storage"
	output yaml
	default "/data/milvus/minio"
	help
	  Directory on the host where MinIO data will be persisted.

config AI_VECTOR_DB_MILVUS_DOCKER_NETWORK_NAME
	string "Docker network name"
	output yaml
	default "milvus-network"
	help
	  Name of the Docker network to create for Milvus containers.

config AI_VECTOR_DB_MILVUS_WEB_UI_PORT
	int "Milvus web UI port"
	output yaml
	default "9091"
	help
	  Port for accessing the Milvus web UI interface.

config AI_VECTOR_DB_MILVUS_MINIO_API_PORT
	int "MinIO API port"
	output yaml
	default "9000"
	help
	  Port for MinIO API access.

config AI_VECTOR_DB_MILVUS_MINIO_CONSOLE_PORT
	int "MinIO console port"
	output yaml
	default "9001"
	help
	  Port for MinIO web console access.

config AI_VECTOR_DB_MILVUS_ETCD_CLIENT_PORT
	int "etcd client port"
	output yaml
	default "2379"
	help
	  Port for etcd client connections.

config AI_VECTOR_DB_MILVUS_ETCD_PEER_PORT
	int "etcd peer port"
	output yaml
	default "2380"
	help
	  Port for etcd peer connections.

menu "Docker resource limits"

config AI_VECTOR_DB_MILVUS_MEMORY_LIMIT
	string "Milvus container memory limit"
	output yaml
	default "8g"
	help
	  Memory limit for the Milvus container. Adjust based on
	  your system resources and dataset size.

config AI_VECTOR_DB_MILVUS_CPU_LIMIT
	string "Milvus container CPU limit"
	output yaml
	default "4.0"
	help
	  CPU limit for the Milvus container (number of CPUs).

config AI_VECTOR_DB_MILVUS_ETCD_MEMORY_LIMIT
	string "etcd container memory limit"
	output yaml
	default "1g"
	help
	  Memory limit for the etcd container.

config AI_VECTOR_DB_MILVUS_MINIO_MEMORY_LIMIT
	string "MinIO container memory limit"
	output yaml
	default "2g"
	help
	  Memory limit for the MinIO container.

endmenu
```
