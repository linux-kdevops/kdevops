## workflows/ai/Kconfig.docker-storage
```kconfig
menu "Docker Storage Configuration for AI Workloads"

config AI_DOCKER_STORAGE_ENABLE
	bool "Enable dedicated Docker storage for AI workloads"
	default y
	output yaml
	help
	  Configure a dedicated storage device for Docker containers
	  and images used in AI workloads. This prevents Docker from
	  filling up the root filesystem and provides better performance
	  isolation for container operations.

	  When enabled, Docker data will be stored on a dedicated device
	  and filesystem optimized for container workloads.

if AI_DOCKER_STORAGE_ENABLE

config AI_DOCKER_DEVICE
	string "Device to use for Docker storage"
	output yaml
	default "/dev/disk/by-id/nvme-QEMU_NVMe_Ctrl_kdevops1" if LIBVIRT && LIBVIRT_EXTRA_STORAGE_DRIVE_NVME
	default "/dev/disk/by-id/virtio-kdevops1" if LIBVIRT && LIBVIRT_EXTRA_STORAGE_DRIVE_VIRTIO
	default "/dev/disk/by-id/ata-QEMU_HARDDISK_kdevops1" if LIBVIRT && LIBVIRT_EXTRA_STORAGE_DRIVE_IDE
	default "/dev/nvme2n1" if TERRAFORM_AWS_INSTANCE_M5AD_2XLARGE
	default "/dev/nvme2n1" if TERRAFORM_AWS_INSTANCE_M5AD_4XLARGE
	default "/dev/nvme1n1" if TERRAFORM_GCE
	default "/dev/sdd" if TERRAFORM_AZURE
	default TERRAFORM_OCI_SPARSE_VOLUME_DEVICE_FILE_NAME if TERRAFORM_OCI
	help
	  The device to use for Docker storage. This device will be
	  formatted and mounted to store Docker containers, images,
	  and volumes for AI workloads.

config AI_DOCKER_MOUNT_POINT
	string "Mount point for Docker storage"
	output yaml
	default "/var/lib/docker/"
	help
	  The path where the Docker storage filesystem will be mounted.
	  Docker will be configured to use this path via a symlink from
	  /var/lib/docker.

choice
	prompt "Docker storage filesystem"
	default AI_DOCKER_FSTYPE_XFS

config AI_DOCKER_FSTYPE_XFS
	bool "XFS"
	help
	  Use XFS filesystem for Docker storage. XFS provides excellent
	  performance for large files and is recommended for production
	  Docker deployments. Supports various block sizes for testing
	  large block size (LBS) configurations.

config AI_DOCKER_FSTYPE_BTRFS
	bool "Btrfs"
	help
	  Use Btrfs filesystem for Docker storage. Btrfs provides
	  advanced features like snapshots and compression, which can
	  be beneficial for Docker layer management.

config AI_DOCKER_FSTYPE_EXT4
	bool "ext4"
	help
	  Use ext4 filesystem for Docker storage. Ext4 is a mature
	  and reliable filesystem with good all-around performance.

endchoice

config AI_DOCKER_FSTYPE
	string
	output yaml
	default "xfs" if AI_DOCKER_FSTYPE_XFS
	default "btrfs" if AI_DOCKER_FSTYPE_BTRFS
	default "ext4" if AI_DOCKER_FSTYPE_EXT4

if AI_DOCKER_FSTYPE_XFS

choice
	prompt "XFS block size configuration"
	default AI_DOCKER_XFS_BLOCKSIZE_4K

config AI_DOCKER_XFS_BLOCKSIZE_4K
	bool "4K block size (default)"
	help
	  Use 4K (4096 bytes) block size. This is the default and most
	  compatible configuration.

config AI_DOCKER_XFS_BLOCKSIZE_8K
	bool "8K block size"
	help
	  Use 8K (8192 bytes) block size for improved performance with
	  larger I/O operations.

config AI_DOCKER_XFS_BLOCKSIZE_16K
	bool "16K block size (LBS)"
	help
	  Use 16K (16384 bytes) block size. This is a large block size
	  configuration that may require kernel LBS support.

config AI_DOCKER_XFS_BLOCKSIZE_32K
	bool "32K block size (LBS)"
	help
	  Use 32K (32768 bytes) block size. This is a large block size
	  configuration that requires kernel LBS support.

config AI_DOCKER_XFS_BLOCKSIZE_64K
	bool "64K block size (LBS)"
	help
	  Use 64K (65536 bytes) block size. This is the maximum XFS block
	  size and requires kernel LBS support.

endchoice

config AI_DOCKER_XFS_BLOCKSIZE
	int
	output yaml
	default 4096 if AI_DOCKER_XFS_BLOCKSIZE_4K
	default 8192 if AI_DOCKER_XFS_BLOCKSIZE_8K
	default 16384 if AI_DOCKER_XFS_BLOCKSIZE_16K
	default 32768 if AI_DOCKER_XFS_BLOCKSIZE_32K
	default 65536 if AI_DOCKER_XFS_BLOCKSIZE_64K

choice
	prompt "XFS sector size"
	default AI_DOCKER_XFS_SECTORSIZE_4K

config AI_DOCKER_XFS_SECTORSIZE_4K
	bool "4K sector size (default)"
	help
	  Use 4K (4096 bytes) sector size. This is the standard
	  configuration for most modern drives.

config AI_DOCKER_XFS_SECTORSIZE_512
	bool "512 byte sector size"
	depends on AI_DOCKER_XFS_BLOCKSIZE_4K
	help
	  Use legacy 512 byte sector size. Only available with 4K block size.

config AI_DOCKER_XFS_SECTORSIZE_8K
	bool "8K sector size"
	depends on AI_DOCKER_XFS_BLOCKSIZE_8K || AI_DOCKER_XFS_BLOCKSIZE_16K || AI_DOCKER_XFS_BLOCKSIZE_32K || AI_DOCKER_XFS_BLOCKSIZE_64K
	help
	  Use 8K (8192 bytes) sector size. Requires block size >= 8K.

config AI_DOCKER_XFS_SECTORSIZE_16K
	bool "16K sector size (LBS)"
	depends on AI_DOCKER_XFS_BLOCKSIZE_16K || AI_DOCKER_XFS_BLOCKSIZE_32K || AI_DOCKER_XFS_BLOCKSIZE_64K
	help
	  Use 16K (16384 bytes) sector size. Requires block size >= 16K
	  and kernel LBS support.

config AI_DOCKER_XFS_SECTORSIZE_32K
	bool "32K sector size (LBS)"
	depends on AI_DOCKER_XFS_BLOCKSIZE_32K || AI_DOCKER_XFS_BLOCKSIZE_64K
	help
	  Use 32K (32768 bytes) sector size. Requires block size >= 32K
	  and kernel LBS support.

endchoice

config AI_DOCKER_XFS_SECTORSIZE
	int
	output yaml
	default 512 if AI_DOCKER_XFS_SECTORSIZE_512
	default 4096 if AI_DOCKER_XFS_SECTORSIZE_4K
	default 8192 if AI_DOCKER_XFS_SECTORSIZE_8K
	default 16384 if AI_DOCKER_XFS_SECTORSIZE_16K
	default 32768 if AI_DOCKER_XFS_SECTORSIZE_32K

config AI_DOCKER_XFS_MKFS_OPTS
	string "Additional XFS mkfs options for Docker storage"
	output yaml
	default ""
	help
	  Additional options to pass to mkfs.xfs when creating the Docker
	  storage filesystem. Block and sector sizes are configured above.

endif # AI_DOCKER_FSTYPE_XFS

config AI_DOCKER_BTRFS_MKFS_OPTS
	string "Btrfs mkfs options for Docker storage"
	output yaml
	default "-f"
	depends on AI_DOCKER_FSTYPE_BTRFS
	help
	  Options to pass to mkfs.btrfs when creating the Docker storage
	  filesystem.

config AI_DOCKER_EXT4_MKFS_OPTS
	string "ext4 mkfs options for Docker storage"
	output yaml
	default "-F"
	depends on AI_DOCKER_FSTYPE_EXT4
	help
	  Options to pass to mkfs.ext4 when creating the Docker storage
	  filesystem.

endif # AI_DOCKER_STORAGE_ENABLE

endmenu
```

## workflows/ai/Kconfig.multifs
```kconfig
menu "Multi-filesystem testing configuration"

config AI_ENABLE_MULTIFS_TESTING
	bool "Enable multi-filesystem testing"
	default n
	output yaml
	help
	  Enable testing the same AI workload across multiple filesystem
	  configurations. This allows comparing performance characteristics
	  between different filesystems and their configurations.

	  When enabled, the AI benchmark will run sequentially across all
	  selected filesystem configurations, allowing for detailed
	  performance analysis across different storage backends.

if AI_ENABLE_MULTIFS_TESTING

config AI_MULTIFS_TEST_XFS
	bool "Test XFS configurations"
	default y
	output yaml
	help
	  Enable testing AI workloads on XFS filesystem with different
	  block size configurations.

if AI_MULTIFS_TEST_XFS

menu "XFS configuration profiles"

config AI_MULTIFS_XFS_4K_4KS
	bool "XFS 4k block size - 4k sector size"
	default y
	output yaml
	help
	  Test AI workloads on XFS with 4k filesystem block size
	  and 4k sector size. This is the most common configuration
	  and provides good performance for most workloads.

config AI_MULTIFS_XFS_16K_4KS
	bool "XFS 16k block size - 4k sector size"
	default y
	output yaml
	help
	  Test AI workloads on XFS with 16k filesystem block size
	  and 4k sector size. Larger block sizes can improve performance
	  for sequential I/O patterns common in AI workloads.

config AI_MULTIFS_XFS_32K_4KS
	bool "XFS 32k block size - 4k sector size"
	default y
	output yaml
	help
	  Test AI workloads on XFS with 32k filesystem block size
	  and 4k sector size. Even larger block sizes can provide
	  benefits for large sequential I/O operations typical in
	  AI vector database workloads.

config AI_MULTIFS_XFS_64K_4KS
	bool "XFS 64k block size - 4k sector size"
	default y
	output yaml
	help
	  Test AI workloads on XFS with 64k filesystem block size
	  and 4k sector size. Maximum supported block size for XFS,
	  optimized for very large file operations and high-throughput
	  AI workloads with substantial data transfers.

endmenu

endif # AI_MULTIFS_TEST_XFS

config AI_MULTIFS_TEST_EXT4
	bool "Test ext4 configurations"
	default y
	output yaml
	help
	  Enable testing AI workloads on ext4 filesystem with different
	  configurations including bigalloc options.

if AI_MULTIFS_TEST_EXT4

menu "ext4 configuration profiles"

config AI_MULTIFS_EXT4_4K
	bool "ext4 4k block size"
	default y
	output yaml
	help
	  Test AI workloads on ext4 with standard 4k block size.
	  This is the default ext4 configuration.

config AI_MULTIFS_EXT4_16K_BIGALLOC
	bool "ext4 16k bigalloc"
	default y
	output yaml
	help
	  Test AI workloads on ext4 with 16k bigalloc enabled.
	  Bigalloc reduces metadata overhead and can improve
	  performance for large file workloads.

endmenu

endif # AI_MULTIFS_TEST_EXT4

config AI_MULTIFS_TEST_BTRFS
	bool "Test btrfs configurations"
	default y
	output yaml
	help
	  Enable testing AI workloads on btrfs filesystem with
	  common default configuration profile.

if AI_MULTIFS_TEST_BTRFS

menu "btrfs configuration profiles"

config AI_MULTIFS_BTRFS_DEFAULT
	bool "btrfs default profile"
	default y
	output yaml
	help
	  Test AI workloads on btrfs with default configuration.
	  This includes modern defaults with free-space-tree and
	  no-holes features enabled.

endmenu

endif # AI_MULTIFS_TEST_BTRFS

config AI_MULTIFS_RESULTS_DIR
	string "Multi-filesystem results directory"
	output yaml
	default "/data/ai-multifs-benchmark"
	help
	  Directory where multi-filesystem test results and logs will be stored.
	  Each filesystem configuration will have its own subdirectory.

config AI_MILVUS_STORAGE_ENABLE
	bool "Enable dedicated Milvus storage with filesystem matching node profile"
	default y
	output yaml
	help
	  Configure a dedicated storage device for Milvus data including
	  vector data (MinIO), metadata (etcd), and local cache. The filesystem
	  type will automatically match the node's configuration profile.

config AI_MILVUS_DEVICE
	string "Device to use for Milvus storage"
	output yaml
	default "/dev/disk/by-id/nvme-QEMU_NVMe_Ctrl_kdevops3" if LIBVIRT && LIBVIRT_EXTRA_STORAGE_DRIVE_NVME
	default "/dev/disk/by-id/virtio-kdevops3" if LIBVIRT && LIBVIRT_EXTRA_STORAGE_DRIVE_VIRTIO
	default "/dev/disk/by-id/ata-QEMU_HARDDISK_kdevops3" if LIBVIRT && LIBVIRT_EXTRA_STORAGE_DRIVE_IDE
	default "/dev/nvme3n1" if TERRAFORM_AWS_INSTANCE_M5AD_2XLARGE
	default "/dev/nvme3n1" if TERRAFORM_AWS_INSTANCE_M5AD_4XLARGE
	default "/dev/nvme3n1" if TERRAFORM_GCE
	default "/dev/sde" if TERRAFORM_AZURE
	default TERRAFORM_OCI_SPARSE_VOLUME_DEVICE_FILE_NAME if TERRAFORM_OCI
	help
	  The device to use for Milvus storage. This device will be
	  formatted with the filesystem type matching the node's profile
	  and mounted at /data/milvus.

config AI_MILVUS_MOUNT_POINT
	string "Mount point for Milvus storage"
	output yaml
	default "/data/milvus"
	help
	  The path where the Milvus storage filesystem will be mounted.
	  All Milvus data directories (data/, etcd/, minio/) will be
	  created under this mount point.

config AI_MILVUS_USE_NODE_FS
	bool "Automatically detect filesystem type from node name"
	default y
	output yaml
	help
	  When enabled, the filesystem type for Milvus storage will be
	  automatically determined based on the node's configuration name.
	  For example, nodes named *-xfs-* will use XFS, *-ext4-* will
	  use ext4, and *-btrfs-* will use Btrfs.

endif # AI_ENABLE_MULTIFS_TESTING

endmenu
```
