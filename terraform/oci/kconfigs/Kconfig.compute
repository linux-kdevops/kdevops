## terraform/oci/kconfigs/images/Kconfig.Ubuntu
```kconfig
if TERRAFORM_OCI_OPERATING_SYSTEM_UBUNTU

choice
	prompt "OS release"
	default TERRAFORM_OCI_OPERATING_SYSTEM_UBUNTU_24_04_ARM64 if TARGET_ARCH_ARM64
	default TERRAFORM_OCI_OPERATING_SYSTEM_UBUNTU_24_04_X86 if TARGET_ARCH_X86_64
	help
	  Select the release of Ubuntu to install on each instance.

config TERRAFORM_OCI_OPERATING_SYSTEM_UBUNTU_20_04_ARM64
	bool "Ubuntu 20.04 (aarch64)"
	depends on TARGET_ARCH_ARM64
	help
	  Canonical-Ubuntu-20.04-aarch64-2025.01.31-1

	  Image release notes:
	  https://docs.oracle.com/en-us/iaas/images/ubuntu-2004/canonical-ubuntu-20-04-aarch64-2025-01-31-1.htm

config TERRAFORM_OCI_OPERATING_SYSTEM_UBUNTU_20_04_X86
	bool "Ubuntu 20.04 (x86)"
	depends on TARGET_ARCH_X86_64
	help
	  Canonical-Ubuntu-20.04-2025.01.31-1

	  Image release notes:
	  https://docs.oracle.com/en-us/iaas/images/ubuntu-2004/canonical-ubuntu-20-04-2025-01-31-1.htm

config TERRAFORM_OCI_OPERATING_SYSTEM_UBUNTU_22_04_ARM64
	bool "Ubuntu 22.04 (aarch64)"
	depends on TARGET_ARCH_ARM64
	help
	  Canonical-Ubuntu-22.04-aarch64-2025.01.31-1

	  Image release notes:
	  https://docs.oracle.com/en-us/iaas/images/ubuntu-2204/canonical-ubuntu-22-04-aarch64-2025-01-31-1.htm

config TERRAFORM_OCI_OPERATING_SYSTEM_UBUNTU_22_04_X86
	bool "Ubuntu 22.04 (x86)"
	depends on TARGET_ARCH_X86_64
	help
	  Canonical-Ubuntu-22.04-2025.01.31-1

	  Image release notes:
	  https://docs.oracle.com/en-us/iaas/images/ubuntu-2204/canonical-ubuntu-22-04-2025-01-31-1.htm

config TERRAFORM_OCI_OPERATING_SYSTEM_UBUNTU_24_04_ARM64
	bool "Ubuntu 24.04 (aarch64)"
	depends on TARGET_ARCH_ARM64
	help
	  Canonical-Ubuntu-24.04-aarch64-2025.01.31-1

	  Image release notes:
	  https://docs.oracle.com/en-us/iaas/images/ubuntu-2404/canonical-ubuntu-24-04-aarch64-2025-01-31-1.htm

config TERRAFORM_OCI_OPERATING_SYSTEM_UBUNTU_24_04_X86
	bool "Ubuntu 24.04 (x86)"
	depends on TARGET_ARCH_X86_64
	help
	  Canonical-Ubuntu-24.04-2025.01.31-1

	  Image release notes:
	  https://docs.oracle.com/en-us/iaas/images/ubuntu-2404/canonical-ubuntu-24-04-2025-01-31-1.htm

endchoice

if TERRAFORM_OCI_OPERATING_SYSTEM_UBUNTU_20_04_ARM64

config TERRAFORM_OCI_OS_IMAGE_OCID
	string
	output yaml
	default "ocid1.image.oc1.ap-hyderabad-1.aaaaaaaawnlatjgnpqmaercoleknle5nml47l23iwnxi7ba4xup5ajyarv6q" if TERRAFORM_OCI_REGION_HYD
	default "ocid1.image.oc1.ap-mumbai-1.aaaaaaaawkgecsy7fbxqeus5zpw5n7ykyeugzizcehrildz7pzavfjrcsswa" if TERRAFORM_OCI_REGION_BOM
	default "ocid1.image.oc1.ca-montreal-1.aaaaaaaaesuvbpyo4lpim5xxx3lwj4lcppfkzp6tsape336epukyndi2pora" if TERRAFORM_OCI_REGION_YUL
	default "ocid1.image.oc1.ca-toronto-1.aaaaaaaaoox5ewo5bq67sr2spakzdiw4rrxjlgbr25ucqwglb4aonastyhzq" if TERRAFORM_OCI_REGION_YYZ
	default "ocid1.image.oc1.iad.aaaaaaaan5qjp6hcvi2ry24zp233wlotljj4llfghqbyn2yoon6wnc3se6pa" if TERRAFORM_OCI_REGION_IAD
	default "ocid1.image.oc1.us-chicago-1.aaaaaaaa7habuxhtxdty52x47eq27lq7gjweoun4urafpv2s6ysggbp6nrxa" if TERRAFORM_OCI_REGION_ORD
	default "ocid1.image.oc1.phx.aaaaaaaaji2v46qtemmx7bpuoomw2uvrsatvgxrlnp3orvdptbl6ppbal67q" if TERRAFORM_OCI_REGION_PHX
	default "ocid1.image.oc1.us-sanjose-1.aaaaaaaa2dt3oqmhwwd3z2o3wynfltfa3rms6pc2uhvr2kmjmmyvqr2li7pq" if TERRAFORM_OCI_REGION_SJC

endif # TERRAFORM_OCI_OPERATING_SYSTEM_UBUNTU_20_04_ARM64

if TERRAFORM_OCI_OPERATING_SYSTEM_UBUNTU_20_04_X86

config TERRAFORM_OCI_OS_IMAGE_OCID
	string
	output yaml
	default "ocid1.image.oc1.ap-hyderabad-1.aaaaaaaa3uvxetf4g6beur4qn2ublcl6set7qtda2rcfcv5h7vul6aut2q7q" if TERRAFORM_OCI_REGION_HYD
	default "ocid1.image.oc1.ap-mumbai-1.aaaaaaaaj276t4bm4hyqyu44mjcuzndgn6lku4th3nfaglwpiyzsp6lozqlq" if TERRAFORM_OCI_REGION_BOM
	default "ocid1.image.oc1.ca-montreal-1.aaaaaaaaagkdbfci5rxx5yikkifi7culqosi7r623osdzqv25rkanxd66dbq" if TERRAFORM_OCI_REGION_YUL
	default "ocid1.image.oc1.ca-toronto-1.aaaaaaaafbbzzsemfbol5vvyevlmqxhcv6avfo5z6larkuty4safdn3epoha" if TERRAFORM_OCI_REGION_YYZ
	default "ocid1.image.oc1.iad.aaaaaaaaw65jff6tnjbr7x2c2lr3qlf46l2sthpuidxaurmar2oxjmqry3qa" if TERRAFORM_OCI_REGION_IAD
	default "ocid1.image.oc1.us-chicago-1.aaaaaaaagyn7e55mr27m7ttkp2exvdix4ugfl2jbl66xognsge44vuqat4ma" if TERRAFORM_OCI_REGION_ORD
	default "ocid1.image.oc1.phx.aaaaaaaazjumsfmhi2tztgs7wuhesifaj2fw47xmyycltazjmr5xa6k7do7q" if TERRAFORM_OCI_REGION_PHX
	default "ocid1.image.oc1.us-sanjose-1.aaaaaaaaka77df4vad27cm7oamg3zji6ir5zrvbwbkm7ks7rvucd3bwsbqnq" if TERRAFORM_OCI_REGION_SJC

endif # TERRAFORM_OCI_OPERATING_SYSTEM_UBUNTU_20_04_X86

if TERRAFORM_OCI_OPERATING_SYSTEM_UBUNTU_22_04_ARM64

config TERRAFORM_OCI_OS_IMAGE_OCID
	string
	output yaml
	default "ocid1.image.oc1.ap-hyderabad-1.aaaaaaaaca7s2s5pgnooszcjysi7pknrimayqjds6knvjascphe2r767m6vq" if TERRAFORM_OCI_REGION_HYD
	default "ocid1.image.oc1.ap-mumbai-1.aaaaaaaamvlfwzlzk6jkyuhoylf6k3n5r7tz6m2lvf5fqjdpsrdwqk2dtcqa" if TERRAFORM_OCI_REGION_BOM
	default "ocid1.image.oc1.ca-montreal-1.aaaaaaaai6c6hx7wvx5l3oikjcv7am3n23etmbuu3byic3grzhx5ylthigca" if TERRAFORM_OCI_REGION_YUL
	default "ocid1.image.oc1.ca-toronto-1.aaaaaaaa7fy2cysnjwlpoghk5ax65jmvyteg4bjmji6xmm4gti6xg4kmgfia" if TERRAFORM_OCI_REGION_YYZ
	default "ocid1.image.oc1.iad.aaaaaaaaq3uhgye3ryjqjcnnmtk5u4ipa5ffhxawa6nvgelzccz5x3pfel4a" if TERRAFORM_OCI_REGION_IAD
	default "ocid1.image.oc1.us-chicago-1.aaaaaaaar5u2rj2ahg2btnlmnxhzijozcuqb5lhjit327wesufuhjkytfwha" if TERRAFORM_OCI_REGION_ORD
	default "ocid1.image.oc1.phx.aaaaaaaa7f6r242tdb2roknj3odb264g2tduvc2je2u4kbp3hqatiy4sngcq" if TERRAFORM_OCI_REGION_PHX
	default "ocid1.image.oc1.us-sanjose-1.aaaaaaaax6vsn7c34viq7yfu3j3v554x6dulorapywrorheltorxoi5on4dq" if TERRAFORM_OCI_REGION_SJC

endif # TERRAFORM_OCI_OPERATING_SYSTEM_UBUNTU_22_04_ARM64

if TERRAFORM_OCI_OPERATING_SYSTEM_UBUNTU_22_04_X86

config TERRAFORM_OCI_OS_IMAGE_OCID
	string
	output yaml
	default "ocid1.image.oc1.ap-hyderabad-1.aaaaaaaalldybw6d43ihqwcqeeedsncrl4s7qfczeqwq2eb5cohxj2gyp72q" if TERRAFORM_OCI_REGION_HYD
	default "ocid1.image.oc1.ap-mumbai-1.aaaaaaaaooprivsfvvblwxhl2oww3djmz4mnjxjqczxunvahu5dvt3dwlfka" if TERRAFORM_OCI_REGION_BOM
	default "ocid1.image.oc1.ca-montreal-1.aaaaaaaadstv5y7ovuhvg354zu4mocto6eyy4frnnfartpl34hmaupg6upka" if TERRAFORM_OCI_REGION_YUL
	default "ocid1.image.oc1.ca-toronto-1.aaaaaaaaf6wyj6ap2frgctd7xj7pkxwvj7gowxinvy6xbjzz3z4cv2d5ycfa" if TERRAFORM_OCI_REGION_YYZ
	default "ocid1.image.oc1.iad.aaaaaaaablkb5j2kdyqehb7qp2scdyuwslknidn4a53qzje2fxcbw3ji5gta" if TERRAFORM_OCI_REGION_IAD
	default "ocid1.image.oc1.us-chicago-1.aaaaaaaa3dfmmuqlupm4gruk5weh5mncxbmfzn36uoj2relmdwvud44zc3ea" if TERRAFORM_OCI_REGION_ORD
	default "ocid1.image.oc1.phx.aaaaaaaaccxuq5zox772ncsaggg52xngwcipzfqoqwu7x73owhvd7ula7xpa" if TERRAFORM_OCI_REGION_PHX
	default "ocid1.image.oc1.us-sanjose-1.aaaaaaaappswsfuaodghkbps5kjh3bhjxxpaig56wiirxhjlo5tktsuypkha" if TERRAFORM_OCI_REGION_SJC

endif # TERRAFORM_OCI_OPERATING_SYSTEM_UBUNTU_22_04_X86

if TERRAFORM_OCI_OPERATING_SYSTEM_UBUNTU_24_04_ARM64

config TERRAFORM_OCI_OS_IMAGE_OCID
	string
	output yaml
	default "ocid1.image.oc1.ap-hyderabad-1.aaaaaaaagkujhljfnogpc4zmmith4sbyh32ltdnxrjx7wksssyv3yv3xkasq" if TERRAFORM_OCI_REGION_HYD
	default "ocid1.image.oc1.ap-mumbai-1.aaaaaaaat27vwnwxtqovgbceettrrkmvlgwgyn3vj7rhyblih7omqhi4cioa" if TERRAFORM_OCI_REGION_BOM
	default "ocid1.image.oc1.ca-montreal-1.aaaaaaaayojwvhljgwqgpdyqcqdjh4jgbcfd6hu2axdogi4c3si5stmdcjxa" if TERRAFORM_OCI_REGION_YUL
	default "ocid1.image.oc1.ca-toronto-1.aaaaaaaaj4vzogabouc3ypajurmwx53juolg745la7mmi4qj3grijoaziwlq" if TERRAFORM_OCI_REGION_YYZ
	default "ocid1.image.oc1.iad.aaaaaaaahga37ytba47p2msqzbh5erbqvniyybcvteuh646vgyw4tltustka" if TERRAFORM_OCI_REGION_IAD
	default "ocid1.image.oc1.us-chicago-1.aaaaaaaasghgl3azcm2kjya2p7urk4nnpfjlrxlfeosn5jc6hm5epn7gkrra" if TERRAFORM_OCI_REGION_ORD
	default "ocid1.image.oc1.phx.aaaaaaaag7js2gmz5yrqtnnjirri52hyqvsymn7gp5a7gwg5jtd2jowpi7tq" if TERRAFORM_OCI_REGION_PHX
	default "ocid1.image.oc1.us-sanjose-1.aaaaaaaatsp47wenhtuubuusyi2pgohpnal5fz6jyz4ur5n4juwhj2n2egpq" if TERRAFORM_OCI_REGION_SJC

endif # TERRAFORM_OCI_OPERATING_SYSTEM_UBUNTU_24_04_ARM64

if TERRAFORM_OCI_OPERATING_SYSTEM_UBUNTU_24_04_X86

config TERRAFORM_OCI_OS_IMAGE_OCID
	string
	output yaml
	default "ocid1.image.oc1.ap-hyderabad-1.aaaaaaaakzztav5leofa43dcc7uecenhjhazdxlaj7u3kgnfsu65fcw6c5wa" if TERRAFORM_OCI_REGION_HYD
	default "ocid1.image.oc1.ap-mumbai-1.aaaaaaaayvok7wg6qwbf2nfeohcqroie2eyplrlxsuwjut7rdugg7jftk7pa" if TERRAFORM_OCI_REGION_BOM
	default "ocid1.image.oc1.ca-montreal-1.aaaaaaaa33jzjdmexcf5zaiia2mhjou5xsgatzaqm4mwgqejp2f77bnjhwpa" if TERRAFORM_OCI_REGION_YUL
	default "ocid1.image.oc1.ca-toronto-1.aaaaaaaadtwzeffczkghs325xbzeocp4i7ghpeims5insf6a65kxcpmk4bwq" if TERRAFORM_OCI_REGION_YYZ
	default "ocid1.image.oc1.iad.aaaaaaaaaja5re7chpwbyrdk57xya7qoxdktskrn5lph7fsuai5zccaefawa" if TERRAFORM_OCI_REGION_IAD
	default "ocid1.image.oc1.us-chicago-1.aaaaaaaaslqsnubarsgmpktkbewqedpf76vp6e5k7nafoxpx3aaryag2a6ba" if TERRAFORM_OCI_REGION_ORD
	default "ocid1.image.oc1.phx.aaaaaaaapplpp6okoc73a23mdag6k6mwgscofpx2p7bcigeo3ztjktsd53pa" if TERRAFORM_OCI_REGION_PHX
	default "ocid1.image.oc1.us-sanjose-1.aaaaaaaaebdhewufiuvsm6kh2eccurg5zdchwfr24heayt4h4bwenee3lwka" if TERRAFORM_OCI_REGION_SJC

endif # TERRAFORM_OCI_OPERATING_SYSTEM_UBUNTU_24_04_X86

endif # TERRAFORM_OCI_OPERATING_SYSTEM_UBUNTU
```

## terraform/oci/kconfigs/images/Kconfig.custom
```kconfig
if TERRAFORM_OCI_OPERATING_SYSTEM_CUSTOM

config TERRAFORM_OCI_OS_IMAGE_OCID
	string "OS image OCID"
	output yaml
	help
	  An image is a template of a virtual hard drive. It
	  contains the operating system and other software for each
	  instance. Select an image by specifying the OCID of the
	  image to use. You can select:

	  - An older release than the latest image release
	  - An older operating system release
	  - A custom-made image

	  More detail is available:

	  https://docs.oracle.com/en-us/iaas/Content/Compute/References/bringyourownimage.htm

endif # TERRAFORM_OCI_OPERATING_SYSTEM_CUSTOM
```

## terraform/oci/kconfigs/regions/Kconfig.ap-hyderabad-1
```kconfig
if TERRAFORM_OCI_REGION_HYD

config TERRAFORM_OCI_REGION
	string
	output yaml
	default "ap-hyderabad-1"

choice
	prompt "Availability Domain"
	default TERRAFORM_OCI_REGION_HYD_AD1
	help
	  The number of the Availability Domain. This number
	  corresponds to the integer at the end of the Availability
	  Domain name.

	  The OCI Fault Domain is chosen automatically.

config TERRAFORM_OCI_REGION_HYD_AD1
	bool "1"

endchoice

config TERRAFORM_OCI_AD_NUMBER
	int
	output yaml
	default 1 if TERRAFORM_OCI_REGION_HYD_1_AD1

endif # TERRAFORM_OCI_REGION_HYD_1
```

## terraform/oci/kconfigs/regions/Kconfig.ca-montreal-1
```kconfig
if TERRAFORM_OCI_REGION_YUL

config TERRAFORM_OCI_REGION
	string
	output yaml
	default "ca-montreal-1"

choice
	prompt "Availability Domain"
	default TERRAFORM_OCI_REGION_YUL_AD1
	help
	  The number of the Availability Domain. This number
	  corresponds to the integer at the end of the Availability
	  Domain name.

	  The OCI Fault Domain is chosen automatically.

config TERRAFORM_OCI_REGION_YUL_AD1
	bool "1"

endchoice

config TERRAFORM_OCI_AD_NUMBER
	int
	output yaml
	default 1 if TERRAFORM_OCI_REGION_YUL_AD1

endif # TERRAFORM_OCI_REGION_YUL
```

## terraform/oci/kconfigs/regions/Kconfig.us-phoenix-1
```kconfig
if TERRAFORM_OCI_REGION_PHX

config TERRAFORM_OCI_REGION
	string
	output yaml
	default "us-phoenix-1"

choice
	prompt "Availability Domain"
	default TERRAFORM_OCI_REGION_PHX_AD1
	help
	  The number of the Availability Domain. This number
	  corresponds to the integer at the end of the Availability
	  Domain name.

	  The OCI Fault Domain is chosen automatically.

config TERRAFORM_OCI_REGION_PHX_AD1
	bool "1"

config TERRAFORM_OCI_REGION_PHX_AD2
	bool "2"

config TERRAFORM_OCI_REGION_PHX_AD3
	bool "3"

endchoice

config TERRAFORM_OCI_AD_NUMBER
	int
	output yaml
	default 1 if TERRAFORM_OCI_REGION_PHX_AD1
	default 2 if TERRAFORM_OCI_REGION_PHX_AD2
	default 3 if TERRAFORM_OCI_REGION_PHX_AD3

endif # TERRAFORM_OCI_REGION_PHX
```

## terraform/oci/kconfigs/shapes/Kconfig.bm
```kconfig
if TERRAFORM_OCI_SHAPE_FAMILY_BARE_METAL

choice
	prompt "OCI shape"
	default TERRAFORM_OCI_SHAPE_BM_STANDARD3
	help
	  Select the basic hardware capabilities that are in each
	  instance. For more details, see:

	  https://docs.oracle.com/en-us/iaas/Content/Compute/References/computeshapes.htm#baremetalshapes

config TERRAFORM_OCI_SHAPE_BM_STANDARD3
	bool "BM.Standard3"
	depends on TARGET_ARCH_X86_64
	help
	  X9-based standard compute. Processor: Intel Xeon Platinum
	  8358. Base frequency 2.6 GHz, max turbo frequency 3.4 GHz.

config TERRAFORM_OCI_SHAPE_BM_STANDARD_E4
	bool "BM.Standard.E4"
	depends on TARGET_ARCH_X86_64
	help
	  E4-based standard compute. Processor: AMD EPYC 7J13. Base
	  frequency 2.55 GHz, max boost frequency 3.5 GHz.

config TERRAFORM_OCI_SHAPE_BM_STANDARD_E5
	bool "BM.Standard.E5"
	depends on TARGET_ARCH_X86_64
	help
	  E5-based standard compute. Processor: AMD EPYC 9J14. Base
	  frequency 2.4 GHz, max boost frequency 3.7 GHz.

config TERRAFORM_OCI_SHAPE_BM_STANDARD_A1
	bool "BM.Standard.A1"
	depends on TARGET_ARCH_ARM64
	help
	  OCI Ampere A1 Compute Arm-based standard compute. Each
	  OCPU corresponds to a single hardware execution thread.
	  Processor: Ampere Altra Q80-30. Max frequency 3.0 GHz.

config TERRAFORM_OCI_SHAPE_BM_DENSEIO_E4
	bool "BM.DenseIO.E4"
	depends on TARGET_ARCH_X86_64
	help
	  E4-based dense I/O compute. Processor: AMD EPYC 7J13.
	  Base frequency 2.55 GHz, max boost frequency 3.5 GHz.

config TERRAFORM_OCI_SHAPE_BM_DENSEIO_E5
	bool "BM.DenseIO.E5"
	depends on TARGET_ARCH_X86_64
	help
	  E5-based dense I/O compute. Processor: AMD EPYC 9J14.
	  Base frequency 2.4 GHz, max boost frequency 3.7 GHz.

config TERRAFORM_OCI_SHAPE_BM_OPTIMIZED3
	bool "BM.Optimized3"
	depends on TARGET_ARCH_X86_64
	help
	  Processor: Intel Xeon 6354. Base frequency 3.0 GHz, max
	  turbo frequency 3.6 GHz.

config TERRAFORM_OCI_SHAPE_BM_HPC_E5
	bool "BM.HPC.E5"
	depends on TARGET_ARCH_X86_64
	help
	  Processor: AMD EPYC 9J14. Base frequency 2.4 GHz, max
	  boost frequency 3.7 GHz.

endchoice

config TERRAFORM_OCI_SHAPE
	string
	output yaml
	default "BM.Standard3" if TERRAFORM_OCI_SHAPE_BM_STANDARD3
	default "BM.Standard.E4" if TERRAFORM_OCI_SHAPE_BM_STANDARD_E4
	default "BM.Standard.E5" if TERRAFORM_OCI_SHAPE_BM_STANDARD_E5
	default "BM.Standard.A1" if TERRAFORM_OCI_SHAPE_BM_STANDARD_A1
	default "BM.DenseIO.E4" if TERRAFORM_OCI_SHAPE_BM_DENSEIO_E4
	default "BM.DenseIO.E5" if TERRAFORM_OCI_SHAPE_BM_DENSEIO_E5
	default "BM.Optimized3" if TERRAFORM_OCI_SHAPE_BM_OPTIMIZED3
	default "BM.HPC.E5" if TERRAFORM_OCI_SHAPE_BM_HPC_E5

endif # TERRAFORM_OCI_SHAPE_FAMILY_BARE_METAL
```
