## terraform/gce/kconfigs/images/Kconfig.centos
```kconfig
if TERRAFORM_GCE_DISTRO_CENTOS

config TERRAFORM_GCE_IMAGE_PROJECT
	string
	output yaml
	default "centos-cloud"

config TERRAFORM_GCE_IMAGE_SIZE
	int
	output yaml
	default 20

if TARGET_ARCH_X86_64

choice
	prompt "OS image to use"
	default TERRAFORM_GCE_IMAGE_CENTOS_STREAM_9_X86_64

config TERRAFORM_GCE_IMAGE_CENTOS_STREAM_9_X86_64
	bool "CentOS Stream 9 (x86)"

endchoice

config TERRAFORM_GCE_IMAGE_FAMILY
	string
	output yaml
	default "centos-stream-9" if TERRAFORM_GCE_IMAGE_CENTOS_STREAM_9_X86_64

endif # TARGET_ARCH_X86_64

if TARGET_ARCH_ARM64

choice
	prompt "OS image to use"
	default TERRAFORM_GCE_IMAGE_CENTOS_STREAM_9_ARM64

config TERRAFORM_GCE_IMAGE_CENTOS_STREAM_9_ARM64
	bool "CentOS Stream 9 (arm64)"

endchoice

config TERRAFORM_GCE_IMAGE_FAMILY
	string
	output yaml
	default "centos-stream-9-arm64" if TERRAFORM_GCE_IMAGE_CENTOS_STREAM_9_ARM64

endif # TARGET_ARCH_ARM64

endif # TERRAFORM_GCE_DISTRO_CENTOS
```

## terraform/gce/kconfigs/images/Kconfig.debian
```kconfig
if TERRAFORM_GCE_DISTRO_DEBIAN

config TERRAFORM_GCE_IMAGE_PROJECT
	string
	output yaml
	default "debian-cloud"

config TERRAFORM_GCE_IMAGE_SIZE
	int
	output yaml
	default 10

if TARGET_ARCH_X86_64

choice
	prompt "OS image to use"
	default TERRAFORM_GCE_IMAGE_DEBIAN_11_X86_64

config TERRAFORM_GCE_IMAGE_DEBIAN_11_X86_64
	bool "Debian-11 Bullseye (x86)"

config TERRAFORM_GCE_IMAGE_DEBIAN_12_X86_64
	bool "Debian-12 Bookworm (x86)"

endchoice

config TERRAFORM_GCE_IMAGE_FAMILY
	string
	output yaml
	default "debian-11" if TERRAFORM_GCE_IMAGE_DEBIAN_11_X86_64
	default "debian-12" if TERRAFORM_GCE_IMAGE_DEBIAN_12_X86_64

endif # TARGET_ARCH_X86_64

if TARGET_ARCH_ARM64

choice
	prompt "OS image to use"
	default TERRAFORM_GCE_IMAGE_DEBIAN_12_ARM64

config TERRAFORM_GCE_IMAGE_DEBIAN_12_ARM64
	bool "Debian-12 Bookworm (arm64)"

endchoice

config TERRAFORM_GCE_IMAGE_FAMILY
	string
	output yaml
	default "debian-12-arm64" if TERRAFORM_GCE_IMAGE_DEBIAN_12_ARM64

endif # TARGET_ARCH_ARM64

endif # TERRAFORM_GCE_DISTRO_DEBIAN
```

## terraform/gce/kconfigs/images/Kconfig.fedora
```kconfig
if TERRAFORM_GCE_DISTRO_FEDORA

config TERRAFORM_GCE_IMAGE_PROJECT
	string
	output yaml
	default "fedora-coreos-cloud"

config TERRAFORM_GCE_IMAGE_SIZE
	int
	output yaml
	default 10

if TARGET_ARCH_X86_64

choice
	prompt "Fedora stream to use"
	default TERRAFORM_GCE_IMAGE_FEDORA_STABLE_X86_64

config TERRAFORM_GCE_IMAGE_FEDORA_STABLE_X86_64
	bool "stable (x86)"
	help
	  The stable stream is the most reliable stream offered with
	  changes only reaching that stream after spending a period
	  of time in the testing stream.

config TERRAFORM_GCE_IMAGE_FEDORA_TESTING_X86_64
	bool "testing (x86)"
	help
	  The testing stream represents what is coming in the next
	  stable release. Content in this stream is updated
	  regularly and offers our community an opportunity to catch
	  breaking changes before they hit the stable stream.

config TERRAFORM_GCE_IMAGE_FEDORA_NEXT_X86_64
	bool "next (x86)"
	help
	  The next stream represents the future. It will often be
	  used to experiment with new features and also test out
	  rebases of our platform on top of the next major version
	  of Fedora. The content in the next stream will also
	  eventually filter down into testing and on to stable.

endchoice

config TERRAFORM_GCE_IMAGE_FAMILY
	string
	output yaml
	default "fedora-coreos-stable" if TERRAFORM_GCE_IMAGE_FEDORA_STABLE_X86_64
	default "fedora-coreos-testing" if TERRAFORM_GCE_IMAGE_FEDORA_TESTING_X86_64
	default "fedora-coreos-next" if TERRAFORM_GCE_IMAGE_FEDORA_NEXT_X86_64

endif # TARGET_ARCH_X86_64

if TARGET_ARCH_ARM64

choice
	prompt "Fedora stream to use"
	default TERRAFORM_GCE_IMAGE_FEDORA_STABLE_ARM64

config TERRAFORM_GCE_IMAGE_FEDORA_STABLE_ARM64
	bool "stable (arm64)"
	help
	  The stable stream is the most reliable stream offered with
	  changes only reaching that stream after spending a period
	  of time in the testing stream.

config TERRAFORM_GCE_IMAGE_FEDORA_TESTING_ARM64
	bool "testing (arm64)"
	help
	  The testing stream represents what is coming in the next
	  stable release. Content in this stream is updated
	  regularly and offers our community an opportunity to catch
	  breaking changes before they hit the stable stream.

config TERRAFORM_GCE_IMAGE_FEDORA_NEXT_ARM64
	bool "next (arm64)"
	help
	  The next stream represents the future. It will often be
	  used to experiment with new features and also test out
	  rebases of our platform on top of the next major version
	  of Fedora. The content in the next stream will also
	  eventually filter down into testing and on to stable.

endchoice

config TERRAFORM_GCE_IMAGE_FAMILY
	string
	output yaml
	default "fedora-coreos-stable-arm64" if TERRAFORM_GCE_IMAGE_FEDORA_STABLE_ARM64
	default "fedora-coreos-testing-arm64" if TERRAFORM_GCE_IMAGE_FEDORA_TESTING_ARM64
	default "fedora-coreos-next-arm64" if TERRAFORM_GCE_IMAGE_FEDORA_NEXT_ARM64

endif # TARGET_ARCH_ARM64

endif # TERRAFORM_GCE_DISTRO_FEDORA
```

## terraform/gce/kconfigs/images/Kconfig.opensuse
```kconfig
if TERRAFORM_GCE_DISTRO_OPENSUSE

config TERRAFORM_GCE_IMAGE_PROJECT
	string
	output yaml
	default "opensuse-cloud"

config TERRAFORM_GCE_IMAGE_SIZE
	int
	output yaml
	default 10

if TARGET_ARCH_X86_64

choice
	prompt "OS image to use"
	default TERRAFORM_GCE_IMAGE_OPENLEAP_15_5_X86_64

config TERRAFORM_GCE_IMAGE_OPENLEAP_15_5_X86_64
	bool "OpenLeap 15.5 (x86)"

config TERRAFORM_GCE_IMAGE_OPENLEAP_15_6_X86_64
	bool "OpenLeap 15.6 (x86)"

endchoice

config TERRAFORM_GCE_IMAGE_FAMILY
	string
	output yaml
	default "opensuse-leap-15-5" if TERRAFORM_GCE_IMAGE_OPENLEAP_15_5_X86_64
	default "opensuse-leap-15-6" if TERRAFORM_GCE_IMAGE_OPENLEAP_15_6_X86_64

endif # TARGET_ARCH_X86_64

endif # TERRAFORM_GCE_DISTRO_OPENSUSE
```

## terraform/gce/kconfigs/images/Kconfig.oracle
```kconfig
if TERRAFORM_GCE_DISTRO_OL

config TERRAFORM_GCE_IMAGE_PROJECT
	string
	output yaml
	default "oracle-linux-cloud"

config TERRAFORM_GCE_IMAGE_SIZE
	int
	output yaml
	default 20

if TARGET_ARCH_X86_64

choice
	prompt "OS image to use"

config TERRAFORM_GCE_IMAGE_OL_8_X86_64
	bool "Oracle Linux 8 (x86)"

config TERRAFORM_GCE_IMAGE_OL_9_X86_64
	bool "Oracle Linux 9 (x86)"

endchoice

config TERRAFORM_GCE_IMAGE_FAMILY
	string
	output yaml
	default "oracle-linux-8" if TERRAFORM_GCE_IMAGE_OL_8_X86_64
	default "oracle-linux-9" if TERRAFORM_GCE_IMAGE_OL_9_X86_64

endif # TARGET_ARCH_X86_64

endif # TERRAFORM_GCE_DISTRO_OL
```

## terraform/gce/kconfigs/images/Kconfig.rhel
```kconfig
if TERRAFORM_GCE_DISTRO_RHEL

config TERRAFORM_GCE_IMAGE_PROJECT
	string
	output yaml
	default "rhel-cloud"

config TERRAFORM_GCE_IMAGE_SIZE
	int
	output yaml
	default 20

choice
	prompt "License type"
	default TERRAFORM_GCE_LICENSE_TYPE_PAYGO_RHEL

config TERRAFORM_GCE_LICENSE_TYPE_PAYGO_RHEL
	bool "Pay as you go"

config TERRAFORM_GCE_LICENSE_TYPE_BYOS_RHEL
	bool "Bring your own subscription or license"

endchoice

if TARGET_ARCH_X86_64

choice
	prompt "OS image to use"

config TERRAFORM_GCE_IMAGE_RHEL_8_X86_64_PAYGO
	depends on TERRAFORM_GCE_LICENSE_TYPE_PAYGO_RHEL
	bool "Red Hat Enterprise Linux 8 (x86)"

config TERRAFORM_GCE_IMAGE_RHEL_9_X86_64_PAYGO
	depends on TERRAFORM_GCE_LICENSE_TYPE_PAYGO_RHEL
	bool "Red Hat Enterprise Linux 9 (x86)"

endchoice

config TERRAFORM_GCE_IMAGE_FAMILY
	string
	output yaml
	default "rhel-8" if TERRAFORM_GCE_IMAGE_RHEL_8_X86_64_PAYGO
	default "rhel-9" if TERRAFORM_GCE_IMAGE_RHEL_9_X86_64_PAYGO

endif # TARGET_ARCH_X86_64

if TARGET_ARCH_ARM64

choice
	prompt "OS image to use"

config TERRAFORM_GCE_IMAGE_RHEL_9_ARM64_PAYGO
	depends on TERRAFORM_GCE_LICENSE_TYPE_PAYGO_RHEL
	bool "Red Hat Enterprise Linux 9 (arm64)"

endchoice

config TERRAFORM_GCE_IMAGE_FAMILY
	string
	output yaml
	default "rhel-9-arm64" if TERRAFORM_GCE_IMAGE_RHEL_9_ARM64_PAYGO

endif # TARGET_ARCH_ARM64

endif # TERRAFORM_GCE_DISTRO_RHEL
```

## terraform/gce/kconfigs/images/Kconfig.rocky
```kconfig
if TERRAFORM_GCE_DISTRO_ROCKY

config TERRAFORM_GCE_IMAGE_PROJECT
	string
	output yaml
	default "rocky-linux-cloud"

config TERRAFORM_GCE_IMAGE_SIZE
	int
	output yaml
	default 20

if TARGET_ARCH_X86_64

choice
	prompt "OS image to use"
	default TERRAFORM_GCE_IMAGE_ROCKY_8_X86_64

config TERRAFORM_GCE_IMAGE_ROCKY_8_X86_64
	bool "Rocky Linux 8 (x86)"

config TERRAFORM_GCE_IMAGE_ROCKY_9_X86_64
	bool "Rocky Linux 9 (x86)"

endchoice

config TERRAFORM_GCE_IMAGE_FAMILY
	string
	output yaml
	default "rocky-linux-8" if TERRAFORM_GCE_IMAGE_ROCKY_8_X86_64
	default "rocky-linux-9" if TERRAFORM_GCE_IMAGE_ROCKY_9_X86_64

endif # TARGET_ARCH_X86_64

if TARGET_ARCH_ARM64

choice
	prompt "OS image to use"
	default TERRAFORM_GCE_IMAGE_ROCKY_9_ARM64

config TERRAFORM_GCE_IMAGE_ROCKY_9_ARM64
	bool "Rocky Linux 9 (arm64)"

endchoice

config TERRAFORM_GCE_IMAGE_FAMILY
	string
	output yaml
	default "rocky-linux-9-arm64" if TERRAFORM_GCE_IMAGE_ROCKY_9_ARM64

endif # TARGET_ARCH_ARM64

endif # TERRAFORM_GCE_DISTRO_ROCKY
```

## terraform/gce/kconfigs/images/Kconfig.sles
```kconfig
if TERRAFORM_GCE_DISTRO_SLES

config TERRAFORM_GCE_IMAGE_PROJECT
	string
	output yaml
	default "suse-cloud"

config TERRAFORM_GCE_IMAGE_SIZE
	int
	output yaml
	default 10

if TARGET_ARCH_X86_64

choice
	prompt "OS image to use"

config TERRAFORM_GCE_IMAGE_SLES_12_X86_64
	bool "SUSE Linux Enterprise Server 12 (x86)"

config TERRAFORM_GCE_IMAGE_SLES_15_X86_64
	bool "SUSE Linux Enterprise Server 15 (x86)"

endchoice

config TERRAFORM_GCE_IMAGE_FAMILY
	string
	output yaml
	default "sles-12" if TERRAFORM_GCE_IMAGE_SLES_12_X86_64
	default "sles-15" if TERRAFORM_GCE_IMAGE_SLES_15_X86_64

endif # TARGET_ARCH_X86_64

if TARGET_ARCH_ARM64

choice
	prompt "OS image to use"

config TERRAFORM_GCE_IMAGE_SLES_15_ARM64
	bool "SUSE Linux Enterprise Server 15 (arm64)"

endchoice

config TERRAFORM_GCE_IMAGE_FAMILY
	string
	output yaml
	default "sles-15-arm64" if TERRAFORM_GCE_IMAGE_SLES_15_ARM64

endif # TARGET_ARCH_ARM64

endif # TERRAFORM_GCE_DISTRO_SLES
```

## terraform/gce/kconfigs/machines/Kconfig.a2-standard
```kconfig
if TERRAFORM_GCE_MACHINE_FAMILY_A2_HIGHGPU

choice
	prompt "GCE Machine Type"
	default TERRAFORM_GCE_MACHINE_A2_HIGHGPU_1G
	help
	  A2 High GPU machine types have a fixed number of A100
	  40GB GPUs.

config TERRAFORM_GCE_MACHINE_A2_HIGHGPU_1G
	bool "a2-highgpu-1g"
	help
	  12 vCPUs, 85GB of memory, and 1 GPU with 40GB of GPU
	  memory.

config TERRAFORM_GCE_MACHINE_A2_HIGHGPU_2G
	bool "a2-highgpu-2g"
	help
	  24 vCPUs, 170GB of memory, and 2 GPUs with 80GB of GPU
	  memory.

config TERRAFORM_GCE_MACHINE_A2_HIGHGPU_4G
	bool "a2-highgpu-4g"
	help
	  48 vCPUs, 340GB of memory, and 4 GPUs with 160GB of GPU
	  memory.

config TERRAFORM_GCE_MACHINE_A2_HIGHGPU_8G
	bool "a2-highgpu-8g"
	help
	  96 vCPUs, 680GB of memory, and 8 GPUs with 320GB of GPU
	  memory.

config TERRAFORM_GCE_MACHINE_A2_HIGHGPU_16G
	bool "a2-highgpu-16g"
	help
	  96 vCPUs, 1360GB of memory, and 16 GPUs with 640GB of GPU
	  memory.

endchoice

config TERRAFORM_GCE_MACHINE_TYPE
	string
	output yaml
	default "a2-highgpu-1g" if TERRAFORM_GCE_MACHINE_A2_HIGHGPU_1G
	default "a2-highgpu-2g" if TERRAFORM_GCE_MACHINE_A2_HIGHGPU_2G
	default "a2-highgpu-4g" if TERRAFORM_GCE_MACHINE_A2_HIGHGPU_4G
	default "a2-highgpu-8g" if TERRAFORM_GCE_MACHINE_A2_HIGHGPU_8G
	default "a2-highgpu-16g" if TERRAFORM_GCE_MACHINE_A2_HIGHGPU_16G

config TERRAFORM_GCE_IMAGE_TYPE
	string
	output yaml
	default "pd-balanced"

endif # TERRAFORM_GCE_MACHINE_FAMILY_A2_HIGHGPU
```

## terraform/gce/kconfigs/machines/Kconfig.c3-standard
```kconfig
if TERRAFORM_GCE_MACHINE_FAMILY_C3_STANDARD

choice
	prompt "GCE Machine Type"
	default TERRAFORM_GCE_MACHINE_C3_STANDARD_4
	help
	  C3 VMs are powered by the 4th generation Intel Xeon
	  Scalable processors (code-named Sapphire Rapids), DDR5
	  memory, and Titanium, enabling higher levels of networking
	  performance, isolation and security.

config TERRAFORM_GCE_MACHINE_C3_STANDARD_4
	bool "c3-standard-4"
	help
	  4 vCPUs (2 cores) and 16GB of memory.

config TERRAFORM_GCE_MACHINE_C3_STANDARD_8
	bool "c3-standard-8"
	help
	  8 vCPUs (4 cores) and 32GB of memory.

config TERRAFORM_GCE_MACHINE_C3_STANDARD_22
	bool "c3-standard-22"
	help
	  22 vCPUs (11 cores) and 88GB of memory.

endchoice

config TERRAFORM_GCE_MACHINE_TYPE
	string
	output yaml
	default "c3-standard-4" if TERRAFORM_GCE_MACHINE_C3_STANDARD_4
	default "c3-standard-8" if TERRAFORM_GCE_MACHINE_C3_STANDARD_8
	default "c3-standard-22" if TERRAFORM_GCE_MACHINE_C3_STANDARD_22

config TERRAFORM_GCE_IMAGE_TYPE
	string
	output yaml
	default "hyperdisk-balanced"

endif # TERRAFORM_GCE_MACHINE_FAMILY_C3_STANDARD
```

## terraform/gce/kconfigs/machines/Kconfig.c3d-standard
```kconfig
if TERRAFORM_GCE_MACHINE_FAMILY_C3D_STANDARD

choice
	prompt "GCE Machine Type"
	default TERRAFORM_GCE_MACHINE_C3D_STANDARD_4
	help
	  C3D VMs are powered by the 4th-gen AMD EPYC (Genoa)
	  processor. C3D uses Titanium, enabling higher levels
	  of networking performance, isolation and security.

config TERRAFORM_GCE_MACHINE_C3D_STANDARD_4
	bool "c3d-standard-4"
	help
	  4 vCPUs (2 cores) and 16GB of memory.

config TERRAFORM_GCE_MACHINE_C3D_STANDARD_8
	bool "c3d-standard-8"
	help
	  8 vCPUs (4 cores) and 32GB of memory.

config TERRAFORM_GCE_MACHINE_C3D_STANDARD_16
	bool "c3d-standard-16"
	help
	  16 vCPUs (8 cores) and 64GB of memory.

config TERRAFORM_GCE_MACHINE_C3D_STANDARD_30
	bool "c3d-standard-30"
	help
	  30 vCPUs (15 cores) and 120GB of memory.

endchoice

config TERRAFORM_GCE_MACHINE_TYPE
	string
	output yaml
	default "c3d-standard-4" if TERRAFORM_GCE_MACHINE_C3D_STANDARD_4
	default "c3d-standard-8" if TERRAFORM_GCE_MACHINE_C3D_STANDARD_8
	default "c3d-standard-16" if TERRAFORM_GCE_MACHINE_C3D_STANDARD_16
	default "c3d-standard-30" if TERRAFORM_GCE_MACHINE_C3D_STANDARD_30

config TERRAFORM_GCE_IMAGE_TYPE
	string
	output yaml
	default "hyperdisk-balanced"

endif # TERRAFORM_GCE_MACHINE_FAMILY_C3D_STANDARD
```

## terraform/gce/kconfigs/machines/Kconfig.c4-standard
```kconfig
if TERRAFORM_GCE_MACHINE_FAMILY_C4_STANDARD

choice
	prompt "GCE Machine Type"
	default TERRAFORM_GCE_MACHINE_C4_STANDARD_4
	help
	  C4 VMs are powered by 6th generation (code-named Granite
	  Rapids) or 5th generation (code-named Emerald Rapids)
	  Intel Xeon Scalable processors and Titanium.

config TERRAFORM_GCE_MACHINE_C4_STANDARD_2
	bool "c4-standard-2"
	help
	  2 vCPUs (1 core) and 7GB of memory.

config TERRAFORM_GCE_MACHINE_C4_STANDARD_4
	bool "c4-standard-4"
	help
	  4 vCPUs (2 core) and 15GB of memory.

config TERRAFORM_GCE_MACHINE_C4_STANDARD_8
	bool "c4-standard-8"
	help
	  8 vCPUs (4 cores) and 30GB of memory.

config TERRAFORM_GCE_MACHINE_C4_STANDARD_16
	bool "c4-standard-16"
	help
	  16 vCPUs (8 cores) and 60GB of memory.

config TERRAFORM_GCE_MACHINE_C4_STANDARD_24
	bool "c4-standard-24"
	help
	  24 vCPUs (12 cores) and 90GB of memory.

config TERRAFORM_GCE_MACHINE_C4_STANDARD_32
	bool "c4-standard-32"
	help
	  32 vCPUs (16 cores) and 120 of memory.

endchoice

config TERRAFORM_GCE_MACHINE_TYPE
	string
	output yaml
	default "c4-standard-2" if TERRAFORM_GCE_MACHINE_C4_STANDARD_2
	default "c4-standard-4" if TERRAFORM_GCE_MACHINE_C4_STANDARD_4
	default "c4-standard-8" if TERRAFORM_GCE_MACHINE_C4_STANDARD_8
	default "c4-standard-16" if TERRAFORM_GCE_MACHINE_C4_STANDARD_16
	default "c4-standard-24" if TERRAFORM_GCE_MACHINE_C4_STANDARD_24
	default "c4-standard-32" if TERRAFORM_GCE_MACHINE_C4_STANDARD_32

config TERRAFORM_GCE_IMAGE_TYPE
	string
	output yaml
	default "hyperdisk-balanced"

endif # TERRAFORM_GCE_MACHINE_FAMILY_C4_STANDARD
```
