## terraform/gce/kconfigs/machines/Kconfig.c4a-standard
```kconfig
if TERRAFORM_GCE_MACHINE_FAMILY_C4A_STANDARD

choice
	prompt "GCE Machine Type"
	default TERRAFORM_GCE_MACHINE_C4A_STANDARD_4
	help
	  C4A VMs are powered by Google's first Arm-based Axion™
	  processor, DDR5 memory, and local Titanium SSDs.

config TERRAFORM_GCE_MACHINE_C4A_STANDARD_1
	bool "c4a-standard-1"
	help
	  1 vCPU and 4GB of memory.

config TERRAFORM_GCE_MACHINE_C4A_STANDARD_2
	bool "c4a-standard-2"
	help
	  2 vCPUs and 8GB of memory.

config TERRAFORM_GCE_MACHINE_C4A_STANDARD_4
	bool "c4a-standard-4"
	help
	  4 vCPUs and 16GB of memory.

config TERRAFORM_GCE_MACHINE_C4A_STANDARD_8
	bool "c4a-standard-8"
	help
	  8 vCPUs and 32GB of memory.

config TERRAFORM_GCE_MACHINE_C4A_STANDARD_16
	bool "c4a-standard-16"
	help
	  16 vCPUs and 64GB of memory.

config TERRAFORM_GCE_MACHINE_C4A_STANDARD_32
	bool "c4a-standard-32"
	help
	  32 vCPUs and 128GB of memory.

endchoice

config TERRAFORM_GCE_MACHINE_TYPE
	string
	output yaml
	default "c4a-standard-1" if TERRAFORM_GCE_MACHINE_C4A_STANDARD_1
	default "c4a-standard-2" if TERRAFORM_GCE_MACHINE_C4A_STANDARD_2
	default "c4a-standard-4" if TERRAFORM_GCE_MACHINE_C4A_STANDARD_4
	default "c4a-standard-8" if TERRAFORM_GCE_MACHINE_C4A_STANDARD_8
	default "c4a-standard-16" if TERRAFORM_GCE_MACHINE_C4A_STANDARD_16
	default "c4a-standard-32" if TERRAFORM_GCE_MACHINE_C4A_STANDARD_32

config TERRAFORM_GCE_IMAGE_TYPE
	string
	output yaml
	default "hyperdisk-balanced"

endif # TERRAFORM_GCE_MACHINE_FAMILY_C4A_STANDARD
```

## terraform/gce/kconfigs/machines/Kconfig.c4d-standard
```kconfig
if TERRAFORM_GCE_MACHINE_FAMILY_C4D_STANDARD

choice
	prompt "GCE Machine Type"
	default TERRAFORM_GCE_MACHINE_C4D_STANDARD_4
	help
	  C4D VMs are powered by the fifth generation AMD EPYC Turin
	  processor and Titanium.

config TERRAFORM_GCE_MACHINE_C4D_STANDARD_2
	bool "c4d-standard-2"
	help
	  2 vCPUs (1 core) and 7GB of memory.

config TERRAFORM_GCE_MACHINE_C4D_STANDARD_4
	bool "c4d-standard-4"
	help
	  4 vCPUs (2 core) and 15GB of memory.

config TERRAFORM_GCE_MACHINE_C4D_STANDARD_8
	bool "c4d-standard-8"
	help
	  8 vCPUs (4 cores) and 31GB of memory.

config TERRAFORM_GCE_MACHINE_C4D_STANDARD_16
	bool "c4d-standard-16"
	help
	  16 vCPUs (8 cores) and 62GB of memory.

config TERRAFORM_GCE_MACHINE_C4D_STANDARD_24
	bool "c4d-standard-24"
	help
	  32 vCPUs (16 cores) and 124GB of memory.

endchoice

config TERRAFORM_GCE_MACHINE_TYPE
	string
	output yaml
	default "c4d-standard-2" if TERRAFORM_GCE_MACHINE_C4D_STANDARD_2
	default "c4d-standard-4" if TERRAFORM_GCE_MACHINE_C4D_STANDARD_4
	default "c4d-standard-8" if TERRAFORM_GCE_MACHINE_C4D_STANDARD_8
	default "c4d-standard-16" if TERRAFORM_GCE_MACHINE_C4D_STANDARD_16
	default "c4d-standard-32" if TERRAFORM_GCE_MACHINE_C4D_STANDARD_32

config TERRAFORM_GCE_IMAGE_TYPE
	string
	output yaml
	default "hyperdisk-balanced"

endif # TERRAFORM_GCE_MACHINE_FAMILY_C4D_STANDARD
```

## terraform/gce/kconfigs/machines/Kconfig.e2-highcpu
```kconfig
if TERRAFORM_GCE_MACHINE_FAMILY_E2_HIGHCPU

choice
	prompt "GCE Machine type"
	default TERRAFORM_GCE_MACHINE_E2_HIGHCPU_8
	help
	  The E2 machine series offers both Intel and AMD EPYC
	  processors, selected for you at the time of VM creation.
	  Machine types in this series are available in all regions
	  and zones and support a virtio memory balloon device.

config TERRAFORM_GCE_MACHINE_E2_HIGHCPU_2
	bool "e2-highcpu-2"
	depends on TARGET_ARCH_X86_64
	help
	  2 vCPUs (1 core) and 2GB of memory.

config TERRAFORM_GCE_MACHINE_E2_HIGHCPU_4
	bool "e2-highcpu-4"
	depends on TARGET_ARCH_X86_64
	help
	  4 vCPUs (2 cores) and 4GB of memory.

config TERRAFORM_GCE_MACHINE_E2_HIGHCPU_8
	bool "e2-highcpu-8"
	depends on TARGET_ARCH_X86_64
	help
	  8 vCPUs (4 cores) and 8GB of memory.

config TERRAFORM_GCE_MACHINE_E2_HIGHCPU_16
	bool "e2-highcpu-16"
	depends on TARGET_ARCH_X86_64
	help
	  16 vCPUs (8 cores) and 16GB of memory.

config TERRAFORM_GCE_MACHINE_E2_HIGHCPU_32
	bool "e2-highcpu-32"
	depends on TARGET_ARCH_X86_64
	help
	  32 vCPUs (16 cores) and 32GB of memory.

endchoice

config TERRAFORM_GCE_MACHINE_TYPE
	string
	output yaml
	default "e2-highcpu-2" if TERRAFORM_GCE_MACHINE_E2_HIGHCPU_2
	default "e2-highcpu-4" if TERRAFORM_GCE_MACHINE_E2_HIGHCPU_4
	default "e2-highcpu-8" if TERRAFORM_GCE_MACHINE_E2_HIGHCPU_8
	default "e2-highcpu-16" if TERRAFORM_GCE_MACHINE_E2_HIGHCPU_16
	default "e2-highcpu-32" if TERRAFORM_GCE_MACHINE_E2_HIGHCPU_32

config TERRAFORM_GCE_IMAGE_TYPE
	string
	output yaml
	default "pd-balanced"

endif # TERRAFORM_GCE_MACHINE_FAMILY_E2_HIGHCPU
```

## terraform/gce/kconfigs/machines/Kconfig.n1-highcpu
```kconfig
if TERRAFORM_GCE_MACHINE_FAMILY_N1_HIGHCPU

choice
	prompt "GCE Machine type"
	default TERRAFORM_GCE_MACHINE_N1_HIGHCPU_8
	help
	  The N1 machine series is Compute Engine's first generation
	  general-purpose machine series available on Intel Skylake,
	  Broadwell, Haswell, Sandy Bridge, and Ivy Bridge CPU
	  platforms.

config TERRAFORM_GCE_MACHINE_N1_HIGHCPU_2
	bool "n1-highcpu-2"
	help
	  2 vCPUs (1 core) and 1.8GB of memory.

config TERRAFORM_GCE_MACHINE_N1_HIGHCPU_4
	bool "n1-highcpu-4"
	help
	  4 vCPUs (2 cores) and 3.6GB of memory.

config TERRAFORM_GCE_MACHINE_N1_HIGHCPU_8
	bool "n1-highcpu-8"
	help
	  8 vCPUs (4 cores) and 7.2GB of memory.

config TERRAFORM_GCE_MACHINE_N1_HIGHCPU_16
	bool "n1-highcpu-16"
	depends on TARGET_ARCH_X86_64
	help
	  16 vCPUs (8 cores) and 14.4GB of memory.

config TERRAFORM_GCE_MACHINE_N1_HIGHCPU_32
	bool "n1-highcpu-32"
	depends on TARGET_ARCH_X86_64
	help
	  32 vCPUs (16 cores) and 28.8GB of memory.

endchoice

config TERRAFORM_GCE_MACHINE_TYPE
	string
	output yaml
	default "n1-highcpu-2" if TERRAFORM_GCE_MACHINE_N1_HIGHCPU_2
	default "n1-highcpu-4" if TERRAFORM_GCE_MACHINE_N1_HIGHCPU_4
	default "n1-highcpu-8" if TERRAFORM_GCE_MACHINE_N1_HIGHCPU_8
	default "n1-highcpu-16" if TERRAFORM_GCE_MACHINE_N1_HIGHCPU_16
	default "n1-highcpu-32" if TERRAFORM_GCE_MACHINE_N1_HIGHCPU_32

config TERRAFORM_GCE_IMAGE_TYPE
	string
	output yaml
	default "pd-balanced"

endif # TERRAFORM_GCE_MACHINE_FAMILY_N1_HIGHCPU
```

## terraform/gce/kconfigs/machines/Kconfig.n1-standard
```kconfig
if TERRAFORM_GCE_MACHINE_FAMILY_N1_STANDARD

choice
	prompt "GCE Machine type"
	default TERRAFORM_GCE_MACHINE_N1_STANDARD_8
	help
	  The N1 machine series is Compute Engine's first generation
	  general-purpose machine series available on Intel Skylake,
	  Broadwell, Haswell, Sandy Bridge, and Ivy Bridge CPU
	  platforms.

config TERRAFORM_GCE_MACHINE_N1_STANDARD_1
	bool "n1-standard-1"
	help
	  1 vCPU and 3.75GB of memory.

config TERRAFORM_GCE_MACHINE_N1_STANDARD_2
	bool "n1-standard-2"
	help
	  2 vCPUs (1 core) and 7.5GB of memory.

config TERRAFORM_GCE_MACHINE_N1_STANDARD_4
	bool "n1-standard-4"
	help
	  4 vCPUs (2 cores) and 15GB of memory.

config TERRAFORM_GCE_MACHINE_N1_STANDARD_8
	bool "n1-standard-8"
	help
	  8 vCPUs (4 cores) and 30GB of memory.

config TERRAFORM_GCE_MACHINE_N1_STANDARD_16
	bool "n1-standard-16"
	depends on TARGET_ARCH_X86_64
	help
	  16 vCPUs (8 cores) and 60GB of memory.

config TERRAFORM_GCE_MACHINE_N1_STANDARD_32
	bool "n1-standard-32"
	depends on TARGET_ARCH_X86_64
	help
	  32 vCPUs (16 cores) and 120GB of memory.

endchoice

config TERRAFORM_GCE_MACHINE_TYPE
	string
	output yaml
	default "n1-standard-1" if TERRAFORM_GCE_MACHINE_N1_STANDARD_1
	default "n1-standard-2" if TERRAFORM_GCE_MACHINE_N1_STANDARD_2
	default "n1-standard-4" if TERRAFORM_GCE_MACHINE_N1_STANDARD_4
	default "n1-standard-8" if TERRAFORM_GCE_MACHINE_N1_STANDARD_8
	default "n1-standard-16" if TERRAFORM_GCE_MACHINE_N1_STANDARD_16
	default "n1-standard-32" if TERRAFORM_GCE_MACHINE_N1_STANDARD_32

config TERRAFORM_GCE_IMAGE_TYPE
	string
	output yaml
	default "pd-balanced"

endif # TERRAFORM_GCE_MACHINE_FAMILY_N1_STANDARD
```

## terraform/gce/kconfigs/machines/Kconfig.n2-highcpu
```kconfig
if TERRAFORM_GCE_MACHINE_FAMILY_N2_HIGHCPU

choice
	prompt "GCE Machine type"
	default TERRAFORM_GCE_MACHINE_N2_HIGHCPU_4
	help
	  The N2 machine series can run on either Intel Cascade Lake
	  (on smaller configurations) or Intel Ice Lake.

config TERRAFORM_GCE_MACHINE_N2_HIGHCPU_2
	bool "n2-highcpu-2"
	depends on TARGET_ARCH_X86_64
	help
	  2 vCPUs (1 core) and 2GB of memory.

config TERRAFORM_GCE_MACHINE_N2_HIGHCPU_4
	bool "n2-highcpu-4"
	depends on TARGET_ARCH_X86_64
	help
	  4 vCPUs (2 cores) and 4GB of memory.

config TERRAFORM_GCE_MACHINE_N2_HIGHCPU_8
	bool "n2-highcpu-8"
	depends on TARGET_ARCH_X86_64
	help
	  8 vCPUs (4 cores) and 8GB of memory.

config TERRAFORM_GCE_MACHINE_N2_HIGHCPU_16
	bool "n2-highcpu-16"
	depends on TARGET_ARCH_X86_64
	help
	  16 vCPUs (8 cores) and 16GB of memory.

config TERRAFORM_GCE_MACHINE_N2_HIGHCPU_32
	bool "n2-highcpu-32"
	depends on TARGET_ARCH_X86_64
	help
	  32 vCPUs (16 cores) and 32GB of memory.

endchoice

config TERRAFORM_GCE_MACHINE_TYPE
	string
	output yaml
	default "n2-highcpu-2" if TERRAFORM_GCE_MACHINE_N2_HIGHCPU_2
	default "n2-highcpu-4" if TERRAFORM_GCE_MACHINE_N2_HIGHCPU_4
	default "n2-highcpu-8" if TERRAFORM_GCE_MACHINE_N2_HIGHCPU_8
	default "n2-highcpu-16" if TERRAFORM_GCE_MACHINE_N2_HIGHCPU_16
	default "n2-highcpu-32" if TERRAFORM_GCE_MACHINE_N2_HIGHCPU_32

config TERRAFORM_GCE_IMAGE_TYPE
	string
	output yaml
	default "pd-balanced"

endif # TERRAFORM_GCE_MACHINE_FAMILY_N2_HIGHCPU
```

## terraform/gce/kconfigs/machines/Kconfig.n2-standard
```kconfig
if TERRAFORM_GCE_MACHINE_FAMILY_N2_STANDARD

choice
	prompt "GCE Machine type"
	default TERRAFORM_GCE_MACHINE_N2_STANDARD_8
	help
	  The N2 machine series can run on either Intel Cascade Lake
	  (on smaller configurations) or Intel Ice Lake.

config TERRAFORM_GCE_MACHINE_N2_STANDARD_2
	bool "n2-standard-2"
	depends on TARGET_ARCH_X86_64
	help
	  2 vCPUs (1 core) and 8GB of memory.

config TERRAFORM_GCE_MACHINE_N2_STANDARD_4
	bool "n2-standard-4"
	depends on TARGET_ARCH_X86_64
	help
	  4 vCPUs (2 cores) and 16GB of memory.

config TERRAFORM_GCE_MACHINE_N2_STANDARD_8
	bool "n2-standard-8"
	depends on TARGET_ARCH_X86_64
	help
	  8 vCPUs (4 cores) and 32GB of memory.

config TERRAFORM_GCE_MACHINE_N2_STANDARD_16
	bool "n2-standard-16"
	depends on TARGET_ARCH_X86_64
	help
	  16 vCPUs (8 cores) and 64GB of memory.

config TERRAFORM_GCE_MACHINE_N2_STANDARD_32
	bool "n2-standard-32"
	depends on TARGET_ARCH_X86_64
	help
	  32 vCPUs (16 cores) and 128GB of memory.

endchoice

config TERRAFORM_GCE_MACHINE_TYPE
	string
	output yaml
	default "n2-standard-2" if TERRAFORM_GCE_MACHINE_N2_STANDARD_2
	default "n2-standard-4" if TERRAFORM_GCE_MACHINE_N2_STANDARD_4
	default "n2-standard-8" if TERRAFORM_GCE_MACHINE_N2_STANDARD_8
	default "n2-standard-16" if TERRAFORM_GCE_MACHINE_N2_STANDARD_16
	default "n2-standard-32" if TERRAFORM_GCE_MACHINE_N2_STANDARD_32

config TERRAFORM_GCE_IMAGE_TYPE
	string
	output yaml
	default "pd-balanced"

endif # TERRAFORM_GCE_MACHINE_FAMILY_N2_STANDARD
```

## terraform/gce/kconfigs/machines/Kconfig.n2d-highcpu
```kconfig
if TERRAFORM_GCE_MACHINE_FAMILY_N2D_HIGHCPU

choice
	prompt "GCE Machine type"
	default TERRAFORM_GCE_MACHINE_N2D_HIGHCPU_4
	help
	  The N2D machine series can run on either AMD EPYC Milan or
	  AMD EPYC Rome processors. The third generation AMD EPYC
	  Milan processor is available only in specific regions and zones.

config TERRAFORM_GCE_MACHINE_N2D_HIGHCPU_2
	bool "n2d-highcpu-2"
	depends on TARGET_ARCH_X86_64
	help
	  2 vCPU (1 core) and 2GB of memory.

config TERRAFORM_GCE_MACHINE_N2D_HIGHCPU_4
	bool "n2d-highcpu-4"
	depends on TARGET_ARCH_X86_64
	help
	  4 vCPUs (2 cores) and 4GB of memory.

config TERRAFORM_GCE_MACHINE_N2D_HIGHCPU_8
	bool "n2d-highcpu-8"
	depends on TARGET_ARCH_X86_64
	help
	  8 vCPUs (4 cores) and 8GB of memory.

config TERRAFORM_GCE_MACHINE_N2D_HIGHCPU_16
	bool "n2d-highcpu-16"
	depends on TARGET_ARCH_X86_64
	help
	  16 vCPUs (8 cores) and 16GB of memory.

config TERRAFORM_GCE_MACHINE_N2D_HIGHCPU_32
	bool "n2d-highcpu-32"
	depends on TARGET_ARCH_X86_64
	help
	  32 vCPUs (16 cores) and 32GB of memory.

endchoice

config TERRAFORM_GCE_MACHINE_TYPE
	string
	output yaml
	default "n2d-highcpu-2" if TERRAFORM_GCE_MACHINE_N2D_HIGHCPU_2
	default "n2d-highcpu-4" if TERRAFORM_GCE_MACHINE_N2D_HIGHCPU_4
	default "n2d-highcpu-8" if TERRAFORM_GCE_MACHINE_N2D_HIGHCPU_8
	default "n2d-highcpu-16" if TERRAFORM_GCE_MACHINE_N2D_HIGHCPU_16
	default "n2d-highcpu-32" if TERRAFORM_GCE_MACHINE_N2D_HIGHCPU_32

config TERRAFORM_GCE_IMAGE_TYPE
	string
	output yaml
	default "pd-balanced"

endif # TERRAFORM_GCE_MACHINE_FAMILY_N2D_HIGHCPU
```

## terraform/gce/kconfigs/machines/Kconfig.n2d-standard
```kconfig
if TERRAFORM_GCE_MACHINE_FAMILY_N2D_STANDARD

choice
	prompt "GCE Machine type"
	default TERRAFORM_GCE_MACHINE_N2D_STANDARD_4
	help
	  The N2D machine series can run on either AMD EPYC Milan or
	  AMD EPYC Rome processors. The third generation AMD EPYC
	  Milan processor is available only in specific regions and zones.

config TERRAFORM_GCE_MACHINE_N2D_STANDARD_2
	bool "n2d-standard-2"
	depends on TARGET_ARCH_X86_64
	help
	  2 vCPUs (1 core) and 8GB of memory.

config TERRAFORM_GCE_MACHINE_N2D_STANDARD_4
	bool "n2d-standard-4"
	depends on TARGET_ARCH_X86_64
	help
	  4 vCPUs (2 cores) and 16GB of memory.

config TERRAFORM_GCE_MACHINE_N2D_STANDARD_8
	bool "n2d-standard-8"
	depends on TARGET_ARCH_X86_64
	help
	  8 vCPUs (4 cores) and 32GB of memory.

config TERRAFORM_GCE_MACHINE_N2D_STANDARD_16
	bool "n2d-standard-16"
	depends on TARGET_ARCH_X86_64
	help
	  16 vCPUs (8 cores) and 64GB of memory.

config TERRAFORM_GCE_MACHINE_N2D_STANDARD_32
	bool "n2d-standard-32"
	depends on TARGET_ARCH_X86_64
	help
	  32 vCPUs (16 cores) and 128GB of memory.

endchoice

config TERRAFORM_GCE_MACHINE_TYPE
	string
	output yaml
	default "n2d-standard-2" if TERRAFORM_GCE_MACHINE_N2D_STANDARD_2
	default "n2d-standard-4" if TERRAFORM_GCE_MACHINE_N2D_STANDARD_4
	default "n2d-standard-8" if TERRAFORM_GCE_MACHINE_N2D_STANDARD_8
	default "n2d-standard-16" if TERRAFORM_GCE_MACHINE_N2D_STANDARD_16
	default "n2d-standard-32" if TERRAFORM_GCE_MACHINE_N2D_STANDARD_32

config TERRAFORM_GCE_IMAGE_TYPE
	string
	output yaml
	default "pd-balanced"

endif # TERRAFORM_GCE_MACHINE_FAMILY_N2D_STANDARD
```

## terraform/gce/kconfigs/machines/Kconfig.n4-highcpu
```kconfig
if TERRAFORM_GCE_MACHINE_FAMILY_N4_HIGHCPU

choice
	prompt "GCE Machine Type"
	default TERRAFORM_GCE_MACHINE_N4_HIGHCPU_4
	help
	  N4 VMs are powered by the 5th generation Intel Xeon Scalable
	  processors (code-named Emerald Rapids) and Titanium.

config TERRAFORM_GCE_MACHINE_N4_HIGHCPU_2
	bool "n4-highcpu-2"
	help
	  2 vCPUs (1 core) and 4GB of memory.

config TERRAFORM_GCE_MACHINE_N4_HIGHCPU_4
	bool "n4-highcpu-4"
	help
	  4 vCPUs (2 cores) and 8GB of memory.

config TERRAFORM_GCE_MACHINE_N4_HIGHCPU_8
	bool "n4-highcpu-8"
	help
	  8 vCPUs (4 cores) and 16GB of memory.

config TERRAFORM_GCE_MACHINE_N4_HIGHCPU_16
	bool "n4-highcpu-16"
	help
	  16 vCPUs (8 cores) and 32GB of memory.

config TERRAFORM_GCE_MACHINE_N4_HIGHCPU_32
	bool "n4-highcpu-32"
	help
	  32 vCPUs (16 cores) and 64GB of memory.

endchoice

config TERRAFORM_GCE_MACHINE_TYPE
	string
	output yaml
	default "n4-highcpu-2" if TERRAFORM_GCE_MACHINE_N4_HIGHCPU_2
	default "n4-highcpu-4" if TERRAFORM_GCE_MACHINE_N4_HIGHCPU_4
	default "n4-highcpu-8" if TERRAFORM_GCE_MACHINE_N4_HIGHCPU_8
	default "n4-highcpu-16" if TERRAFORM_GCE_MACHINE_N4_HIGHCPU_16
	default "n4-highcpu-32" if TERRAFORM_GCE_MACHINE_N4_HIGHCPU_32

config TERRAFORM_GCE_IMAGE_TYPE
	string
	output yaml
	default "hyperdisk-balanced"

endif # TERRAFORM_GCE_MACHINE_FAMILY_N4_HIGHCPU
```
