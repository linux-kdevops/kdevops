## terraform/lambdalabs/kconfigs/Kconfig.compute.default
```kconfig
# Lambda Labs instance types (default configuration)
#
# This file provides sensible defaults for Lambda Labs instance types.
# Run 'make cloud-configs' to regenerate with live API data.

choice
	prompt "Lambda Labs instance type"
	default TERRAFORM_LAMBDALABS_INSTANCE_TYPE_GPU_1X_A10
	help
	  Select the Lambda Labs instance type for your deployment.
	  Run 'make cloud-configs' to update with current availability.
	  Prices shown are on-demand hourly rates in USD.

config TERRAFORM_LAMBDALABS_INSTANCE_TYPE_GPU_1X_A10
	bool "gpu_1x_a10 - 1x NVIDIA A10 GPU ($0.75/hr)"
	help
	  Single NVIDIA A10 GPU instance with 24GB VRAM.
	  Good for development and testing workloads.
	  Price: $0.75 per hour (on-demand)

config TERRAFORM_LAMBDALABS_INSTANCE_TYPE_GPU_1X_A100
	bool "gpu_1x_a100 - 1x NVIDIA A100 GPU ($1.29/hr)"
	help
	  Single NVIDIA A100 GPU instance with 40GB VRAM.
	  High-performance option for training and inference.
	  Price: $1.29 per hour (on-demand)

config TERRAFORM_LAMBDALABS_INSTANCE_TYPE_GPU_1X_A6000
	bool "gpu_1x_a6000 - 1x NVIDIA A6000 GPU ($0.80/hr)"
	help
	  Single NVIDIA RTX A6000 GPU instance with 48GB VRAM.
	  Good balance of performance and cost.
	  Price: $0.80 per hour (on-demand)

config TERRAFORM_LAMBDALABS_INSTANCE_TYPE_GPU_1X_RTX6000
	bool "gpu_1x_rtx6000 - 1x NVIDIA RTX 6000 GPU ($0.50/hr)"
	help
	  Single NVIDIA RTX 6000 GPU instance.
	  Budget-friendly option for lighter workloads.
	  Price: $0.50 per hour (on-demand)

config TERRAFORM_LAMBDALABS_INSTANCE_TYPE_GPU_1X_H100_PCIE
	bool "gpu_1x_h100_pcie - 1x NVIDIA H100 PCIe GPU ($2.49/hr)"
	help
	  Single NVIDIA H100 PCIe GPU instance with 80GB VRAM.
	  Latest generation high-performance GPU.
	  Price: $2.49 per hour (on-demand)

config TERRAFORM_LAMBDALABS_INSTANCE_TYPE_GPU_8X_A100_80GB_SXM4
	bool "gpu_8x_a100_80gb_sxm4 - 8x NVIDIA A100 80GB SXM ($14.32/hr)"
	help
	  Eight NVIDIA A100 GPUs with 80GB VRAM each (SXM4 form factor).
	  High-performance multi-GPU training.
	  Price: $14.32 per hour (on-demand)

config TERRAFORM_LAMBDALABS_INSTANCE_TYPE_GPU_8X_H100_SXM5
	bool "gpu_8x_h100_sxm5 - 8x NVIDIA H100 SXM GPU ($23.92/hr)"
	help
	  Eight NVIDIA H100 SXM GPUs with 80GB VRAM each.
	  Maximum performance for large-scale training.
	  Price: $23.92 per hour (on-demand)

config TERRAFORM_LAMBDALABS_INSTANCE_TYPE_GPU_8X_V100
	bool "gpu_8x_v100 - 8x NVIDIA V100 GPU ($4.40/hr)"
	help
	  Eight NVIDIA V100 GPUs.
	  Cost-effective multi-GPU option.
	  Price: $4.40 per hour (on-demand)

endchoice
```

## terraform/lambdalabs/kconfigs/Kconfig.compute.static
```kconfig
# Lambda Labs instance types (dynamically generated with capacity info)

choice
	prompt "Lambda Labs instance type"
	default TERRAFORM_LAMBDALABS_INSTANCE_TYPE_GPU_1X_GH200
	help
	  Select the Lambda Labs instance type for your deployment.
	  These options are dynamically generated from the Lambda Labs API.
	  [Available] = Has capacity in at least one region
	  [No Capacity] = Currently no capacity available
	  Prices shown are on-demand hourly rates in USD.

# Instance types WITH available capacity:
config TERRAFORM_LAMBDALABS_INSTANCE_TYPE_GPU_1X_GH200
	bool "gpu_1x_gh200 ($1.49/hr) - 1x GH200 (96 GB) [AVAILABLE]"
	depends on !TERRAFORM_LAMBDALABS_REGION_MANUAL || (TERRAFORM_LAMBDALABS_REGION_US_EAST_3)
	help
	  1x GH200 (96 GB)
	  AVAILABLE in: us-east-3
	  Price: $1.49/hr (on-demand)
	  vCPUs: 64, Memory: 432 GiB, Storage: 4096 GiB

config TERRAFORM_LAMBDALABS_INSTANCE_TYPE_GPU_1X_H100_PCIE
	bool "gpu_1x_h100_pcie ($2.49/hr) - 1x H100 (80 GB PCIe) [AVAILABLE]"
	depends on !TERRAFORM_LAMBDALABS_REGION_MANUAL || (TERRAFORM_LAMBDALABS_REGION_US_WEST_3)
	help
	  1x H100 (80 GB PCIe)
	  AVAILABLE in: us-west-3
	  Price: $2.49/hr (on-demand)
	  vCPUs: 26, Memory: 200 GiB, Storage: 1024 GiB

config TERRAFORM_LAMBDALABS_INSTANCE_TYPE_GPU_1X_H100_SXM5
	bool "gpu_1x_h100_sxm5 (Price N/A) - 1x H100 (80 GB SXM5) [AVAILABLE]"
	depends on !TERRAFORM_LAMBDALABS_REGION_MANUAL || (TERRAFORM_LAMBDALABS_REGION_US_SOUTH_2)
	help
	  1x H100 (80 GB SXM5)
	  AVAILABLE in: us-south-2
	  Price: Price N/A (on-demand)
	  vCPUs: 26, Memory: 225 GiB, Storage: 2816 GiB

config TERRAFORM_LAMBDALABS_INSTANCE_TYPE_GPU_2X_H100_SXM5
	bool "gpu_2x_h100_sxm5 (Price N/A) - 2x H100 (80 GB SXM5) [AVAILABLE]"
	depends on !TERRAFORM_LAMBDALABS_REGION_MANUAL || (TERRAFORM_LAMBDALABS_REGION_US_SOUTH_2 || TERRAFORM_LAMBDALABS_REGION_US_SOUTH_3)
	help
	  2x H100 (80 GB SXM5)
	  AVAILABLE in: us-south-2, us-south-3
	  Price: Price N/A (on-demand)
	  vCPUs: 52, Memory: 450 GiB, Storage: 5632 GiB

config TERRAFORM_LAMBDALABS_INSTANCE_TYPE_GPU_4X_H100_SXM5
	bool "gpu_4x_h100_sxm5 (Price N/A) - 4x H100 (80 GB SXM5) [AVAILABLE]"
	depends on !TERRAFORM_LAMBDALABS_REGION_MANUAL || (TERRAFORM_LAMBDALABS_REGION_US_SOUTH_2)
	help
	  4x H100 (80 GB SXM5)
	  AVAILABLE in: us-south-2
	  Price: Price N/A (on-demand)
	  vCPUs: 104, Memory: 900 GiB, Storage: 11264 GiB

config TERRAFORM_LAMBDALABS_INSTANCE_TYPE_GPU_8X_A100_80GB_SXM4
	bool "gpu_8x_a100_80gb_sxm4 (Price N/A) - 8x A100 (80 GB SXM4) [AVAILABLE]"
	depends on !TERRAFORM_LAMBDALABS_REGION_MANUAL || (TERRAFORM_LAMBDALABS_REGION_US_MIDWEST_1 || TERRAFORM_LAMBDALABS_REGION_AUSTRALIA_EAST_1)
	help
	  8x A100 (80 GB SXM4)
	  AVAILABLE in: us-midwest-1, australia-east-1
	  Price: Price N/A (on-demand)
	  vCPUs: 240, Memory: 1800 GiB, Storage: 20480 GiB

config TERRAFORM_LAMBDALABS_INSTANCE_TYPE_GPU_8X_B200_SXM6
	bool "gpu_8x_b200_sxm6 (Price N/A) - 8x B200 (180 GB SXM6) [AVAILABLE]"
	depends on !TERRAFORM_LAMBDALABS_REGION_MANUAL || (TERRAFORM_LAMBDALABS_REGION_US_EAST_1)
	help
	  8x B200 (180 GB SXM6)
	  AVAILABLE in: us-east-1
	  Price: Price N/A (on-demand)
	  vCPUs: 208, Memory: 2900 GiB, Storage: 22528 GiB

config TERRAFORM_LAMBDALABS_INSTANCE_TYPE_GPU_8X_V100
	bool "gpu_8x_v100 ($4.40/hr) - 8x Tesla V100 (16 GB) [AVAILABLE]"
	depends on !TERRAFORM_LAMBDALABS_REGION_MANUAL || (TERRAFORM_LAMBDALABS_REGION_US_SOUTH_1)
	help
	  8x Tesla V100 (16 GB)
	  AVAILABLE in: us-south-1
	  Price: $4.40/hr (on-demand)
	  vCPUs: 92, Memory: 448 GiB, Storage: 6041 GiB

# Instance types WITHOUT capacity (not recommended):
config TERRAFORM_LAMBDALABS_INSTANCE_TYPE_CPU_4X_GENERAL
	bool "cpu_4x_general (Price N/A) - [NO CAPACITY]"
	depends on !TERRAFORM_LAMBDALABS_REGION_MANUAL
	help
	  4x CPU General (16 GiB)
	  WARNING: Currently NO CAPACITY in any region!
	  This option will fail during provisioning.
	  Price: Price N/A (on-demand) when available

config TERRAFORM_LAMBDALABS_INSTANCE_TYPE_GPU_1X_A10
	bool "gpu_1x_a10 ($0.75/hr) - [NO CAPACITY]"
	depends on !TERRAFORM_LAMBDALABS_REGION_MANUAL
	help
	  1x A10 (24 GB PCIe)
	  WARNING: Currently NO CAPACITY in any region!
	  This option will fail during provisioning.
	  Price: $0.75/hr (on-demand) when available

config TERRAFORM_LAMBDALABS_INSTANCE_TYPE_GPU_1X_A100
	bool "gpu_1x_a100 ($1.29/hr) - [NO CAPACITY]"
	depends on !TERRAFORM_LAMBDALABS_REGION_MANUAL
	help
	  1x A100 (40 GB PCIe)
	  WARNING: Currently NO CAPACITY in any region!
	  This option will fail during provisioning.
	  Price: $1.29/hr (on-demand) when available

config TERRAFORM_LAMBDALABS_INSTANCE_TYPE_GPU_1X_A100_SXM4
	bool "gpu_1x_a100_sxm4 (Price N/A) - [NO CAPACITY]"
	depends on !TERRAFORM_LAMBDALABS_REGION_MANUAL
	help
	  1x A100 (40 GB SXM4)
	  WARNING: Currently NO CAPACITY in any region!
	  This option will fail during provisioning.
	  Price: Price N/A (on-demand) when available

config TERRAFORM_LAMBDALABS_INSTANCE_TYPE_GPU_1X_A6000
	bool "gpu_1x_a6000 ($0.80/hr) - [NO CAPACITY]"
	depends on !TERRAFORM_LAMBDALABS_REGION_MANUAL
	help
	  1x A6000 (48 GB)
	  WARNING: Currently NO CAPACITY in any region!
	  This option will fail during provisioning.
	  Price: $0.80/hr (on-demand) when available

config TERRAFORM_LAMBDALABS_INSTANCE_TYPE_GPU_1X_RTX6000
	bool "gpu_1x_rtx6000 ($0.50/hr) - [NO CAPACITY]"
	depends on !TERRAFORM_LAMBDALABS_REGION_MANUAL
	help
	  1x RTX 6000 (24 GB)
	  WARNING: Currently NO CAPACITY in any region!
	  This option will fail during provisioning.
	  Price: $0.50/hr (on-demand) when available

config TERRAFORM_LAMBDALABS_INSTANCE_TYPE_GPU_2X_A100
	bool "gpu_2x_a100 ($2.58/hr) - [NO CAPACITY]"
	depends on !TERRAFORM_LAMBDALABS_REGION_MANUAL
	help
	  2x A100 (40 GB PCIe)
	  WARNING: Currently NO CAPACITY in any region!
	  This option will fail during provisioning.
	  Price: $2.58/hr (on-demand) when available

config TERRAFORM_LAMBDALABS_INSTANCE_TYPE_GPU_2X_A6000
	bool "gpu_2x_a6000 ($1.60/hr) - [NO CAPACITY]"
	depends on !TERRAFORM_LAMBDALABS_REGION_MANUAL
	help
	  2x A6000 (48 GB)
	  WARNING: Currently NO CAPACITY in any region!
	  This option will fail during provisioning.
	  Price: $1.60/hr (on-demand) when available

config TERRAFORM_LAMBDALABS_INSTANCE_TYPE_GPU_4X_A100
	bool "gpu_4x_a100 ($5.16/hr) - [NO CAPACITY]"
	depends on !TERRAFORM_LAMBDALABS_REGION_MANUAL
	help
	  4x A100 (40 GB PCIe)
	  WARNING: Currently NO CAPACITY in any region!
	  This option will fail during provisioning.
	  Price: $5.16/hr (on-demand) when available

config TERRAFORM_LAMBDALABS_INSTANCE_TYPE_GPU_4X_A6000
	bool "gpu_4x_a6000 ($3.20/hr) - [NO CAPACITY]"
	depends on !TERRAFORM_LAMBDALABS_REGION_MANUAL
	help
	  4x A6000 (48 GB)
	  WARNING: Currently NO CAPACITY in any region!
	  This option will fail during provisioning.
	  Price: $3.20/hr (on-demand) when available

config TERRAFORM_LAMBDALABS_INSTANCE_TYPE_GPU_8X_A100
	bool "gpu_8x_a100 ($10.32/hr) - [NO CAPACITY]"
	depends on !TERRAFORM_LAMBDALABS_REGION_MANUAL
	help
	  8x A100 (40 GB SXM4)
	  WARNING: Currently NO CAPACITY in any region!
	  This option will fail during provisioning.
	  Price: $10.32/hr (on-demand) when available

config TERRAFORM_LAMBDALABS_INSTANCE_TYPE_GPU_8X_H100_SXM5
	bool "gpu_8x_h100_sxm5 (Price N/A) - [NO CAPACITY]"
	depends on !TERRAFORM_LAMBDALABS_REGION_MANUAL
	help
	  8x H100 (80 GB SXM5)
	  WARNING: Currently NO CAPACITY in any region!
	  This option will fail during provisioning.
	  Price: Price N/A (on-demand) when available

endchoice
```

## terraform/lambdalabs/kconfigs/Kconfig.identity
```kconfig
# Lambda Labs identity and access configuration

# SSH Key Security Model
# =======================
# For security, each kdevops project directory should use its own SSH key.
# This prevents key sharing between different projects and environments.
#
# Two modes are supported:
# 1. Unique keys per directory (recommended) - Each project gets its own key
# 2. Shared key (legacy) - Use a common key name across projects

choice
	prompt "Lambda Labs SSH key management strategy"
	default TERRAFORM_LAMBDALABS_SSH_KEY_UNIQUE
	help
	  Choose how SSH keys are managed for Lambda Labs instances.

	  Unique keys (recommended): Each project directory gets its own SSH key,
	  preventing key sharing between projects. The key name includes a hash
	  of the directory path for uniqueness.

	  Shared key: Use the same key name across all projects (less secure).

config TERRAFORM_LAMBDALABS_SSH_KEY_UNIQUE
	bool "Use unique SSH key per project directory (recommended)"
	help
	  Generate a unique SSH key name for each kdevops project directory.
	  This improves security by ensuring projects don't share SSH keys.

	  The key name will be generated based on the directory path, like:
	  "kdevops-lambda-kdevops-a1b2c3d4"

	  The key will be automatically created and uploaded to Lambda Labs
	  when you run 'make bringup' if it doesn't already exist.

config TERRAFORM_LAMBDALABS_SSH_KEY_SHARED
	bool "Use shared SSH key name (legacy)"
	help
	  Use a fixed SSH key name that you specify. This is less secure
	  as multiple projects might share the same key.

	  You'll need to ensure the key exists in Lambda Labs before
	  running 'make bringup'.

endchoice

config TERRAFORM_LAMBDALABS_SSH_KEY_NAME_CUSTOM
	string "Custom SSH key name (only for shared mode)"
	default "kdevops-lambdalabs"
	depends on TERRAFORM_LAMBDALABS_SSH_KEY_SHARED
	help
	  Specify the custom SSH key name to use when in shared mode.
	  This key must already exist in your Lambda Labs account.

config TERRAFORM_LAMBDALABS_SSH_KEY_NAME
	string
	output yaml
	default $(shell, python3 scripts/lambdalabs_ssh_key_name.py 2>/dev/null || echo "kdevops-lambdalabs") if TERRAFORM_LAMBDALABS_SSH_KEY_UNIQUE
	default TERRAFORM_LAMBDALABS_SSH_KEY_NAME_CUSTOM if TERRAFORM_LAMBDALABS_SSH_KEY_SHARED

config TERRAFORM_LAMBDALABS_SSH_KEY_AUTO_CREATE
	bool "Automatically create and upload SSH key if missing"
	default y if TERRAFORM_LAMBDALABS_SSH_KEY_UNIQUE
	default n if TERRAFORM_LAMBDALABS_SSH_KEY_SHARED
	help
	  When enabled, kdevops will automatically:
	  1. Generate a new SSH key pair if it doesn't exist
	  2. Upload the public key to Lambda Labs if not already there
	  3. Clean up the key when destroying infrastructure

	  This is enabled by default for unique keys mode and disabled
	  for shared key mode.

# Note: Lambda Labs doesn't support custom SSH users
# Instances always use the OS default user (ubuntu for Ubuntu 22.04)
# To handle this, we disable SSH user inference for Lambda Labs
```
