## terraform/gce/kconfigs/zones/Kconfig.northamerica-northeast1
```kconfig
if TERRAFORM_GCE_REGION_NORTHAMERICA_NORTHEAST1

choice
	prompt "GCE zone"
	default TERRAFORM_GCE_REGION_NORTHAMERICA_NORTHEAST1_B
	help
	  A zone is a deployment area within a region.

config TERRAFORM_GCE_REGION_NORTHAMERICA_NORTHEAST1_A
	bool "northamerica-northeast1-a"

config TERRAFORM_GCE_REGION_NORTHAMERICA_NORTHEAST1_B
	bool "northamerica-northeast1-b"

config TERRAFORM_GCE_REGION_NORTHAMERICA_NORTHEAST1_C
	bool "northamerica-northeast1-c"

endchoice

config TERRAFORM_GCE_ZONE
	string
	output yaml
	default "northamerica-northeast1-a" if TERRAFORM_GCE_REGION_NORTHAMERICA_NORTHEAST1_A
	default "northamerica-northeast1-b" if TERRAFORM_GCE_REGION_NORTHAMERICA_NORTHEAST1_B
	default "northamerica-northeast1-c" if TERRAFORM_GCE_REGION_NORTHAMERICA_NORTHEAST1_C

endif # TERRAFORM_GCE_REGION_NORTHAMERICA_NORTHEAST1
```

## terraform/gce/kconfigs/zones/Kconfig.northamerica-northeast2
```kconfig
if TERRAFORM_GCE_REGION_NORTHAMERICA_NORTHEAST2

choice
	prompt "GCE zone"
	default TERRAFORM_GCE_REGION_NORTHAMERICA_NORTHEAST2_B
	help
	  A zone is a deployment area within a region.

config TERRAFORM_GCE_REGION_NORTHAMERICA_NORTHEAST2_A
	bool "northamerica-northeast2-a"

config TERRAFORM_GCE_REGION_NORTHAMERICA_NORTHEAST2_B
	bool "northamerica-northeast2-b"

config TERRAFORM_GCE_REGION_NORTHAMERICA_NORTHEAST2_C
	bool "northamerica-northeast2-c"

endchoice

config TERRAFORM_GCE_ZONE
	string
	output yaml
	default "northamerica-northeast2-a" if TERRAFORM_GCE_REGION_NORTHAMERICA_NORTHEAST2_A
	default "northamerica-northeast2-b" if TERRAFORM_GCE_REGION_NORTHAMERICA_NORTHEAST2_B
	default "northamerica-northeast2-c" if TERRAFORM_GCE_REGION_NORTHAMERICA_NORTHEAST2_C

endif # TERRAFORM_GCE_REGION_NORTHAMERICA_NORTHEAST2
```

## terraform/gce/kconfigs/zones/Kconfig.northamerica-south1
```kconfig
if TERRAFORM_GCE_REGION_NORTHAMERICA_SOUTH1

choice
	prompt "GCE zone"
	default TERRAFORM_GCE_REGION_NORTHAMERICA_SOUTH1_B
	help
	  A zone is a deployment area within a region.

config TERRAFORM_GCE_REGION_NORTHAMERICA_SOUTH1_A
	bool "northamerica-south1-a"

config TERRAFORM_GCE_REGION_NORTHAMERICA_SOUTH1_B
	bool "northamerica-south1-b"

config TERRAFORM_GCE_REGION_NORTHAMERICA_SOUTH1_C
	bool "northamerica-south1-c"

endchoice

config TERRAFORM_GCE_ZONE
	string
	output yaml
	default "northamerica-south1-a" if TERRAFORM_GCE_REGION_NORTHAMERICA_SOUTH1_A
	default "northamerica-south1-b" if TERRAFORM_GCE_REGION_NORTHAMERICA_SOUTH1_B
	default "northamerica-south1-c" if TERRAFORM_GCE_REGION_NORTHAMERICA_SOUTH1_C

endif # TERRAFORM_GCE_REGION_NORTHAMERICA_SOUTH1
```

## terraform/gce/kconfigs/zones/Kconfig.us-central1
```kconfig
if TERRAFORM_GCE_REGION_US_CENTRAL1

choice
	prompt "GCE zone"
	default TERRAFORM_GCE_ZONE_US_CENTRAL1_C
	help
	  A zone is a deployment area within a region.

config TERRAFORM_GCE_ZONE_US_CENTRAL1_A
	bool "us-central1-a"

config TERRAFORM_GCE_ZONE_US_CENTRAL1_B
	bool "us-central1-b"

config TERRAFORM_GCE_ZONE_US_CENTRAL1_C
	bool "us-central1-c"

config TERRAFORM_GCE_ZONE_US_CENTRAL1_F
	bool "us-central1-f"

endchoice

config TERRAFORM_GCE_ZONE
	string
	output yaml
	default "us-central1-a" if TERRAFORM_GCE_ZONE_US_CENTRAL1_A
	default "us-central1-b" if TERRAFORM_GCE_ZONE_US_CENTRAL1_B
	default "us-central1-c" if TERRAFORM_GCE_ZONE_US_CENTRAL1_C
	default "us-central1-f" if TERRAFORM_GCE_ZONE_US_CENTRAL1_F

endif # TERRAFORM_GCE_REGION_US_CENTRAL1
```

## terraform/gce/kconfigs/zones/Kconfig.us-east1
```kconfig
if TERRAFORM_GCE_REGION_US_EAST1

choice
	prompt "GCE zone"
	default TERRAFORM_GCE_ZONE_US_EAST1_B
	help
	  A zone is a deployment area within a region.

config TERRAFORM_GCE_ZONE_US_EAST1_B
	bool "us-east1-b"

config TERRAFORM_GCE_ZONE_US_EAST1_C
	bool "us-east1-c"

config TERRAFORM_GCE_ZONE_US_EAST1_D
	bool "us-east1-d"

endchoice

config TERRAFORM_GCE_ZONE
	string
	output yaml
	default "us-east1-b" if TERRAFORM_GCE_ZONE_US_EAST1_B
	default "us-east1-c" if TERRAFORM_GCE_ZONE_US_EAST1_C
	default "us-east1-d" if TERRAFORM_GCE_ZONE_US_EAST1_D

endif # TERRAFORM_GCE_REGION_US_EAST1
```

## terraform/gce/kconfigs/zones/Kconfig.us-east4
```kconfig
if TERRAFORM_GCE_REGION_US_EAST4

choice
	prompt "GCE zone"
	default TERRAFORM_GCE_ZONE_US_EAST4_C
	help
	  A zone is a deployment area within a region.

config TERRAFORM_GCE_ZONE_US_EAST4_A
	bool "us-east4-a"

config TERRAFORM_GCE_ZONE_US_EAST4_B
	bool "us-east4-b"

config TERRAFORM_GCE_ZONE_US_EAST4_C
	bool "us-east4-c"

endchoice

config TERRAFORM_GCE_ZONE
	string
	output yaml
	default "us-east4-a" if TERRAFORM_GCE_ZONE_US_EAST4_A
	default "us-east4-b" if TERRAFORM_GCE_ZONE_US_EAST4_B
	default "us-east4-c" if TERRAFORM_GCE_ZONE_US_EAST4_C

endif # TERRAFORM_GCE_REGION_US_EAST4
```

## terraform/gce/kconfigs/zones/Kconfig.us-east5
```kconfig
if TERRAFORM_GCE_REGION_US_EAST5

choice
	prompt "GCE zone"
	default TERRAFORM_GCE_ZONE_US_EAST5_B
	help
	  A zone is a deployment area within a region.

config TERRAFORM_GCE_ZONE_US_EAST5_A
	bool "us-east5-a"

config TERRAFORM_GCE_ZONE_US_EAST5_B
	bool "us-east5-b"

config TERRAFORM_GCE_ZONE_US_EAST5_C
	bool "us-east5-c"

endchoice

config TERRAFORM_GCE_ZONE
	string
	output yaml
	default "us-east5-a" if TERRAFORM_GCE_ZONE_US_EAST5_A
	default "us-east5-b" if TERRAFORM_GCE_ZONE_US_EAST5_B
	default "us-east5-c" if TERRAFORM_GCE_ZONE_US_EAST5_C

endif # TERRAFORM_GCE_REGION_US_EAST5
```

## terraform/gce/kconfigs/zones/Kconfig.us-south1
```kconfig
if TERRAFORM_GCE_REGION_US_SOUTH1

choice
	prompt "GCE zone"
	default TERRAFORM_GCE_ZONE_US_SOUTH1_B
	help
	  A zone is a deployment area within a region.

config TERRAFORM_GCE_ZONE_US_SOUTH1_A
	bool "us-south1-a"

config TERRAFORM_GCE_ZONE_US_SOUTH1_B
	bool "us-south1-b"

config TERRAFORM_GCE_ZONE_US_SOUTH1_C
	bool "us-south1-c"

endchoice

config TERRAFORM_GCE_ZONE
	string
	output yaml
	default "us-south1-a" if TERRAFORM_GCE_ZONE_US_SOUTH1_A
	default "us-south1-b" if TERRAFORM_GCE_ZONE_US_SOUTH1_B
	default "us-south1-c" if TERRAFORM_GCE_ZONE_US_SOUTH1_C

endif # TERRAFORM_GCE_REGION_US_SOUTH1
```

## terraform/gce/kconfigs/zones/Kconfig.us-west1
```kconfig
if TERRAFORM_GCE_REGION_US_WEST1

choice
	prompt "GCE zone"
	default TERRAFORM_GCE_ZONE_US_WEST1_B
	help
	  A zone is a deployment area within a region.

config TERRAFORM_GCE_ZONE_US_WEST1_A
	bool "us-west1-a"

config TERRAFORM_GCE_ZONE_US_WEST1_B
	bool "us-west1-b"

config TERRAFORM_GCE_ZONE_US_WEST1_C
	bool "us-west1-c"

endchoice

config TERRAFORM_GCE_ZONE
	string
	output yaml
	default "us-west1-a" if TERRAFORM_GCE_ZONE_US_WEST1_A
	default "us-west1-b" if TERRAFORM_GCE_ZONE_US_WEST1_B
	default "us-west1-c" if TERRAFORM_GCE_ZONE_US_WEST1_C

endif # TERRAFORM_GCE_REGION_US_WEST1
```

## terraform/gce/kconfigs/zones/Kconfig.us-west2
```kconfig
if TERRAFORM_GCE_REGION_US_WEST2

choice
	prompt "GCE zone"
	default TERRAFORM_GCE_ZONE_US_WEST2_C
	help
	  A zone is a deployment area within a region.

config TERRAFORM_GCE_ZONE_US_WEST2_A
	bool "us-west2-a"

config TERRAFORM_GCE_ZONE_US_WEST2_B
	bool "us-west2-b"

config TERRAFORM_GCE_ZONE_US_WEST2_C
	bool "us-west2-c"

endchoice

config TERRAFORM_GCE_ZONE
	string
	output yaml
	default "us-west2-a" if TERRAFORM_GCE_ZONE_US_WEST2_A
	default "us-west2-b" if TERRAFORM_GCE_ZONE_US_WEST2_B
	default "us-west2-c" if TERRAFORM_GCE_ZONE_US_WEST2_C

endif # TERRAFORM_GCE_REGION_US_WEST2
```

## terraform/gce/kconfigs/zones/Kconfig.us-west3
```kconfig
if TERRAFORM_GCE_REGION_US_WEST3

choice
	prompt "GCE zone"
	default TERRAFORM_GCE_ZONE_US_WEST3_B
	help
	  A zone is a deployment area within a region.

config TERRAFORM_GCE_ZONE_US_WEST3_A
	bool "us-west3-a"

config TERRAFORM_GCE_ZONE_US_WEST3_B
	bool "us-west3-b"

config TERRAFORM_GCE_ZONE_US_WEST3_C
	bool "us-west3-c"

endchoice

config TERRAFORM_GCE_ZONE
	string
	output yaml
	default "us-west3-a" if TERRAFORM_GCE_ZONE_US_WEST3_A
	default "us-west3-b" if TERRAFORM_GCE_ZONE_US_WEST3_B
	default "us-west3-c" if TERRAFORM_GCE_ZONE_US_WEST3_C

endif # TERRAFORM_GCE_REGION_US_WEST3
```

## terraform/gce/kconfigs/zones/Kconfig.us-west4
```kconfig
if TERRAFORM_GCE_REGION_US_WEST4

choice
	prompt "GCE zone"
	default TERRAFORM_GCE_ZONE_US_WEST4_B
	help
	  A zone is a deployment area within a region.

config TERRAFORM_GCE_ZONE_US_WEST4_A
	bool "us-west4-a"

config TERRAFORM_GCE_ZONE_US_WEST4_B
	bool "us-west4-b"

config TERRAFORM_GCE_ZONE_US_WEST4_C
	bool "us-west4-c"

endchoice

config TERRAFORM_GCE_ZONE
	string
	output yaml
	default "us-west4-a" if TERRAFORM_GCE_ZONE_US_WEST4_A
	default "us-west4-b" if TERRAFORM_GCE_ZONE_US_WEST4_B
	default "us-west4-c" if TERRAFORM_GCE_ZONE_US_WEST4_C

endif # TERRAFORM_GCE_REGION_US_WEST4
```

## terraform/lambdalabs/Kconfig
```kconfig
if TERRAFORM_LAMBDALABS

# Lambda Labs Terraform Provider Limitations:
# The elct9620/lambdalabs provider (v0.3.0) has significant limitations:
# - NO OS/distribution selection (always Ubuntu 22.04)
# - NO storage volume management
# - NO custom user creation (always uses "ubuntu" user)
# - NO user data/cloud-init support
#
# Only these features are supported:
# - Region selection
# - GPU instance type selection
# - SSH key management

menu "Resource Location"
source "terraform/lambdalabs/kconfigs/Kconfig.location"
endmenu

menu "Compute"
source "terraform/lambdalabs/kconfigs/Kconfig.compute"
endmenu

# Storage menu removed - not supported by provider
# OS image selection removed - not supported by provider

menu "Identity & Access"
source "terraform/lambdalabs/kconfigs/Kconfig.identity"
endmenu

# Note: Storage and OS configuration files are kept as placeholders
# for future provider updates but contain no options currently

endif # TERRAFORM_LAMBDALABS
```

## terraform/lambdalabs/kconfigs/Kconfig.compute
```kconfig
# Lambda Labs compute configuration

if TERRAFORM_LAMBDALABS_REGION_SMART_CHEAPEST

comment "Instance type: Automatically selected (cheapest available)"
comment "Enable manual region selection to choose specific instance type"

endif # TERRAFORM_LAMBDALABS_REGION_SMART_CHEAPEST

# Include dynamically generated instance types when not using smart cheapest selection
if !TERRAFORM_LAMBDALABS_REGION_SMART_CHEAPEST
source "terraform/lambdalabs/kconfigs/Kconfig.compute.generated"

config TERRAFORM_LAMBDALABS_INSTANCE_TYPE_GH200_OR_LESS
	bool "GH200_OR_LESS - Best available up to GH200 (tier-based)"
	help
	  Tier-based selection: provision the highest-tier single GPU available.
	  Tries tiers in order: GH200 → H100-SXM → H100-PCIe → A100-SXM →
	  A100 → A6000 → RTX6000 → A10.

	  Use this for maximum single-GPU performance with automatic fallback
	  when top-tier options are unavailable.

config TERRAFORM_LAMBDALABS_INSTANCE_TYPE_H100_OR_LESS
	bool "H100_OR_LESS - Best available up to H100 (tier-based)"
	help
	  Tier-based selection: provision the highest-tier single GPU available.
	  Tries tiers in order: H100-SXM → H100-PCIe → A100-SXM → A100 →
	  A6000 → RTX6000 → A10.

	  Use when you want the best available single GPU up to H100.

config TERRAFORM_LAMBDALABS_INSTANCE_TYPE_A100_OR_LESS
	bool "A100_OR_LESS - Best available up to A100 (tier-based)"
	help
	  Tier-based selection: provision the highest-tier single GPU available.
	  Tries tiers in order: A100-SXM → A100 → A6000 → RTX6000 → A10.

	  Use for cost-effective GPU provisioning with A100 as the maximum tier.

config TERRAFORM_LAMBDALABS_INSTANCE_TYPE_A6000_OR_LESS
	bool "A6000_OR_LESS - Best available up to A6000 (tier-based)"
	help
	  Tier-based selection: provision the highest-tier single GPU available.
	  Tries tiers in order: A6000 → RTX6000 → A10.

	  Budget-friendly option with A6000 as maximum tier.

config TERRAFORM_LAMBDALABS_INSTANCE_TYPE_8X_B200_OR_LESS
	bool "8X_B200_OR_LESS - Best available 8-GPU up to B200 (tier-based)"
	help
	  Tier-based selection for 8-GPU instances.
	  Tries tiers in order: 8x B200 → 8x H100 → 8x A100-80 → 8x A100 → 8x V100.

	  Use for maximum multi-GPU performance with automatic fallback.

config TERRAFORM_LAMBDALABS_INSTANCE_TYPE_8X_H100_OR_LESS
	bool "8X_H100_OR_LESS - Best available 8-GPU up to H100 (tier-based)"
	help
	  Tier-based selection for 8-GPU instances.
	  Tries tiers in order: 8x H100 → 8x A100-80 → 8x A100 → 8x V100.

	  Use when you need 8 GPUs with H100 as the maximum tier.

config TERRAFORM_LAMBDALABS_INSTANCE_TYPE_8X_A100_OR_LESS
	bool "8X_A100_OR_LESS - Best available 8-GPU up to A100 (tier-based)"
	help
	  Tier-based selection for 8-GPU instances.
	  Tries tiers in order: 8x A100-80 → 8x A100 → 8x V100.

	  Cost-effective 8-GPU option with A100 as maximum tier.

endif

config TERRAFORM_LAMBDALABS_INSTANCE_TYPE
	string
	output yaml
	default $(shell, python3 scripts/lambdalabs_smart_inference.py instance) if TERRAFORM_LAMBDALABS_REGION_SMART_CHEAPEST
	# Tier-based instance type mappings
	default "GH200_OR_LESS" if TERRAFORM_LAMBDALABS_INSTANCE_TYPE_GH200_OR_LESS
	default "H100_OR_LESS" if TERRAFORM_LAMBDALABS_INSTANCE_TYPE_H100_OR_LESS
	default "A100_OR_LESS" if TERRAFORM_LAMBDALABS_INSTANCE_TYPE_A100_OR_LESS
	default "A6000_OR_LESS" if TERRAFORM_LAMBDALABS_INSTANCE_TYPE_A6000_OR_LESS
	default "8X_B200_OR_LESS" if TERRAFORM_LAMBDALABS_INSTANCE_TYPE_8X_B200_OR_LESS
	default "8X_H100_OR_LESS" if TERRAFORM_LAMBDALABS_INSTANCE_TYPE_8X_H100_OR_LESS
	default "8X_A100_OR_LESS" if TERRAFORM_LAMBDALABS_INSTANCE_TYPE_8X_A100_OR_LESS
	# Dynamically generated mappings for all instance types
	default "cpu_4x_general" if TERRAFORM_LAMBDALABS_INSTANCE_TYPE_CPU_4X_GENERAL
	default "gpu_1x_a10" if TERRAFORM_LAMBDALABS_INSTANCE_TYPE_GPU_1X_A10
	default "gpu_1x_a100" if TERRAFORM_LAMBDALABS_INSTANCE_TYPE_GPU_1X_A100
	default "gpu_1x_a100_sxm4" if TERRAFORM_LAMBDALABS_INSTANCE_TYPE_GPU_1X_A100_SXM4
	default "gpu_1x_a6000" if TERRAFORM_LAMBDALABS_INSTANCE_TYPE_GPU_1X_A6000
	default "gpu_1x_gh200" if TERRAFORM_LAMBDALABS_INSTANCE_TYPE_GPU_1X_GH200
	default "gpu_1x_h100_pcie" if TERRAFORM_LAMBDALABS_INSTANCE_TYPE_GPU_1X_H100_PCIE
	default "gpu_1x_h100_sxm5" if TERRAFORM_LAMBDALABS_INSTANCE_TYPE_GPU_1X_H100_SXM5
	default "gpu_1x_rtx6000" if TERRAFORM_LAMBDALABS_INSTANCE_TYPE_GPU_1X_RTX6000
	default "gpu_2x_a100" if TERRAFORM_LAMBDALABS_INSTANCE_TYPE_GPU_2X_A100
	default "gpu_2x_a6000" if TERRAFORM_LAMBDALABS_INSTANCE_TYPE_GPU_2X_A6000
	default "gpu_2x_h100_sxm5" if TERRAFORM_LAMBDALABS_INSTANCE_TYPE_GPU_2X_H100_SXM5
	default "gpu_4x_a100" if TERRAFORM_LAMBDALABS_INSTANCE_TYPE_GPU_4X_A100
	default "gpu_4x_a6000" if TERRAFORM_LAMBDALABS_INSTANCE_TYPE_GPU_4X_A6000
	default "gpu_4x_h100_sxm5" if TERRAFORM_LAMBDALABS_INSTANCE_TYPE_GPU_4X_H100_SXM5
	default "gpu_8x_a100" if TERRAFORM_LAMBDALABS_INSTANCE_TYPE_GPU_8X_A100
	default "gpu_8x_a100_80gb_sxm4" if TERRAFORM_LAMBDALABS_INSTANCE_TYPE_GPU_8X_A100_80GB_SXM4
	default "gpu_8x_b200_sxm6" if TERRAFORM_LAMBDALABS_INSTANCE_TYPE_GPU_8X_B200_SXM6
	default "gpu_8x_h100_sxm5" if TERRAFORM_LAMBDALABS_INSTANCE_TYPE_GPU_8X_H100_SXM5
	default "gpu_8x_v100" if TERRAFORM_LAMBDALABS_INSTANCE_TYPE_GPU_8X_V100

# OS image is not configurable - provider limitation
config TERRAFORM_LAMBDALABS_IMAGE
	string
	default "ubuntu-22.04"
	help
	  Lambda Labs terraform provider does NOT support OS/image selection.
	  The provider always deploys Ubuntu 22.04. This is a placeholder
	  config that exists only for consistency with other cloud providers.
```
