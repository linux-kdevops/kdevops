## terraform/lambdalabs/kconfigs/Kconfig.location
```kconfig
# Lambda Labs location configuration with smart inference

choice
	prompt "Lambda Labs region selection method"
	default TERRAFORM_LAMBDALABS_REGION_SMART_CHEAPEST
	help
	  Select how to choose the Lambda Labs region for deployment.

config TERRAFORM_LAMBDALABS_REGION_SMART_CHEAPEST
	bool "Smart selection - automatically select cheapest instance in closest region"
	help
	  Enable smart inference that:
	  1. Determines your location from public IP
	  2. Finds all available instance/region combinations
	  3. Selects the cheapest instance type
	  4. Picks the closest region where that instance is available
	  
	  This ensures you get the most affordable option with lowest latency.

config TERRAFORM_LAMBDALABS_REGION_SMART_INFER
	bool "Smart inference - automatically select region with available capacity"
	help
	  Automatically selects a region that has available capacity for your
	  chosen instance type. This eliminates manual checking of region availability.

config TERRAFORM_LAMBDALABS_REGION_MANUAL
	bool "Manual region selection"
	help
	  Manually select a specific region. Note that the selected region
	  may not have capacity for your chosen instance type.

endchoice

if TERRAFORM_LAMBDALABS_REGION_SMART_CHEAPEST

comment "Region: Automatically selected (closest with cheapest instance)"
comment "Instance: Automatically selected (cheapest available)"

endif # TERRAFORM_LAMBDALABS_REGION_SMART_CHEAPEST

if TERRAFORM_LAMBDALABS_REGION_SMART_INFER

comment "Region: Automatically selected based on instance availability"

endif # TERRAFORM_LAMBDALABS_REGION_SMART_INFER

if TERRAFORM_LAMBDALABS_REGION_MANUAL
# Include dynamically generated regions when using manual selection
source "terraform/lambdalabs/kconfigs/Kconfig.location.generated"
endif # TERRAFORM_LAMBDALABS_REGION_MANUAL

config TERRAFORM_LAMBDALABS_REGION
	string
	output yaml
	default $(shell, python3 scripts/lambdalabs_smart_inference.py region) if TERRAFORM_LAMBDALABS_REGION_SMART_CHEAPEST
	default $(shell, scripts/lambdalabs_infer_region.py $(TERRAFORM_LAMBDALABS_INSTANCE_TYPE)) if TERRAFORM_LAMBDALABS_REGION_SMART_INFER
	default "us-tx-1" if TERRAFORM_LAMBDALABS_REGION_US_TX_1
	default "us-midwest-1" if TERRAFORM_LAMBDALABS_REGION_US_MIDWEST_1
	default "us-west-1" if TERRAFORM_LAMBDALABS_REGION_US_WEST_1
	default "us-west-2" if TERRAFORM_LAMBDALABS_REGION_US_WEST_2
	default "us-west-3" if TERRAFORM_LAMBDALABS_REGION_US_WEST_3
	default "us-south-1" if TERRAFORM_LAMBDALABS_REGION_US_SOUTH_1
	default "us-south-2" if TERRAFORM_LAMBDALABS_REGION_US_SOUTH_2
	default "us-south-3" if TERRAFORM_LAMBDALABS_REGION_US_SOUTH_3
	default "europe-central-1" if TERRAFORM_LAMBDALABS_REGION_EU_CENTRAL_1
	default "asia-northeast-1" if TERRAFORM_LAMBDALABS_REGION_ASIA_NORTHEAST_1
	default "asia-northeast-2" if TERRAFORM_LAMBDALABS_REGION_ASIA_NORTHEAST_2
	default "asia-south-1" if TERRAFORM_LAMBDALABS_REGION_ASIA_SOUTH_1
	default "me-west-1" if TERRAFORM_LAMBDALABS_REGION_ME_WEST_1
	default "us-east-1" if TERRAFORM_LAMBDALABS_REGION_US_EAST_1
	default "us-east-3" if TERRAFORM_LAMBDALABS_REGION_US_EAST_3
	default "australia-east-1" if TERRAFORM_LAMBDALABS_REGION_AUSTRALIA_EAST_1
	default "us-tx-1"
```

## terraform/lambdalabs/kconfigs/Kconfig.location.default
```kconfig
# Lambda Labs regions (default configuration)
#
# This file provides sensible defaults for Lambda Labs regions.
# Run 'make cloud-configs' to regenerate with live capacity data.

choice
	prompt "Lambda Labs region"
	default TERRAFORM_LAMBDALABS_REGION_US_TX_1
	help
	  Select the Lambda Labs region for deployment.
	  Run 'make cloud-configs' to see current capacity per region.

config TERRAFORM_LAMBDALABS_REGION_US_TX_1
	bool "us-tx-1 - Texas, USA"
	help
	  Lambda Labs datacenter in Texas, USA.

config TERRAFORM_LAMBDALABS_REGION_US_MIDWEST_1
	bool "us-midwest-1 - Midwest, USA"
	help
	  Lambda Labs datacenter in the US Midwest.

config TERRAFORM_LAMBDALABS_REGION_US_WEST_1
	bool "us-west-1 - California, USA"
	help
	  Lambda Labs datacenter in California, USA.

config TERRAFORM_LAMBDALABS_REGION_US_WEST_2
	bool "us-west-2 - US West 2"
	help
	  Lambda Labs datacenter in US West region 2.

config TERRAFORM_LAMBDALABS_REGION_US_WEST_3
	bool "us-west-3 - US West 3"
	help
	  Lambda Labs datacenter in US West region 3.

config TERRAFORM_LAMBDALABS_REGION_US_SOUTH_1
	bool "us-south-1 - US South"
	help
	  Lambda Labs datacenter in US South region.

config TERRAFORM_LAMBDALABS_REGION_US_SOUTH_2
	bool "us-south-2 - US South 2"
	help
	  Lambda Labs datacenter in US South region 2.

config TERRAFORM_LAMBDALABS_REGION_US_SOUTH_3
	bool "us-south-3 - US South 3"
	help
	  Lambda Labs datacenter in US South region 3.

config TERRAFORM_LAMBDALABS_REGION_US_EAST_1
	bool "us-east-1 - Virginia, USA"
	help
	  Lambda Labs datacenter in Virginia, USA.

config TERRAFORM_LAMBDALABS_REGION_US_EAST_3
	bool "us-east-3 - US East 3"
	help
	  Lambda Labs datacenter in US East region 3.

config TERRAFORM_LAMBDALABS_REGION_EU_CENTRAL_1
	bool "europe-central-1 - Europe Central"
	help
	  Lambda Labs datacenter in Central Europe.

config TERRAFORM_LAMBDALABS_REGION_ASIA_NORTHEAST_1
	bool "asia-northeast-1 - Asia Northeast"
	help
	  Lambda Labs datacenter in Northeast Asia.

config TERRAFORM_LAMBDALABS_REGION_ASIA_NORTHEAST_2
	bool "asia-northeast-2 - Asia Northeast 2"
	help
	  Lambda Labs datacenter in Northeast Asia region 2.

config TERRAFORM_LAMBDALABS_REGION_ASIA_SOUTH_1
	bool "asia-south-1 - Asia South"
	help
	  Lambda Labs datacenter in South Asia.

config TERRAFORM_LAMBDALABS_REGION_ME_WEST_1
	bool "me-west-1 - Middle East West"
	help
	  Lambda Labs datacenter in the Middle East.

config TERRAFORM_LAMBDALABS_REGION_AUSTRALIA_EAST_1
	bool "australia-east-1 - Australia East"
	help
	  Lambda Labs datacenter in Eastern Australia.

endchoice
```

## terraform/lambdalabs/kconfigs/Kconfig.location.manual
```kconfig
# Manual region selection (included when TERRAFORM_LAMBDALABS_REGION_MANUAL is set)

choice
	prompt "Lambda Labs region"
	default TERRAFORM_LAMBDALABS_REGION_US_TX_1
	depends on TERRAFORM_LAMBDALABS_REGION_MANUAL

config TERRAFORM_LAMBDALABS_REGION_US_TX_1
	bool "us-tx-1 - Texas, USA"

config TERRAFORM_LAMBDALABS_REGION_US_MIDWEST_1
	bool "us-midwest-1 - Midwest, USA"

config TERRAFORM_LAMBDALABS_REGION_US_WEST_1
	bool "us-west-1 - West Coast, USA"

config TERRAFORM_LAMBDALABS_REGION_US_WEST_2
	bool "us-west-2 - West Coast, USA (alt)"

config TERRAFORM_LAMBDALABS_REGION_US_WEST_3
	bool "us-west-3 - West Coast, USA (alt 2)"

config TERRAFORM_LAMBDALABS_REGION_US_SOUTH_1
	bool "us-south-1 - South, USA"

config TERRAFORM_LAMBDALABS_REGION_EU_CENTRAL_1
	bool "europe-central-1 - Central Europe"

config TERRAFORM_LAMBDALABS_REGION_ASIA_NORTHEAST_1
	bool "asia-northeast-1 - Northeast Asia"

config TERRAFORM_LAMBDALABS_REGION_ASIA_SOUTH_1
	bool "asia-south-1 - South Asia"

config TERRAFORM_LAMBDALABS_REGION_ME_WEST_1
	bool "me-west-1 - Middle East West"

config TERRAFORM_LAMBDALABS_REGION_US_EAST_1
	bool "us-east-1 - East Coast, USA"

endchoice

config TERRAFORM_LAMBDALABS_REGION
	string
	output yaml
	default "us-tx-1" if TERRAFORM_LAMBDALABS_REGION_US_TX_1
	default "us-midwest-1" if TERRAFORM_LAMBDALABS_REGION_US_MIDWEST_1
	default "us-west-1" if TERRAFORM_LAMBDALABS_REGION_US_WEST_1
	default "us-west-2" if TERRAFORM_LAMBDALABS_REGION_US_WEST_2
	default "us-west-3" if TERRAFORM_LAMBDALABS_REGION_US_WEST_3
	default "us-south-1" if TERRAFORM_LAMBDALABS_REGION_US_SOUTH_1
	default "europe-central-1" if TERRAFORM_LAMBDALABS_REGION_EU_CENTRAL_1
	default "asia-northeast-1" if TERRAFORM_LAMBDALABS_REGION_ASIA_NORTHEAST_1
	default "asia-south-1" if TERRAFORM_LAMBDALABS_REGION_ASIA_SOUTH_1
	default "me-west-1" if TERRAFORM_LAMBDALABS_REGION_ME_WEST_1
	default "us-east-1" if TERRAFORM_LAMBDALABS_REGION_US_EAST_1
	default "us-tx-1"
```

## terraform/lambdalabs/kconfigs/Kconfig.location.static
```kconfig
# Lambda Labs regions (dynamically generated with capacity info)

choice
	prompt "Lambda Labs region"
	default TERRAFORM_LAMBDALABS_REGION_US_SOUTH_2
	help
	  Select the Lambda Labs region for deployment.
	  Number shows how many instance types have capacity in that region.
	  Choose regions with higher numbers for better availability.

config TERRAFORM_LAMBDALABS_REGION_US_SOUTH_2
	bool "us-south-2 - Us South 2 [3 types available]"
	help
	  Region: Us South 2
	  3 instance types have capacity in this region.

config TERRAFORM_LAMBDALABS_REGION_AUSTRALIA_EAST_1
	bool "australia-east-1 - Australia East 1 [1 types available]"
	help
	  Region: Australia East 1
	  1 instance types have capacity in this region.

config TERRAFORM_LAMBDALABS_REGION_US_EAST_1
	bool "us-east-1 - US East (Virginia) [1 types available]"
	help
	  Region: US East (Virginia)
	  1 instance types have capacity in this region.

config TERRAFORM_LAMBDALABS_REGION_US_EAST_3
	bool "us-east-3 - Us East 3 [1 types available]"
	help
	  Region: Us East 3
	  1 instance types have capacity in this region.

config TERRAFORM_LAMBDALABS_REGION_US_MIDWEST_1
	bool "us-midwest-1 - US Midwest [1 types available]"
	help
	  Region: US Midwest
	  1 instance types have capacity in this region.

config TERRAFORM_LAMBDALABS_REGION_US_SOUTH_1
	bool "us-south-1 - US South [1 types available]"
	help
	  Region: US South
	  1 instance types have capacity in this region.

config TERRAFORM_LAMBDALABS_REGION_US_SOUTH_3
	bool "us-south-3 - Us South 3 [1 types available]"
	help
	  Region: Us South 3
	  1 instance types have capacity in this region.

config TERRAFORM_LAMBDALABS_REGION_US_WEST_3
	bool "us-west-3 - US West 3 [1 types available]"
	help
	  Region: US West 3
	  1 instance types have capacity in this region.

endchoice
```

## terraform/lambdalabs/kconfigs/Kconfig.smart
```kconfig
# Lambda Labs Smart Inference Configuration

config TERRAFORM_LAMBDALABS_SMART_CHEAPEST
	bool "Automatically select cheapest available instance in closest region"
	default y
	help
	  Enable smart inference that:
	  1. Determines your location from public IP
	  2. Finds all available instance/region combinations
	  3. Selects the cheapest instance type
	  4. Picks the closest region where that instance is available

	  This ensures you get the most affordable option with lowest latency.

if TERRAFORM_LAMBDALABS_SMART_CHEAPEST

config TERRAFORM_LAMBDALABS_SMART_INSTANCE
	string
	default $(shell, python3 scripts/lambdalabs_smart_inference.py instance)

config TERRAFORM_LAMBDALABS_SMART_REGION
	string
	default $(shell, python3 scripts/lambdalabs_smart_inference.py region)

endif # TERRAFORM_LAMBDALABS_SMART_CHEAPEST
```

## terraform/oci/Kconfig
```kconfig
# OCI provider configuration
#
# This file sources dynamically Kconfig menus. Run
# 'make cloud-config-oci' to populate the .generated files
# with current OCI resource information.

if TERRAFORM_OCI

menu "Resource location"
source "terraform/oci/kconfigs/Kconfig.location.generated"
endmenu
menu "Compute"
comment "Shape selection"
source "terraform/oci/kconfigs/Kconfig.shape"
comment "OS image selection"
source "terraform/oci/kconfigs/Kconfig.image"
endmenu
menu "Storage"
source "terraform/oci/kconfigs/Kconfig.storage"
endmenu
menu "Network"
source "terraform/oci/kconfigs/Kconfig.network"
endmenu
menu "Identity & Access"
source "terraform/oci/kconfigs/Kconfig.identity"
endmenu

endif # TERRAFORM_OCI
```
