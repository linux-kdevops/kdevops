## terraform/aws/kconfigs/instance-types/Kconfig.p3dn.static
```kconfig
# AWS P3DN instance sizes (dynamically generated)

choice
	prompt "Instance size for P3DN family"
	default TERRAFORM_AWS_INSTANCE_P3DN_24XLARGE
	help
	  Select the specific instance size within the P3DN family.

config TERRAFORM_AWS_INSTANCE_P3DN_24XLARGE
	bool "p3dn.24xlarge"
	help
	  vCPUs: 96
	  Memory: 768.0 GB
	  Network: 100 Gigabit
	  Price: pricing varies
	  Instance storage: 1800 GB

endchoice

config TERRAFORM_AWS_P3DN_SIZE
	string
	default "p3dn.24xlarge" if TERRAFORM_AWS_INSTANCE_P3DN_24XLARGE
	default "p3dn.24xlarge"
```

## terraform/aws/kconfigs/instance-types/Kconfig.p4d
```kconfig
if TERRAFORM_AWS_INSTANCE_TYPE_P4D

choice
	prompt "P4d instance size"
	default TERRAFORM_AWS_INSTANCE_P4D_24XLARGE_CHOICE
	help
	  Select the size of the P4d instance. P4d instances
	  include NVIDIA A100 GPUs for ML training workloads.

config TERRAFORM_AWS_INSTANCE_P4D_24XLARGE_CHOICE
	bool "p4d.24xlarge (8 GPUs, 96 vCPUs, 1152 GiB)"
	help
	  8x NVIDIA A100 40GB GPUs, 96 vCPUs, 1152 GiB memory
	  400 Gbps network with EFA support
	  8x 1 TB local NVMe SSD storage
	  GPUDirect RDMA support
	  ~$32.77/hour on-demand

endchoice

endif # TERRAFORM_AWS_INSTANCE_TYPE_P4D

config TERRAFORM_AWS_INSTANCE_FAMILY_P4D
	bool
	default y if TERRAFORM_AWS_INSTANCE_TYPE_P4D
	output yaml

config TERRAFORM_AWS_INSTANCE_P4D_24XLARGE
	bool
	default y if TERRAFORM_AWS_INSTANCE_TYPE_P4D && TERRAFORM_AWS_INSTANCE_P4D_24XLARGE_CHOICE
	output yaml
```

## terraform/aws/kconfigs/instance-types/Kconfig.p4d.static
```kconfig
# AWS P4D instance sizes (dynamically generated)

choice
	prompt "Instance size for P4D family"
	default TERRAFORM_AWS_INSTANCE_P4D_24XLARGE
	help
	  Select the specific instance size within the P4D family.

config TERRAFORM_AWS_INSTANCE_P4D_24XLARGE
	bool "p4d.24xlarge"
	help
	  vCPUs: 96
	  Memory: 1152.0 GB
	  Network: 4x 100 Gigabit
	  Price: pricing varies
	  Instance storage: 8000 GB

endchoice

config TERRAFORM_AWS_P4D_SIZE
	string
	default "p4d.24xlarge" if TERRAFORM_AWS_INSTANCE_P4D_24XLARGE
	default "p4d.24xlarge"
```

## terraform/aws/kconfigs/instance-types/Kconfig.p4de.static
```kconfig
# AWS P4DE instance sizes (dynamically generated)

choice
	prompt "Instance size for P4DE family"
	default TERRAFORM_AWS_INSTANCE_P4DE_24XLARGE
	help
	  Select the specific instance size within the P4DE family.

config TERRAFORM_AWS_INSTANCE_P4DE_24XLARGE
	bool "p4de.24xlarge"
	help
	  vCPUs: 96
	  Memory: 1152.0 GB
	  Network: 4x 100 Gigabit
	  Price: pricing varies
	  Instance storage: 8000 GB

endchoice

config TERRAFORM_AWS_P4DE_SIZE
	string
	default "p4de.24xlarge" if TERRAFORM_AWS_INSTANCE_P4DE_24XLARGE
	default "p4de.24xlarge"
```

## terraform/aws/kconfigs/instance-types/Kconfig.p5
```kconfig
if TERRAFORM_AWS_INSTANCE_TYPE_P5

choice
	prompt "P5 instance size"
	default TERRAFORM_AWS_INSTANCE_P5_48XLARGE_CHOICE
	help
	  Select the size of the P5 instance. P5 instances
	  include NVIDIA H100 GPUs for the most demanding ML workloads.

config TERRAFORM_AWS_INSTANCE_P5_48XLARGE_CHOICE
	bool "p5.48xlarge (8 GPUs, 192 vCPUs, 2048 GiB)"
	help
	  8x NVIDIA H100 80GB GPUs, 192 vCPUs, 2048 GiB memory
	  3200 Gbps network with EFA v2 support
	  30 TB local NVMe SSD storage
	  GPUDirect RDMA support
	  ~$98.32/hour on-demand

endchoice

endif # TERRAFORM_AWS_INSTANCE_TYPE_P5

config TERRAFORM_AWS_INSTANCE_FAMILY_P5
	bool
	default y if TERRAFORM_AWS_INSTANCE_TYPE_P5
	output yaml

config TERRAFORM_AWS_INSTANCE_P5_48XLARGE
	bool
	default y if TERRAFORM_AWS_INSTANCE_TYPE_P5 && TERRAFORM_AWS_INSTANCE_P5_48XLARGE_CHOICE
	output yaml
```

## terraform/aws/kconfigs/instance-types/Kconfig.p5.static
```kconfig
# AWS P5 instance sizes (dynamically generated)

choice
	prompt "Instance size for P5 family"
	default TERRAFORM_AWS_INSTANCE_P5_4XLARGE
	help
	  Select the specific instance size within the P5 family.

config TERRAFORM_AWS_INSTANCE_P5_4XLARGE
	bool "p5.4xlarge"
	help
	  vCPUs: 16
	  Memory: 256.0 GB
	  Network: 100 Gigabit
	  Price: pricing varies
	  Instance storage: 3800 GB

config TERRAFORM_AWS_INSTANCE_P5_48XLARGE
	bool "p5.48xlarge"
	help
	  vCPUs: 192
	  Memory: 2048.0 GB
	  Network: 3200 Gigabit
	  Price: pricing varies
	  Instance storage: 30400 GB

endchoice

config TERRAFORM_AWS_P5_SIZE
	string
	default "p5.4xlarge" if TERRAFORM_AWS_INSTANCE_P5_4XLARGE
	default "p5.48xlarge" if TERRAFORM_AWS_INSTANCE_P5_48XLARGE
	default "p5.4xlarge"
```

## terraform/aws/kconfigs/instance-types/Kconfig.p5en.static
```kconfig
# AWS P5EN instance sizes (dynamically generated)

choice
	prompt "Instance size for P5EN family"
	default TERRAFORM_AWS_INSTANCE_P5EN_48XLARGE
	help
	  Select the specific instance size within the P5EN family.

config TERRAFORM_AWS_INSTANCE_P5EN_48XLARGE
	bool "p5en.48xlarge"
	help
	  vCPUs: 192
	  Memory: 2048.0 GB
	  Network: 3200 Gigabit
	  Price: pricing varies
	  Instance storage: 30400 GB

endchoice

config TERRAFORM_AWS_P5EN_SIZE
	string
	default "p5en.48xlarge" if TERRAFORM_AWS_INSTANCE_P5EN_48XLARGE
	default "p5en.48xlarge"
```

## terraform/aws/kconfigs/instance-types/Kconfig.p6-b200.static
```kconfig
# AWS P6-B200 instance sizes (dynamically generated)

choice
	prompt "Instance size for P6-B200 family"
	default TERRAFORM_AWS_INSTANCE_P6_B200_48XLARGE
	help
	  Select the specific instance size within the P6-B200 family.

config TERRAFORM_AWS_INSTANCE_P6_B200_48XLARGE
	bool "p6-b200.48xlarge"
	help
	  vCPUs: 192
	  Memory: 2048.0 GB
	  Network: 3200 Gigabit
	  Price: pricing varies
	  Instance storage: 30400 GB

endchoice

config TERRAFORM_AWS_P6_B200_SIZE
	string
	default "p6-b200.48xlarge" if TERRAFORM_AWS_INSTANCE_P6_B200_48XLARGE
	default "p6-b200.48xlarge"
```

## terraform/aws/kconfigs/instance-types/Kconfig.r3.static
```kconfig
# AWS R3 instance sizes (dynamically generated)

choice
	prompt "Instance size for R3 family"
	default TERRAFORM_AWS_INSTANCE_R3_LARGE
	help
	  Select the specific instance size within the R3 family.

config TERRAFORM_AWS_INSTANCE_R3_LARGE
	bool "r3.large"
	help
	  vCPUs: 2
	  Memory: 15.0 GB
	  Network: Moderate
	  Price: pricing varies
	  Instance storage: 32 GB

config TERRAFORM_AWS_INSTANCE_R3_XLARGE
	bool "r3.xlarge"
	help
	  vCPUs: 4
	  Memory: 30.5 GB
	  Network: Moderate
	  Price: pricing varies
	  Instance storage: 80 GB

config TERRAFORM_AWS_INSTANCE_R3_2XLARGE
	bool "r3.2xlarge"
	help
	  vCPUs: 8
	  Memory: 61.0 GB
	  Network: High
	  Price: pricing varies
	  Instance storage: 160 GB

config TERRAFORM_AWS_INSTANCE_R3_4XLARGE
	bool "r3.4xlarge"
	help
	  vCPUs: 16
	  Memory: 122.0 GB
	  Network: High
	  Price: pricing varies
	  Instance storage: 320 GB

config TERRAFORM_AWS_INSTANCE_R3_8XLARGE
	bool "r3.8xlarge"
	help
	  vCPUs: 32
	  Memory: 244.0 GB
	  Network: 10 Gigabit
	  Price: pricing varies
	  Instance storage: 640 GB

endchoice

config TERRAFORM_AWS_R3_SIZE
	string
	default "r3.large" if TERRAFORM_AWS_INSTANCE_R3_LARGE
	default "r3.xlarge" if TERRAFORM_AWS_INSTANCE_R3_XLARGE
	default "r3.2xlarge" if TERRAFORM_AWS_INSTANCE_R3_2XLARGE
	default "r3.4xlarge" if TERRAFORM_AWS_INSTANCE_R3_4XLARGE
	default "r3.8xlarge" if TERRAFORM_AWS_INSTANCE_R3_8XLARGE
	default "r3.large"
```
