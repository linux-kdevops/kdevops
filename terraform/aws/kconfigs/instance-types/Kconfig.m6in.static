## terraform/aws/kconfigs/instance-types/Kconfig.m8g.static
```kconfig
# AWS M8G instance sizes (dynamically generated)

choice
	prompt "Instance size for M8G family"
	default TERRAFORM_AWS_INSTANCE_M8G_MEDIUM
	help
	  Select the specific instance size within the M8G family.

config TERRAFORM_AWS_INSTANCE_M8G_MEDIUM
	bool "m8g.medium"
	help
	  vCPUs: 1
	  Memory: 4.0 GB
	  Network: Up to 12.5 Gigabit
	  Price: pricing varies

config TERRAFORM_AWS_INSTANCE_M8G_LARGE
	bool "m8g.large"
	help
	  vCPUs: 2
	  Memory: 8.0 GB
	  Network: Up to 12.5 Gigabit
	  Price: pricing varies

config TERRAFORM_AWS_INSTANCE_M8G_XLARGE
	bool "m8g.xlarge"
	help
	  vCPUs: 4
	  Memory: 16.0 GB
	  Network: Up to 12.5 Gigabit
	  Price: pricing varies

config TERRAFORM_AWS_INSTANCE_M8G_2XLARGE
	bool "m8g.2xlarge"
	help
	  vCPUs: 8
	  Memory: 32.0 GB
	  Network: Up to 15 Gigabit
	  Price: pricing varies

config TERRAFORM_AWS_INSTANCE_M8G_4XLARGE
	bool "m8g.4xlarge"
	help
	  vCPUs: 16
	  Memory: 64.0 GB
	  Network: Up to 15 Gigabit
	  Price: pricing varies

config TERRAFORM_AWS_INSTANCE_M8G_8XLARGE
	bool "m8g.8xlarge"
	help
	  vCPUs: 32
	  Memory: 128.0 GB
	  Network: 15 Gigabit
	  Price: pricing varies

config TERRAFORM_AWS_INSTANCE_M8G_12XLARGE
	bool "m8g.12xlarge"
	help
	  vCPUs: 48
	  Memory: 192.0 GB
	  Network: 22.5 Gigabit
	  Price: pricing varies

config TERRAFORM_AWS_INSTANCE_M8G_16XLARGE
	bool "m8g.16xlarge"
	help
	  vCPUs: 64
	  Memory: 256.0 GB
	  Network: 30 Gigabit
	  Price: pricing varies

config TERRAFORM_AWS_INSTANCE_M8G_24XLARGE
	bool "m8g.24xlarge"
	help
	  vCPUs: 96
	  Memory: 384.0 GB
	  Network: 40 Gigabit
	  Price: pricing varies

config TERRAFORM_AWS_INSTANCE_M8G_METAL_24XL
	bool "m8g.metal-24xl"
	help
	  vCPUs: 96
	  Memory: 384.0 GB
	  Network: 40 Gigabit
	  Price: pricing varies

config TERRAFORM_AWS_INSTANCE_M8G_METAL_48XL
	bool "m8g.metal-48xl"
	help
	  vCPUs: 192
	  Memory: 768.0 GB
	  Network: 50 Gigabit
	  Price: pricing varies

config TERRAFORM_AWS_INSTANCE_M8G_48XLARGE
	bool "m8g.48xlarge"
	help
	  vCPUs: 192
	  Memory: 768.0 GB
	  Network: 50 Gigabit
	  Price: pricing varies

endchoice

config TERRAFORM_AWS_M8G_SIZE
	string
	default "m8g.medium" if TERRAFORM_AWS_INSTANCE_M8G_MEDIUM
	default "m8g.large" if TERRAFORM_AWS_INSTANCE_M8G_LARGE
	default "m8g.xlarge" if TERRAFORM_AWS_INSTANCE_M8G_XLARGE
	default "m8g.2xlarge" if TERRAFORM_AWS_INSTANCE_M8G_2XLARGE
	default "m8g.4xlarge" if TERRAFORM_AWS_INSTANCE_M8G_4XLARGE
	default "m8g.8xlarge" if TERRAFORM_AWS_INSTANCE_M8G_8XLARGE
	default "m8g.12xlarge" if TERRAFORM_AWS_INSTANCE_M8G_12XLARGE
	default "m8g.16xlarge" if TERRAFORM_AWS_INSTANCE_M8G_16XLARGE
	default "m8g.24xlarge" if TERRAFORM_AWS_INSTANCE_M8G_24XLARGE
	default "m8g.metal-24xl" if TERRAFORM_AWS_INSTANCE_M8G_METAL_24XL
	default "m8g.metal-48xl" if TERRAFORM_AWS_INSTANCE_M8G_METAL_48XL
	default "m8g.48xlarge" if TERRAFORM_AWS_INSTANCE_M8G_48XLARGE
	default "m8g.medium"
```

## terraform/aws/kconfigs/instance-types/Kconfig.m8gd.static
```kconfig
# AWS M8GD instance sizes (dynamically generated)

choice
	prompt "Instance size for M8GD family"
	default TERRAFORM_AWS_INSTANCE_M8GD_MEDIUM
	help
	  Select the specific instance size within the M8GD family.

config TERRAFORM_AWS_INSTANCE_M8GD_MEDIUM
	bool "m8gd.medium"
	help
	  vCPUs: 1
	  Memory: 4.0 GB
	  Network: Up to 12.5 Gigabit
	  Price: pricing varies
	  Instance storage: 59 GB

config TERRAFORM_AWS_INSTANCE_M8GD_LARGE
	bool "m8gd.large"
	help
	  vCPUs: 2
	  Memory: 8.0 GB
	  Network: Up to 12.5 Gigabit
	  Price: pricing varies
	  Instance storage: 118 GB

config TERRAFORM_AWS_INSTANCE_M8GD_XLARGE
	bool "m8gd.xlarge"
	help
	  vCPUs: 4
	  Memory: 16.0 GB
	  Network: Up to 12.5 Gigabit
	  Price: pricing varies
	  Instance storage: 237 GB

config TERRAFORM_AWS_INSTANCE_M8GD_2XLARGE
	bool "m8gd.2xlarge"
	help
	  vCPUs: 8
	  Memory: 32.0 GB
	  Network: Up to 15 Gigabit
	  Price: pricing varies
	  Instance storage: 474 GB

config TERRAFORM_AWS_INSTANCE_M8GD_4XLARGE
	bool "m8gd.4xlarge"
	help
	  vCPUs: 16
	  Memory: 64.0 GB
	  Network: Up to 15 Gigabit
	  Price: pricing varies
	  Instance storage: 950 GB

config TERRAFORM_AWS_INSTANCE_M8GD_8XLARGE
	bool "m8gd.8xlarge"
	help
	  vCPUs: 32
	  Memory: 128.0 GB
	  Network: 15 Gigabit
	  Price: pricing varies
	  Instance storage: 1900 GB

config TERRAFORM_AWS_INSTANCE_M8GD_12XLARGE
	bool "m8gd.12xlarge"
	help
	  vCPUs: 48
	  Memory: 192.0 GB
	  Network: 22.5 Gigabit
	  Price: pricing varies
	  Instance storage: 2850 GB

config TERRAFORM_AWS_INSTANCE_M8GD_16XLARGE
	bool "m8gd.16xlarge"
	help
	  vCPUs: 64
	  Memory: 256.0 GB
	  Network: 30 Gigabit
	  Price: pricing varies
	  Instance storage: 3800 GB

config TERRAFORM_AWS_INSTANCE_M8GD_24XLARGE
	bool "m8gd.24xlarge"
	help
	  vCPUs: 96
	  Memory: 384.0 GB
	  Network: 40 Gigabit
	  Price: pricing varies
	  Instance storage: 5700 GB

config TERRAFORM_AWS_INSTANCE_M8GD_METAL_24XL
	bool "m8gd.metal-24xl"
	help
	  vCPUs: 96
	  Memory: 384.0 GB
	  Network: 40 Gigabit
	  Price: pricing varies
	  Instance storage: 5700 GB

config TERRAFORM_AWS_INSTANCE_M8GD_METAL_48XL
	bool "m8gd.metal-48xl"
	help
	  vCPUs: 192
	  Memory: 768.0 GB
	  Network: 50 Gigabit
	  Price: pricing varies
	  Instance storage: 11400 GB

config TERRAFORM_AWS_INSTANCE_M8GD_48XLARGE
	bool "m8gd.48xlarge"
	help
	  vCPUs: 192
	  Memory: 768.0 GB
	  Network: 50 Gigabit
	  Price: pricing varies
	  Instance storage: 11400 GB

endchoice

config TERRAFORM_AWS_M8GD_SIZE
	string
	default "m8gd.medium" if TERRAFORM_AWS_INSTANCE_M8GD_MEDIUM
	default "m8gd.large" if TERRAFORM_AWS_INSTANCE_M8GD_LARGE
	default "m8gd.xlarge" if TERRAFORM_AWS_INSTANCE_M8GD_XLARGE
	default "m8gd.2xlarge" if TERRAFORM_AWS_INSTANCE_M8GD_2XLARGE
	default "m8gd.4xlarge" if TERRAFORM_AWS_INSTANCE_M8GD_4XLARGE
	default "m8gd.8xlarge" if TERRAFORM_AWS_INSTANCE_M8GD_8XLARGE
	default "m8gd.12xlarge" if TERRAFORM_AWS_INSTANCE_M8GD_12XLARGE
	default "m8gd.16xlarge" if TERRAFORM_AWS_INSTANCE_M8GD_16XLARGE
	default "m8gd.24xlarge" if TERRAFORM_AWS_INSTANCE_M8GD_24XLARGE
	default "m8gd.metal-24xl" if TERRAFORM_AWS_INSTANCE_M8GD_METAL_24XL
	default "m8gd.metal-48xl" if TERRAFORM_AWS_INSTANCE_M8GD_METAL_48XL
	default "m8gd.48xlarge" if TERRAFORM_AWS_INSTANCE_M8GD_48XLARGE
	default "m8gd.medium"
```

## terraform/aws/kconfigs/instance-types/Kconfig.m8i-flex.static
```kconfig
# AWS M8I-FLEX instance sizes (dynamically generated)

choice
	prompt "Instance size for M8I-FLEX family"
	default TERRAFORM_AWS_INSTANCE_M8I_FLEX_LARGE
	help
	  Select the specific instance size within the M8I-FLEX family.

config TERRAFORM_AWS_INSTANCE_M8I_FLEX_LARGE
	bool "m8i-flex.large"
	help
	  vCPUs: 2
	  Memory: 8.0 GB
	  Network: Up to 12.5 Gigabit
	  Price: pricing varies

config TERRAFORM_AWS_INSTANCE_M8I_FLEX_XLARGE
	bool "m8i-flex.xlarge"
	help
	  vCPUs: 4
	  Memory: 16.0 GB
	  Network: Up to 12.5 Gigabit
	  Price: pricing varies

config TERRAFORM_AWS_INSTANCE_M8I_FLEX_2XLARGE
	bool "m8i-flex.2xlarge"
	help
	  vCPUs: 8
	  Memory: 32.0 GB
	  Network: Up to 15 Gigabit
	  Price: pricing varies

config TERRAFORM_AWS_INSTANCE_M8I_FLEX_4XLARGE
	bool "m8i-flex.4xlarge"
	help
	  vCPUs: 16
	  Memory: 64.0 GB
	  Network: Up to 15 Gigabit
	  Price: pricing varies

config TERRAFORM_AWS_INSTANCE_M8I_FLEX_8XLARGE
	bool "m8i-flex.8xlarge"
	help
	  vCPUs: 32
	  Memory: 128.0 GB
	  Network: Up to 15 Gigabit
	  Price: pricing varies

config TERRAFORM_AWS_INSTANCE_M8I_FLEX_12XLARGE
	bool "m8i-flex.12xlarge"
	help
	  vCPUs: 48
	  Memory: 192.0 GB
	  Network: Up to 22.5 Gigabit
	  Price: pricing varies

config TERRAFORM_AWS_INSTANCE_M8I_FLEX_16XLARGE
	bool "m8i-flex.16xlarge"
	help
	  vCPUs: 64
	  Memory: 256.0 GB
	  Network: Up to 30 Gigabit
	  Price: pricing varies

endchoice

config TERRAFORM_AWS_M8I_FLEX_SIZE
	string
	default "m8i-flex.large" if TERRAFORM_AWS_INSTANCE_M8I_FLEX_LARGE
	default "m8i-flex.xlarge" if TERRAFORM_AWS_INSTANCE_M8I_FLEX_XLARGE
	default "m8i-flex.2xlarge" if TERRAFORM_AWS_INSTANCE_M8I_FLEX_2XLARGE
	default "m8i-flex.4xlarge" if TERRAFORM_AWS_INSTANCE_M8I_FLEX_4XLARGE
	default "m8i-flex.8xlarge" if TERRAFORM_AWS_INSTANCE_M8I_FLEX_8XLARGE
	default "m8i-flex.12xlarge" if TERRAFORM_AWS_INSTANCE_M8I_FLEX_12XLARGE
	default "m8i-flex.16xlarge" if TERRAFORM_AWS_INSTANCE_M8I_FLEX_16XLARGE
	default "m8i-flex.large"
```

## terraform/aws/kconfigs/instance-types/Kconfig.m8i.static
```kconfig
# AWS M8I instance sizes (dynamically generated)

choice
	prompt "Instance size for M8I family"
	default TERRAFORM_AWS_INSTANCE_M8I_LARGE
	help
	  Select the specific instance size within the M8I family.

config TERRAFORM_AWS_INSTANCE_M8I_LARGE
	bool "m8i.large"
	help
	  vCPUs: 2
	  Memory: 8.0 GB
	  Network: Up to 12.5 Gigabit
	  Price: pricing varies

config TERRAFORM_AWS_INSTANCE_M8I_XLARGE
	bool "m8i.xlarge"
	help
	  vCPUs: 4
	  Memory: 16.0 GB
	  Network: Up to 12.5 Gigabit
	  Price: pricing varies

config TERRAFORM_AWS_INSTANCE_M8I_2XLARGE
	bool "m8i.2xlarge"
	help
	  vCPUs: 8
	  Memory: 32.0 GB
	  Network: Up to 15 Gigabit
	  Price: pricing varies

config TERRAFORM_AWS_INSTANCE_M8I_4XLARGE
	bool "m8i.4xlarge"
	help
	  vCPUs: 16
	  Memory: 64.0 GB
	  Network: Up to 15 Gigabit
	  Price: pricing varies

config TERRAFORM_AWS_INSTANCE_M8I_8XLARGE
	bool "m8i.8xlarge"
	help
	  vCPUs: 32
	  Memory: 128.0 GB
	  Network: 15 Gigabit
	  Price: pricing varies

config TERRAFORM_AWS_INSTANCE_M8I_12XLARGE
	bool "m8i.12xlarge"
	help
	  vCPUs: 48
	  Memory: 192.0 GB
	  Network: 22.5 Gigabit
	  Price: pricing varies

config TERRAFORM_AWS_INSTANCE_M8I_16XLARGE
	bool "m8i.16xlarge"
	help
	  vCPUs: 64
	  Memory: 256.0 GB
	  Network: 30 Gigabit
	  Price: pricing varies

config TERRAFORM_AWS_INSTANCE_M8I_24XLARGE
	bool "m8i.24xlarge"
	help
	  vCPUs: 96
	  Memory: 384.0 GB
	  Network: 40 Gigabit
	  Price: pricing varies

config TERRAFORM_AWS_INSTANCE_M8I_32XLARGE
	bool "m8i.32xlarge"
	help
	  vCPUs: 128
	  Memory: 512.0 GB
	  Network: 50 Gigabit
	  Price: pricing varies

config TERRAFORM_AWS_INSTANCE_M8I_48XLARGE
	bool "m8i.48xlarge"
	help
	  vCPUs: 192
	  Memory: 768.0 GB
	  Network: 75 Gigabit
	  Price: pricing varies

config TERRAFORM_AWS_INSTANCE_M8I_METAL_48XL
	bool "m8i.metal-48xl"
	help
	  vCPUs: 192
	  Memory: 768.0 GB
	  Network: 75 Gigabit
	  Price: pricing varies

config TERRAFORM_AWS_INSTANCE_M8I_METAL_96XL
	bool "m8i.metal-96xl"
	help
	  vCPUs: 384
	  Memory: 1536.0 GB
	  Network: 100 Gigabit
	  Price: pricing varies

config TERRAFORM_AWS_INSTANCE_M8I_96XLARGE
	bool "m8i.96xlarge"
	help
	  vCPUs: 384
	  Memory: 1536.0 GB
	  Network: 100 Gigabit
	  Price: pricing varies

endchoice

config TERRAFORM_AWS_M8I_SIZE
	string
	default "m8i.large" if TERRAFORM_AWS_INSTANCE_M8I_LARGE
	default "m8i.xlarge" if TERRAFORM_AWS_INSTANCE_M8I_XLARGE
	default "m8i.2xlarge" if TERRAFORM_AWS_INSTANCE_M8I_2XLARGE
	default "m8i.4xlarge" if TERRAFORM_AWS_INSTANCE_M8I_4XLARGE
	default "m8i.8xlarge" if TERRAFORM_AWS_INSTANCE_M8I_8XLARGE
	default "m8i.12xlarge" if TERRAFORM_AWS_INSTANCE_M8I_12XLARGE
	default "m8i.16xlarge" if TERRAFORM_AWS_INSTANCE_M8I_16XLARGE
	default "m8i.24xlarge" if TERRAFORM_AWS_INSTANCE_M8I_24XLARGE
	default "m8i.32xlarge" if TERRAFORM_AWS_INSTANCE_M8I_32XLARGE
	default "m8i.48xlarge" if TERRAFORM_AWS_INSTANCE_M8I_48XLARGE
	default "m8i.metal-48xl" if TERRAFORM_AWS_INSTANCE_M8I_METAL_48XL
	default "m8i.metal-96xl" if TERRAFORM_AWS_INSTANCE_M8I_METAL_96XL
	default "m8i.96xlarge" if TERRAFORM_AWS_INSTANCE_M8I_96XLARGE
	default "m8i.large"
```

## terraform/aws/kconfigs/instance-types/Kconfig.mac1.static
```kconfig
# AWS MAC1 instance sizes (dynamically generated)

choice
	prompt "Instance size for MAC1 family"
	default TERRAFORM_AWS_INSTANCE_MAC1_METAL
	help
	  Select the specific instance size within the MAC1 family.

config TERRAFORM_AWS_INSTANCE_MAC1_METAL
	bool "mac1.metal"
	help
	  vCPUs: 12
	  Memory: 32.0 GB
	  Network: 25 Gigabit
	  Price: pricing varies

endchoice

config TERRAFORM_AWS_MAC1_SIZE
	string
	default "mac1.metal" if TERRAFORM_AWS_INSTANCE_MAC1_METAL
	default "mac1.metal"
```

## terraform/aws/kconfigs/instance-types/Kconfig.mac2-m1ultra.static
```kconfig
# AWS MAC2-M1ULTRA instance sizes (dynamically generated)

choice
	prompt "Instance size for MAC2-M1ULTRA family"
	default TERRAFORM_AWS_INSTANCE_MAC2_M1ULTRA_METAL
	help
	  Select the specific instance size within the MAC2-M1ULTRA family.

config TERRAFORM_AWS_INSTANCE_MAC2_M1ULTRA_METAL
	bool "mac2-m1ultra.metal"
	help
	  vCPUs: 20
	  Memory: 128.0 GB
	  Network: 10 Gigabit
	  Price: pricing varies

endchoice

config TERRAFORM_AWS_MAC2_M1ULTRA_SIZE
	string
	default "mac2-m1ultra.metal" if TERRAFORM_AWS_INSTANCE_MAC2_M1ULTRA_METAL
	default "mac2-m1ultra.metal"
```

## terraform/aws/kconfigs/instance-types/Kconfig.mac2-m2.static
```kconfig
# AWS MAC2-M2 instance sizes (dynamically generated)

choice
	prompt "Instance size for MAC2-M2 family"
	default TERRAFORM_AWS_INSTANCE_MAC2_M2_METAL
	help
	  Select the specific instance size within the MAC2-M2 family.

config TERRAFORM_AWS_INSTANCE_MAC2_M2_METAL
	bool "mac2-m2.metal"
	help
	  vCPUs: 8
	  Memory: 24.0 GB
	  Network: 10 Gigabit
	  Price: pricing varies

endchoice

config TERRAFORM_AWS_MAC2_M2_SIZE
	string
	default "mac2-m2.metal" if TERRAFORM_AWS_INSTANCE_MAC2_M2_METAL
	default "mac2-m2.metal"
```

## terraform/aws/kconfigs/instance-types/Kconfig.mac2-m2pro.static
```kconfig
# AWS MAC2-M2PRO instance sizes (dynamically generated)

choice
	prompt "Instance size for MAC2-M2PRO family"
	default TERRAFORM_AWS_INSTANCE_MAC2_M2PRO_METAL
	help
	  Select the specific instance size within the MAC2-M2PRO family.

config TERRAFORM_AWS_INSTANCE_MAC2_M2PRO_METAL
	bool "mac2-m2pro.metal"
	help
	  vCPUs: 12
	  Memory: 32.0 GB
	  Network: 10 Gigabit
	  Price: pricing varies

endchoice

config TERRAFORM_AWS_MAC2_M2PRO_SIZE
	string
	default "mac2-m2pro.metal" if TERRAFORM_AWS_INSTANCE_MAC2_M2PRO_METAL
	default "mac2-m2pro.metal"
```

## terraform/aws/kconfigs/instance-types/Kconfig.mac2.static
```kconfig
# AWS MAC2 instance sizes (dynamically generated)

choice
	prompt "Instance size for MAC2 family"
	default TERRAFORM_AWS_INSTANCE_MAC2_METAL
	help
	  Select the specific instance size within the MAC2 family.

config TERRAFORM_AWS_INSTANCE_MAC2_METAL
	bool "mac2.metal"
	help
	  vCPUs: 8
	  Memory: 16.0 GB
	  Network: 10 Gigabit
	  Price: pricing varies

endchoice

config TERRAFORM_AWS_MAC2_SIZE
	string
	default "mac2.metal" if TERRAFORM_AWS_INSTANCE_MAC2_METAL
	default "mac2.metal"
```

## terraform/aws/kconfigs/instance-types/Kconfig.p3.static
```kconfig
# AWS P3 instance sizes (dynamically generated)

choice
	prompt "Instance size for P3 family"
	default TERRAFORM_AWS_INSTANCE_P3_2XLARGE
	help
	  Select the specific instance size within the P3 family.

config TERRAFORM_AWS_INSTANCE_P3_2XLARGE
	bool "p3.2xlarge"
	help
	  vCPUs: 8
	  Memory: 61.0 GB
	  Network: Up to 10 Gigabit
	  Price: pricing varies

config TERRAFORM_AWS_INSTANCE_P3_8XLARGE
	bool "p3.8xlarge"
	help
	  vCPUs: 32
	  Memory: 244.0 GB
	  Network: 10 Gigabit
	  Price: pricing varies

config TERRAFORM_AWS_INSTANCE_P3_16XLARGE
	bool "p3.16xlarge"
	help
	  vCPUs: 64
	  Memory: 488.0 GB
	  Network: 25 Gigabit
	  Price: pricing varies

endchoice

config TERRAFORM_AWS_P3_SIZE
	string
	default "p3.2xlarge" if TERRAFORM_AWS_INSTANCE_P3_2XLARGE
	default "p3.8xlarge" if TERRAFORM_AWS_INSTANCE_P3_8XLARGE
	default "p3.16xlarge" if TERRAFORM_AWS_INSTANCE_P3_16XLARGE
	default "p3.2xlarge"
```
