## terraform/aws/kconfigs/instance-types/Kconfig.m6in.static
```kconfig
# AWS M6IN instance sizes (dynamically generated)

choice
	prompt "Instance size for M6IN family"
	default TERRAFORM_AWS_INSTANCE_M6IN_LARGE
	help
	  Select the specific instance size within the M6IN family.

config TERRAFORM_AWS_INSTANCE_M6IN_LARGE
	bool "m6in.large"
	help
	  vCPUs: 2
	  Memory: 8.0 GB
	  Network: Up to 25 Gigabit
	  Price: pricing varies

config TERRAFORM_AWS_INSTANCE_M6IN_XLARGE
	bool "m6in.xlarge"
	help
	  vCPUs: 4
	  Memory: 16.0 GB
	  Network: Up to 30 Gigabit
	  Price: pricing varies

config TERRAFORM_AWS_INSTANCE_M6IN_2XLARGE
	bool "m6in.2xlarge"
	help
	  vCPUs: 8
	  Memory: 32.0 GB
	  Network: Up to 40 Gigabit
	  Price: pricing varies

config TERRAFORM_AWS_INSTANCE_M6IN_4XLARGE
	bool "m6in.4xlarge"
	help
	  vCPUs: 16
	  Memory: 64.0 GB
	  Network: Up to 50 Gigabit
	  Price: pricing varies

config TERRAFORM_AWS_INSTANCE_M6IN_8XLARGE
	bool "m6in.8xlarge"
	help
	  vCPUs: 32
	  Memory: 128.0 GB
	  Network: 50 Gigabit
	  Price: pricing varies

config TERRAFORM_AWS_INSTANCE_M6IN_12XLARGE
	bool "m6in.12xlarge"
	help
	  vCPUs: 48
	  Memory: 192.0 GB
	  Network: 75 Gigabit
	  Price: pricing varies

config TERRAFORM_AWS_INSTANCE_M6IN_16XLARGE
	bool "m6in.16xlarge"
	help
	  vCPUs: 64
	  Memory: 256.0 GB
	  Network: 100 Gigabit
	  Price: pricing varies

config TERRAFORM_AWS_INSTANCE_M6IN_24XLARGE
	bool "m6in.24xlarge"
	help
	  vCPUs: 96
	  Memory: 384.0 GB
	  Network: 150 Gigabit
	  Price: pricing varies

config TERRAFORM_AWS_INSTANCE_M6IN_32XLARGE
	bool "m6in.32xlarge"
	help
	  vCPUs: 128
	  Memory: 512.0 GB
	  Network: 200 Gigabit
	  Price: pricing varies

config TERRAFORM_AWS_INSTANCE_M6IN_METAL
	bool "m6in.metal"
	help
	  vCPUs: 128
	  Memory: 512.0 GB
	  Network: 200 Gigabit
	  Price: pricing varies

endchoice

config TERRAFORM_AWS_M6IN_SIZE
	string
	default "m6in.large" if TERRAFORM_AWS_INSTANCE_M6IN_LARGE
	default "m6in.xlarge" if TERRAFORM_AWS_INSTANCE_M6IN_XLARGE
	default "m6in.2xlarge" if TERRAFORM_AWS_INSTANCE_M6IN_2XLARGE
	default "m6in.4xlarge" if TERRAFORM_AWS_INSTANCE_M6IN_4XLARGE
	default "m6in.8xlarge" if TERRAFORM_AWS_INSTANCE_M6IN_8XLARGE
	default "m6in.12xlarge" if TERRAFORM_AWS_INSTANCE_M6IN_12XLARGE
	default "m6in.16xlarge" if TERRAFORM_AWS_INSTANCE_M6IN_16XLARGE
	default "m6in.24xlarge" if TERRAFORM_AWS_INSTANCE_M6IN_24XLARGE
	default "m6in.32xlarge" if TERRAFORM_AWS_INSTANCE_M6IN_32XLARGE
	default "m6in.metal" if TERRAFORM_AWS_INSTANCE_M6IN_METAL
	default "m6in.large"
```

## terraform/aws/kconfigs/instance-types/Kconfig.m7a
```kconfig
if TERRAFORM_AWS_INSTANCE_TYPE_M7A

choice
	prompt "AWS instance type"
	default TERRAFORM_AWS_INSTANCE_SIZE_M7A_XLARGE
	help
	  Add storage by increasing the number of EBS volumes per
	  instance.

config TERRAFORM_AWS_INSTANCE_SIZE_M7A_MEDIUM
	bool "m7a.medium"
	depends on TARGET_ARCH_X86_64
	help
	  4 GiB RAM, 1 AMD Ryzen vcpu, 1 10 GiB main drive, and up to
	  12.5 Gbs network speed.

config TERRAFORM_AWS_INSTANCE_SIZE_M7A_LARGE
	bool "m7a.large"
	depends on TARGET_ARCH_X86_64
	help
	  8 GiB RAM, 2 AMD Ryzen vcpus, 1 10 GiB main drive, and up to
	  12.5 Gbs network speed.

config TERRAFORM_AWS_INSTANCE_SIZE_M7A_XLARGE
	bool "m7a.xlarge"
	depends on TARGET_ARCH_X86_64
	help
	  16 GiB RAM, 4 AMD Ryzen vcpus, 1 10 GiB main drive, and up to
	  12.5 Gbs network speed.

config TERRAFORM_AWS_INSTANCE_SIZE_M7A_2XLARGE
	bool "m7a.2xlarge"
	depends on TARGET_ARCH_X86_64
	help
	  32 GiB RAM, 8 AMD Ryzen vcpus, 1 10 GiB main drive, and up to
	  12.5 Gbs network speed.

config TERRAFORM_AWS_INSTANCE_SIZE_M7A_4XLARGE
	bool "m7a.4xlarge"
	depends on TARGET_ARCH_X86_64
	help
	  64 GiB RAM, 16 AMD Ryzen vcpus, 1 10 GiB main drive, and up to
	  12.5 Gbs network speed.

endchoice

config TERRAFORM_AWS_INSTANCE_TYPE
	string
	output yaml
	default "m7a.medium" if TERRAFORM_AWS_INSTANCE_SIZE_M7A_MEDIUM
	default "m7a.large" if TERRAFORM_AWS_INSTANCE_SIZE_M7A_LARGE
	default "m7a.xlarge" if TERRAFORM_AWS_INSTANCE_SIZE_M7A_XLARGE
	default "m7a.xlarge" if TERRAFORM_AWS_INSTANCE_SIZE_M7A_XLARGE
	default "m7a.2xlarge" if TERRAFORM_AWS_INSTANCE_SIZE_M7A_2XLARGE
	default "m7a.4xlarge" if TERRAFORM_AWS_INSTANCE_SIZE_M7A_4XLARGE

endif # TERRAFORM_AWS_INSTANCE_TYPE_M7A
```

## terraform/aws/kconfigs/instance-types/Kconfig.m7a.static
```kconfig
# AWS M7A instance sizes (dynamically generated)

choice
	prompt "Instance size for M7A family"
	default TERRAFORM_AWS_INSTANCE_M7A_MEDIUM
	help
	  Select the specific instance size within the M7A family.

config TERRAFORM_AWS_INSTANCE_M7A_MEDIUM
	bool "m7a.medium"
	help
	  vCPUs: 1
	  Memory: 4.0 GB
	  Network: Up to 12.5 Gigabit
	  Price: $0.046/hour

config TERRAFORM_AWS_INSTANCE_M7A_LARGE
	bool "m7a.large"
	help
	  vCPUs: 2
	  Memory: 8.0 GB
	  Network: Up to 12.5 Gigabit
	  Price: $0.093/hour

config TERRAFORM_AWS_INSTANCE_M7A_XLARGE
	bool "m7a.xlarge"
	help
	  vCPUs: 4
	  Memory: 16.0 GB
	  Network: Up to 12.5 Gigabit
	  Price: $0.186/hour

config TERRAFORM_AWS_INSTANCE_M7A_2XLARGE
	bool "m7a.2xlarge"
	help
	  vCPUs: 8
	  Memory: 32.0 GB
	  Network: Up to 12.5 Gigabit
	  Price: $0.371/hour

config TERRAFORM_AWS_INSTANCE_M7A_4XLARGE
	bool "m7a.4xlarge"
	help
	  vCPUs: 16
	  Memory: 64.0 GB
	  Network: Up to 12.5 Gigabit
	  Price: $0.742/hour

config TERRAFORM_AWS_INSTANCE_M7A_8XLARGE
	bool "m7a.8xlarge"
	help
	  vCPUs: 32
	  Memory: 128.0 GB
	  Network: 12.5 Gigabit
	  Price: $1.485/hour

config TERRAFORM_AWS_INSTANCE_M7A_12XLARGE
	bool "m7a.12xlarge"
	help
	  vCPUs: 48
	  Memory: 192.0 GB
	  Network: 18.75 Gigabit
	  Price: $2.227/hour

config TERRAFORM_AWS_INSTANCE_M7A_16XLARGE
	bool "m7a.16xlarge"
	help
	  vCPUs: 64
	  Memory: 256.0 GB
	  Network: 25 Gigabit
	  Price: $2.970/hour

config TERRAFORM_AWS_INSTANCE_M7A_24XLARGE
	bool "m7a.24xlarge"
	help
	  vCPUs: 96
	  Memory: 384.0 GB
	  Network: 37.5 Gigabit
	  Price: $4.454/hour

config TERRAFORM_AWS_INSTANCE_M7A_32XLARGE
	bool "m7a.32xlarge"
	help
	  vCPUs: 128
	  Memory: 512.0 GB
	  Network: 50 Gigabit
	  Price: $5.939/hour

config TERRAFORM_AWS_INSTANCE_M7A_48XLARGE
	bool "m7a.48xlarge"
	help
	  vCPUs: 192
	  Memory: 768.0 GB
	  Network: 50 Gigabit
	  Price: $8.909/hour

config TERRAFORM_AWS_INSTANCE_M7A_METAL_48XL
	bool "m7a.metal-48xl"
	help
	  vCPUs: 192
	  Memory: 768.0 GB
	  Network: 50 Gigabit
	  Price: pricing varies

endchoice

config TERRAFORM_AWS_M7A_SIZE
	string
	default "m7a.medium" if TERRAFORM_AWS_INSTANCE_M7A_MEDIUM
	default "m7a.large" if TERRAFORM_AWS_INSTANCE_M7A_LARGE
	default "m7a.xlarge" if TERRAFORM_AWS_INSTANCE_M7A_XLARGE
	default "m7a.2xlarge" if TERRAFORM_AWS_INSTANCE_M7A_2XLARGE
	default "m7a.4xlarge" if TERRAFORM_AWS_INSTANCE_M7A_4XLARGE
	default "m7a.8xlarge" if TERRAFORM_AWS_INSTANCE_M7A_8XLARGE
	default "m7a.12xlarge" if TERRAFORM_AWS_INSTANCE_M7A_12XLARGE
	default "m7a.16xlarge" if TERRAFORM_AWS_INSTANCE_M7A_16XLARGE
	default "m7a.24xlarge" if TERRAFORM_AWS_INSTANCE_M7A_24XLARGE
	default "m7a.32xlarge" if TERRAFORM_AWS_INSTANCE_M7A_32XLARGE
	default "m7a.48xlarge" if TERRAFORM_AWS_INSTANCE_M7A_48XLARGE
	default "m7a.metal-48xl" if TERRAFORM_AWS_INSTANCE_M7A_METAL_48XL
	default "m7a.medium"
```

## terraform/aws/kconfigs/instance-types/Kconfig.m7g.static
```kconfig
# AWS M7G instance sizes (dynamically generated)

choice
	prompt "Instance size for M7G family"
	default TERRAFORM_AWS_INSTANCE_M7G_MEDIUM
	help
	  Select the specific instance size within the M7G family.

config TERRAFORM_AWS_INSTANCE_M7G_MEDIUM
	bool "m7g.medium"
	help
	  vCPUs: 1
	  Memory: 4.0 GB
	  Network: Up to 12.5 Gigabit
	  Price: pricing varies

config TERRAFORM_AWS_INSTANCE_M7G_LARGE
	bool "m7g.large"
	help
	  vCPUs: 2
	  Memory: 8.0 GB
	  Network: Up to 12.5 Gigabit
	  Price: pricing varies

config TERRAFORM_AWS_INSTANCE_M7G_XLARGE
	bool "m7g.xlarge"
	help
	  vCPUs: 4
	  Memory: 16.0 GB
	  Network: Up to 12.5 Gigabit
	  Price: pricing varies

config TERRAFORM_AWS_INSTANCE_M7G_2XLARGE
	bool "m7g.2xlarge"
	help
	  vCPUs: 8
	  Memory: 32.0 GB
	  Network: Up to 15 Gigabit
	  Price: pricing varies

config TERRAFORM_AWS_INSTANCE_M7G_4XLARGE
	bool "m7g.4xlarge"
	help
	  vCPUs: 16
	  Memory: 64.0 GB
	  Network: Up to 15 Gigabit
	  Price: pricing varies

config TERRAFORM_AWS_INSTANCE_M7G_8XLARGE
	bool "m7g.8xlarge"
	help
	  vCPUs: 32
	  Memory: 128.0 GB
	  Network: 15 Gigabit
	  Price: pricing varies

config TERRAFORM_AWS_INSTANCE_M7G_12XLARGE
	bool "m7g.12xlarge"
	help
	  vCPUs: 48
	  Memory: 192.0 GB
	  Network: 22.5 Gigabit
	  Price: pricing varies

config TERRAFORM_AWS_INSTANCE_M7G_16XLARGE
	bool "m7g.16xlarge"
	help
	  vCPUs: 64
	  Memory: 256.0 GB
	  Network: 30 Gigabit
	  Price: pricing varies

config TERRAFORM_AWS_INSTANCE_M7G_METAL
	bool "m7g.metal"
	help
	  vCPUs: 64
	  Memory: 256.0 GB
	  Network: 30 Gigabit
	  Price: pricing varies

endchoice

config TERRAFORM_AWS_M7G_SIZE
	string
	default "m7g.medium" if TERRAFORM_AWS_INSTANCE_M7G_MEDIUM
	default "m7g.large" if TERRAFORM_AWS_INSTANCE_M7G_LARGE
	default "m7g.xlarge" if TERRAFORM_AWS_INSTANCE_M7G_XLARGE
	default "m7g.2xlarge" if TERRAFORM_AWS_INSTANCE_M7G_2XLARGE
	default "m7g.4xlarge" if TERRAFORM_AWS_INSTANCE_M7G_4XLARGE
	default "m7g.8xlarge" if TERRAFORM_AWS_INSTANCE_M7G_8XLARGE
	default "m7g.12xlarge" if TERRAFORM_AWS_INSTANCE_M7G_12XLARGE
	default "m7g.16xlarge" if TERRAFORM_AWS_INSTANCE_M7G_16XLARGE
	default "m7g.metal" if TERRAFORM_AWS_INSTANCE_M7G_METAL
	default "m7g.medium"
```

## terraform/aws/kconfigs/instance-types/Kconfig.m7gd.static
```kconfig
# AWS M7GD instance sizes (dynamically generated)

choice
	prompt "Instance size for M7GD family"
	default TERRAFORM_AWS_INSTANCE_M7GD_MEDIUM
	help
	  Select the specific instance size within the M7GD family.

config TERRAFORM_AWS_INSTANCE_M7GD_MEDIUM
	bool "m7gd.medium"
	help
	  vCPUs: 1
	  Memory: 4.0 GB
	  Network: Up to 12.5 Gigabit
	  Price: pricing varies
	  Instance storage: 59 GB

config TERRAFORM_AWS_INSTANCE_M7GD_LARGE
	bool "m7gd.large"
	help
	  vCPUs: 2
	  Memory: 8.0 GB
	  Network: Up to 12.5 Gigabit
	  Price: pricing varies
	  Instance storage: 118 GB

config TERRAFORM_AWS_INSTANCE_M7GD_XLARGE
	bool "m7gd.xlarge"
	help
	  vCPUs: 4
	  Memory: 16.0 GB
	  Network: Up to 12.5 Gigabit
	  Price: pricing varies
	  Instance storage: 237 GB

config TERRAFORM_AWS_INSTANCE_M7GD_2XLARGE
	bool "m7gd.2xlarge"
	help
	  vCPUs: 8
	  Memory: 32.0 GB
	  Network: Up to 15 Gigabit
	  Price: pricing varies
	  Instance storage: 474 GB

config TERRAFORM_AWS_INSTANCE_M7GD_4XLARGE
	bool "m7gd.4xlarge"
	help
	  vCPUs: 16
	  Memory: 64.0 GB
	  Network: Up to 15 Gigabit
	  Price: pricing varies
	  Instance storage: 950 GB

config TERRAFORM_AWS_INSTANCE_M7GD_8XLARGE
	bool "m7gd.8xlarge"
	help
	  vCPUs: 32
	  Memory: 128.0 GB
	  Network: 15 Gigabit
	  Price: pricing varies
	  Instance storage: 1900 GB

config TERRAFORM_AWS_INSTANCE_M7GD_12XLARGE
	bool "m7gd.12xlarge"
	help
	  vCPUs: 48
	  Memory: 192.0 GB
	  Network: 22.5 Gigabit
	  Price: pricing varies
	  Instance storage: 2850 GB

config TERRAFORM_AWS_INSTANCE_M7GD_16XLARGE
	bool "m7gd.16xlarge"
	help
	  vCPUs: 64
	  Memory: 256.0 GB
	  Network: 30 Gigabit
	  Price: pricing varies
	  Instance storage: 3800 GB

config TERRAFORM_AWS_INSTANCE_M7GD_METAL
	bool "m7gd.metal"
	help
	  vCPUs: 64
	  Memory: 256.0 GB
	  Network: 30 Gigabit
	  Price: pricing varies
	  Instance storage: 3800 GB

endchoice

config TERRAFORM_AWS_M7GD_SIZE
	string
	default "m7gd.medium" if TERRAFORM_AWS_INSTANCE_M7GD_MEDIUM
	default "m7gd.large" if TERRAFORM_AWS_INSTANCE_M7GD_LARGE
	default "m7gd.xlarge" if TERRAFORM_AWS_INSTANCE_M7GD_XLARGE
	default "m7gd.2xlarge" if TERRAFORM_AWS_INSTANCE_M7GD_2XLARGE
	default "m7gd.4xlarge" if TERRAFORM_AWS_INSTANCE_M7GD_4XLARGE
	default "m7gd.8xlarge" if TERRAFORM_AWS_INSTANCE_M7GD_8XLARGE
	default "m7gd.12xlarge" if TERRAFORM_AWS_INSTANCE_M7GD_12XLARGE
	default "m7gd.16xlarge" if TERRAFORM_AWS_INSTANCE_M7GD_16XLARGE
	default "m7gd.metal" if TERRAFORM_AWS_INSTANCE_M7GD_METAL
	default "m7gd.medium"
```

## terraform/aws/kconfigs/instance-types/Kconfig.m7i.static
```kconfig
# AWS M7I instance sizes (dynamically generated)

choice
	prompt "Instance size for M7I family"
	default TERRAFORM_AWS_INSTANCE_M7I_LARGE
	help
	  Select the specific instance size within the M7I family.

config TERRAFORM_AWS_INSTANCE_M7I_LARGE
	bool "m7i.large"
	help
	  vCPUs: 2
	  Memory: 8.0 GB
	  Network: Up to 12.5 Gigabit
	  Price: pricing varies

config TERRAFORM_AWS_INSTANCE_M7I_XLARGE
	bool "m7i.xlarge"
	help
	  vCPUs: 4
	  Memory: 16.0 GB
	  Network: Up to 12.5 Gigabit
	  Price: pricing varies

config TERRAFORM_AWS_INSTANCE_M7I_2XLARGE
	bool "m7i.2xlarge"
	help
	  vCPUs: 8
	  Memory: 32.0 GB
	  Network: Up to 12.5 Gigabit
	  Price: pricing varies

config TERRAFORM_AWS_INSTANCE_M7I_4XLARGE
	bool "m7i.4xlarge"
	help
	  vCPUs: 16
	  Memory: 64.0 GB
	  Network: Up to 12.5 Gigabit
	  Price: pricing varies

config TERRAFORM_AWS_INSTANCE_M7I_8XLARGE
	bool "m7i.8xlarge"
	help
	  vCPUs: 32
	  Memory: 128.0 GB
	  Network: 12.5 Gigabit
	  Price: pricing varies

config TERRAFORM_AWS_INSTANCE_M7I_12XLARGE
	bool "m7i.12xlarge"
	help
	  vCPUs: 48
	  Memory: 192.0 GB
	  Network: 18.75 Gigabit
	  Price: pricing varies

config TERRAFORM_AWS_INSTANCE_M7I_16XLARGE
	bool "m7i.16xlarge"
	help
	  vCPUs: 64
	  Memory: 256.0 GB
	  Network: 25 Gigabit
	  Price: pricing varies

config TERRAFORM_AWS_INSTANCE_M7I_METAL_24XL
	bool "m7i.metal-24xl"
	help
	  vCPUs: 96
	  Memory: 384.0 GB
	  Network: 37.5 Gigabit
	  Price: pricing varies

config TERRAFORM_AWS_INSTANCE_M7I_24XLARGE
	bool "m7i.24xlarge"
	help
	  vCPUs: 96
	  Memory: 384.0 GB
	  Network: 37.5 Gigabit
	  Price: pricing varies

config TERRAFORM_AWS_INSTANCE_M7I_48XLARGE
	bool "m7i.48xlarge"
	help
	  vCPUs: 192
	  Memory: 768.0 GB
	  Network: 50 Gigabit
	  Price: pricing varies

config TERRAFORM_AWS_INSTANCE_M7I_METAL_48XL
	bool "m7i.metal-48xl"
	help
	  vCPUs: 192
	  Memory: 768.0 GB
	  Network: 50 Gigabit
	  Price: pricing varies

endchoice

config TERRAFORM_AWS_M7I_SIZE
	string
	default "m7i.large" if TERRAFORM_AWS_INSTANCE_M7I_LARGE
	default "m7i.xlarge" if TERRAFORM_AWS_INSTANCE_M7I_XLARGE
	default "m7i.2xlarge" if TERRAFORM_AWS_INSTANCE_M7I_2XLARGE
	default "m7i.4xlarge" if TERRAFORM_AWS_INSTANCE_M7I_4XLARGE
	default "m7i.8xlarge" if TERRAFORM_AWS_INSTANCE_M7I_8XLARGE
	default "m7i.12xlarge" if TERRAFORM_AWS_INSTANCE_M7I_12XLARGE
	default "m7i.16xlarge" if TERRAFORM_AWS_INSTANCE_M7I_16XLARGE
	default "m7i.metal-24xl" if TERRAFORM_AWS_INSTANCE_M7I_METAL_24XL
	default "m7i.24xlarge" if TERRAFORM_AWS_INSTANCE_M7I_24XLARGE
	default "m7i.48xlarge" if TERRAFORM_AWS_INSTANCE_M7I_48XLARGE
	default "m7i.metal-48xl" if TERRAFORM_AWS_INSTANCE_M7I_METAL_48XL
	default "m7i.large"
```
