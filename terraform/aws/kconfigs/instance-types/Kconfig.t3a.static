## terraform/aws/kconfigs/instance-types/Kconfig.t3a.static
```kconfig
# AWS T3A instance sizes (dynamically generated)

choice
	prompt "Instance size for T3A family"
	default TERRAFORM_AWS_INSTANCE_T3A_NANO
	help
	  Select the specific instance size within the T3A family.

config TERRAFORM_AWS_INSTANCE_T3A_NANO
	bool "t3a.nano"
	help
	  vCPUs: 2
	  Memory: 0.5 GB
	  Network: Up to 5 Gigabit
	  Price: $0.005/hour

config TERRAFORM_AWS_INSTANCE_T3A_MICRO
	bool "t3a.micro"
	help
	  vCPUs: 2
	  Memory: 1.0 GB
	  Network: Up to 5 Gigabit
	  Price: $0.009/hour

config TERRAFORM_AWS_INSTANCE_T3A_SMALL
	bool "t3a.small"
	help
	  vCPUs: 2
	  Memory: 2.0 GB
	  Network: Up to 5 Gigabit
	  Price: $0.019/hour

config TERRAFORM_AWS_INSTANCE_T3A_MEDIUM
	bool "t3a.medium"
	help
	  vCPUs: 2
	  Memory: 4.0 GB
	  Network: Up to 5 Gigabit
	  Price: $0.038/hour

config TERRAFORM_AWS_INSTANCE_T3A_LARGE
	bool "t3a.large"
	help
	  vCPUs: 2
	  Memory: 8.0 GB
	  Network: Up to 5 Gigabit
	  Price: $0.075/hour

config TERRAFORM_AWS_INSTANCE_T3A_XLARGE
	bool "t3a.xlarge"
	help
	  vCPUs: 4
	  Memory: 16.0 GB
	  Network: Up to 5 Gigabit
	  Price: $0.150/hour

config TERRAFORM_AWS_INSTANCE_T3A_2XLARGE
	bool "t3a.2xlarge"
	help
	  vCPUs: 8
	  Memory: 32.0 GB
	  Network: Up to 5 Gigabit
	  Price: $0.301/hour

endchoice

config TERRAFORM_AWS_T3A_SIZE
	string
	default "t3a.nano" if TERRAFORM_AWS_INSTANCE_T3A_NANO
	default "t3a.micro" if TERRAFORM_AWS_INSTANCE_T3A_MICRO
	default "t3a.small" if TERRAFORM_AWS_INSTANCE_T3A_SMALL
	default "t3a.medium" if TERRAFORM_AWS_INSTANCE_T3A_MEDIUM
	default "t3a.large" if TERRAFORM_AWS_INSTANCE_T3A_LARGE
	default "t3a.xlarge" if TERRAFORM_AWS_INSTANCE_T3A_XLARGE
	default "t3a.2xlarge" if TERRAFORM_AWS_INSTANCE_T3A_2XLARGE
	default "t3a.nano"
```

## terraform/aws/kconfigs/instance-types/Kconfig.t4g.static
```kconfig
# AWS T4G instance sizes (dynamically generated)

choice
	prompt "Instance size for T4G family"
	default TERRAFORM_AWS_INSTANCE_T4G_NANO
	help
	  Select the specific instance size within the T4G family.

config TERRAFORM_AWS_INSTANCE_T4G_NANO
	bool "t4g.nano"
	help
	  vCPUs: 2
	  Memory: 0.5 GB
	  Network: Up to 5 Gigabit
	  Price: pricing varies

config TERRAFORM_AWS_INSTANCE_T4G_MICRO
	bool "t4g.micro"
	help
	  vCPUs: 2
	  Memory: 1.0 GB
	  Network: Up to 5 Gigabit
	  Price: pricing varies

config TERRAFORM_AWS_INSTANCE_T4G_SMALL
	bool "t4g.small"
	help
	  vCPUs: 2
	  Memory: 2.0 GB
	  Network: Up to 5 Gigabit
	  Price: pricing varies

config TERRAFORM_AWS_INSTANCE_T4G_MEDIUM
	bool "t4g.medium"
	help
	  vCPUs: 2
	  Memory: 4.0 GB
	  Network: Up to 5 Gigabit
	  Price: pricing varies

config TERRAFORM_AWS_INSTANCE_T4G_LARGE
	bool "t4g.large"
	help
	  vCPUs: 2
	  Memory: 8.0 GB
	  Network: Up to 5 Gigabit
	  Price: pricing varies

config TERRAFORM_AWS_INSTANCE_T4G_XLARGE
	bool "t4g.xlarge"
	help
	  vCPUs: 4
	  Memory: 16.0 GB
	  Network: Up to 5 Gigabit
	  Price: pricing varies

config TERRAFORM_AWS_INSTANCE_T4G_2XLARGE
	bool "t4g.2xlarge"
	help
	  vCPUs: 8
	  Memory: 32.0 GB
	  Network: Up to 5 Gigabit
	  Price: pricing varies

endchoice

config TERRAFORM_AWS_T4G_SIZE
	string
	default "t4g.nano" if TERRAFORM_AWS_INSTANCE_T4G_NANO
	default "t4g.micro" if TERRAFORM_AWS_INSTANCE_T4G_MICRO
	default "t4g.small" if TERRAFORM_AWS_INSTANCE_T4G_SMALL
	default "t4g.medium" if TERRAFORM_AWS_INSTANCE_T4G_MEDIUM
	default "t4g.large" if TERRAFORM_AWS_INSTANCE_T4G_LARGE
	default "t4g.xlarge" if TERRAFORM_AWS_INSTANCE_T4G_XLARGE
	default "t4g.2xlarge" if TERRAFORM_AWS_INSTANCE_T4G_2XLARGE
	default "t4g.nano"
```

## terraform/aws/kconfigs/instance-types/Kconfig.trn1.static
```kconfig
# AWS TRN1 instance sizes (dynamically generated)

choice
	prompt "Instance size for TRN1 family"
	default TERRAFORM_AWS_INSTANCE_TRN1_2XLARGE
	help
	  Select the specific instance size within the TRN1 family.

config TERRAFORM_AWS_INSTANCE_TRN1_2XLARGE
	bool "trn1.2xlarge"
	help
	  vCPUs: 8
	  Memory: 32.0 GB
	  Network: Up to 12.5 Gigabit
	  Price: pricing varies
	  Instance storage: 474 GB

config TERRAFORM_AWS_INSTANCE_TRN1_32XLARGE
	bool "trn1.32xlarge"
	help
	  vCPUs: 128
	  Memory: 512.0 GB
	  Network: 8x 100 Gigabit
	  Price: pricing varies
	  Instance storage: 7600 GB

endchoice

config TERRAFORM_AWS_TRN1_SIZE
	string
	default "trn1.2xlarge" if TERRAFORM_AWS_INSTANCE_TRN1_2XLARGE
	default "trn1.32xlarge" if TERRAFORM_AWS_INSTANCE_TRN1_32XLARGE
	default "trn1.2xlarge"
```

## terraform/aws/kconfigs/instance-types/Kconfig.trn1n.static
```kconfig
# AWS TRN1N instance sizes (dynamically generated)

choice
	prompt "Instance size for TRN1N family"
	default TERRAFORM_AWS_INSTANCE_TRN1N_32XLARGE
	help
	  Select the specific instance size within the TRN1N family.

config TERRAFORM_AWS_INSTANCE_TRN1N_32XLARGE
	bool "trn1n.32xlarge"
	help
	  vCPUs: 128
	  Memory: 512.0 GB
	  Network: 16x 100 Gigabit
	  Price: pricing varies
	  Instance storage: 7600 GB

endchoice

config TERRAFORM_AWS_TRN1N_SIZE
	string
	default "trn1n.32xlarge" if TERRAFORM_AWS_INSTANCE_TRN1N_32XLARGE
	default "trn1n.32xlarge"
```

## terraform/aws/kconfigs/instance-types/Kconfig.u-3tb1.static
```kconfig
# AWS U-3TB1 instance sizes (dynamically generated)

choice
	prompt "Instance size for U-3TB1 family"
	default TERRAFORM_AWS_INSTANCE_U_3TB1_56XLARGE
	help
	  Select the specific instance size within the U-3TB1 family.

config TERRAFORM_AWS_INSTANCE_U_3TB1_56XLARGE
	bool "u-3tb1.56xlarge"
	help
	  vCPUs: 224
	  Memory: 3072.0 GB
	  Network: 50 Gigabit
	  Price: pricing varies

endchoice

config TERRAFORM_AWS_U_3TB1_SIZE
	string
	default "u-3tb1.56xlarge" if TERRAFORM_AWS_INSTANCE_U_3TB1_56XLARGE
	default "u-3tb1.56xlarge"
```

## terraform/aws/kconfigs/instance-types/Kconfig.u-6tb1.static
```kconfig
# AWS U-6TB1 instance sizes (dynamically generated)

choice
	prompt "Instance size for U-6TB1 family"
	default TERRAFORM_AWS_INSTANCE_U_6TB1_56XLARGE
	help
	  Select the specific instance size within the U-6TB1 family.

config TERRAFORM_AWS_INSTANCE_U_6TB1_56XLARGE
	bool "u-6tb1.56xlarge"
	help
	  vCPUs: 224
	  Memory: 6144.0 GB
	  Network: 100 Gigabit
	  Price: pricing varies

config TERRAFORM_AWS_INSTANCE_U_6TB1_112XLARGE
	bool "u-6tb1.112xlarge"
	help
	  vCPUs: 448
	  Memory: 6144.0 GB
	  Network: 100 Gigabit
	  Price: pricing varies

endchoice

config TERRAFORM_AWS_U_6TB1_SIZE
	string
	default "u-6tb1.56xlarge" if TERRAFORM_AWS_INSTANCE_U_6TB1_56XLARGE
	default "u-6tb1.112xlarge" if TERRAFORM_AWS_INSTANCE_U_6TB1_112XLARGE
	default "u-6tb1.56xlarge"
```

## terraform/aws/kconfigs/instance-types/Kconfig.u7i-12tb.static
```kconfig
# AWS U7I-12TB instance sizes (dynamically generated)

choice
	prompt "Instance size for U7I-12TB family"
	default TERRAFORM_AWS_INSTANCE_U7I_12TB_224XLARGE
	help
	  Select the specific instance size within the U7I-12TB family.

config TERRAFORM_AWS_INSTANCE_U7I_12TB_224XLARGE
	bool "u7i-12tb.224xlarge"
	help
	  vCPUs: 896
	  Memory: 12288.0 GB
	  Network: 100 Gigabit
	  Price: pricing varies

endchoice

config TERRAFORM_AWS_U7I_12TB_SIZE
	string
	default "u7i-12tb.224xlarge" if TERRAFORM_AWS_INSTANCE_U7I_12TB_224XLARGE
	default "u7i-12tb.224xlarge"
```

## terraform/aws/kconfigs/instance-types/Kconfig.u7i-6tb.static
```kconfig
# AWS U7I-6TB instance sizes (dynamically generated)

choice
	prompt "Instance size for U7I-6TB family"
	default TERRAFORM_AWS_INSTANCE_U7I_6TB_112XLARGE
	help
	  Select the specific instance size within the U7I-6TB family.

config TERRAFORM_AWS_INSTANCE_U7I_6TB_112XLARGE
	bool "u7i-6tb.112xlarge"
	help
	  vCPUs: 448
	  Memory: 6144.0 GB
	  Network: 100 Gigabit
	  Price: pricing varies

endchoice

config TERRAFORM_AWS_U7I_6TB_SIZE
	string
	default "u7i-6tb.112xlarge" if TERRAFORM_AWS_INSTANCE_U7I_6TB_112XLARGE
	default "u7i-6tb.112xlarge"
```

## terraform/aws/kconfigs/instance-types/Kconfig.u7i-8tb.static
```kconfig
# AWS U7I-8TB instance sizes (dynamically generated)

choice
	prompt "Instance size for U7I-8TB family"
	default TERRAFORM_AWS_INSTANCE_U7I_8TB_112XLARGE
	help
	  Select the specific instance size within the U7I-8TB family.

config TERRAFORM_AWS_INSTANCE_U7I_8TB_112XLARGE
	bool "u7i-8tb.112xlarge"
	help
	  vCPUs: 448
	  Memory: 8192.0 GB
	  Network: 100 Gigabit
	  Price: pricing varies

endchoice

config TERRAFORM_AWS_U7I_8TB_SIZE
	string
	default "u7i-8tb.112xlarge" if TERRAFORM_AWS_INSTANCE_U7I_8TB_112XLARGE
	default "u7i-8tb.112xlarge"
```

## terraform/aws/kconfigs/instance-types/Kconfig.u7in-16tb.static
```kconfig
# AWS U7IN-16TB instance sizes (dynamically generated)

choice
	prompt "Instance size for U7IN-16TB family"
	default TERRAFORM_AWS_INSTANCE_U7IN_16TB_224XLARGE
	help
	  Select the specific instance size within the U7IN-16TB family.

config TERRAFORM_AWS_INSTANCE_U7IN_16TB_224XLARGE
	bool "u7in-16tb.224xlarge"
	help
	  vCPUs: 896
	  Memory: 16384.0 GB
	  Network: 200 Gigabit
	  Price: pricing varies

endchoice

config TERRAFORM_AWS_U7IN_16TB_SIZE
	string
	default "u7in-16tb.224xlarge" if TERRAFORM_AWS_INSTANCE_U7IN_16TB_224XLARGE
	default "u7in-16tb.224xlarge"
```

## terraform/aws/kconfigs/instance-types/Kconfig.u7in-24tb.static
```kconfig
# AWS U7IN-24TB instance sizes (dynamically generated)

choice
	prompt "Instance size for U7IN-24TB family"
	default TERRAFORM_AWS_INSTANCE_U7IN_24TB_224XLARGE
	help
	  Select the specific instance size within the U7IN-24TB family.

config TERRAFORM_AWS_INSTANCE_U7IN_24TB_224XLARGE
	bool "u7in-24tb.224xlarge"
	help
	  vCPUs: 896
	  Memory: 24576.0 GB
	  Network: 200 Gigabit
	  Price: pricing varies

endchoice

config TERRAFORM_AWS_U7IN_24TB_SIZE
	string
	default "u7in-24tb.224xlarge" if TERRAFORM_AWS_INSTANCE_U7IN_24TB_224XLARGE
	default "u7in-24tb.224xlarge"
```

## terraform/aws/kconfigs/instance-types/Kconfig.u7in-32tb.static
```kconfig
# AWS U7IN-32TB instance sizes (dynamically generated)

choice
	prompt "Instance size for U7IN-32TB family"
	default TERRAFORM_AWS_INSTANCE_U7IN_32TB_224XLARGE
	help
	  Select the specific instance size within the U7IN-32TB family.

config TERRAFORM_AWS_INSTANCE_U7IN_32TB_224XLARGE
	bool "u7in-32tb.224xlarge"
	help
	  vCPUs: 896
	  Memory: 32768.0 GB
	  Network: 200 Gigabit
	  Price: pricing varies

endchoice

config TERRAFORM_AWS_U7IN_32TB_SIZE
	string
	default "u7in-32tb.224xlarge" if TERRAFORM_AWS_INSTANCE_U7IN_32TB_224XLARGE
	default "u7in-32tb.224xlarge"
```

## terraform/aws/kconfigs/instance-types/Kconfig.vt1.static
```kconfig
# AWS VT1 instance sizes (dynamically generated)

choice
	prompt "Instance size for VT1 family"
	default TERRAFORM_AWS_INSTANCE_VT1_3XLARGE
	help
	  Select the specific instance size within the VT1 family.

config TERRAFORM_AWS_INSTANCE_VT1_3XLARGE
	bool "vt1.3xlarge"
	help
	  vCPUs: 12
	  Memory: 24.0 GB
	  Network: 3.12 Gigabit
	  Price: pricing varies

config TERRAFORM_AWS_INSTANCE_VT1_6XLARGE
	bool "vt1.6xlarge"
	help
	  vCPUs: 24
	  Memory: 48.0 GB
	  Network: 6.25 Gigabit
	  Price: pricing varies

config TERRAFORM_AWS_INSTANCE_VT1_24XLARGE
	bool "vt1.24xlarge"
	help
	  vCPUs: 96
	  Memory: 192.0 GB
	  Network: 25 Gigabit
	  Price: pricing varies

endchoice

config TERRAFORM_AWS_VT1_SIZE
	string
	default "vt1.3xlarge" if TERRAFORM_AWS_INSTANCE_VT1_3XLARGE
	default "vt1.6xlarge" if TERRAFORM_AWS_INSTANCE_VT1_6XLARGE
	default "vt1.24xlarge" if TERRAFORM_AWS_INSTANCE_VT1_24XLARGE
	default "vt1.3xlarge"
```

## terraform/aws/kconfigs/instance-types/Kconfig.x1.static
```kconfig
# AWS X1 instance sizes (dynamically generated)

choice
	prompt "Instance size for X1 family"
	default TERRAFORM_AWS_INSTANCE_X1_16XLARGE
	help
	  Select the specific instance size within the X1 family.

config TERRAFORM_AWS_INSTANCE_X1_16XLARGE
	bool "x1.16xlarge"
	help
	  vCPUs: 64
	  Memory: 976.0 GB
	  Network: 10 Gigabit
	  Price: pricing varies
	  Instance storage: 1920 GB

config TERRAFORM_AWS_INSTANCE_X1_32XLARGE
	bool "x1.32xlarge"
	help
	  vCPUs: 128
	  Memory: 1952.0 GB
	  Network: 25 Gigabit
	  Price: pricing varies
	  Instance storage: 3840 GB

endchoice

config TERRAFORM_AWS_X1_SIZE
	string
	default "x1.16xlarge" if TERRAFORM_AWS_INSTANCE_X1_16XLARGE
	default "x1.32xlarge" if TERRAFORM_AWS_INSTANCE_X1_32XLARGE
	default "x1.16xlarge"
```

## terraform/aws/kconfigs/instance-types/Kconfig.x1e.static
```kconfig
# AWS X1E instance sizes (dynamically generated)

choice
	prompt "Instance size for X1E family"
	default TERRAFORM_AWS_INSTANCE_X1E_XLARGE
	help
	  Select the specific instance size within the X1E family.

config TERRAFORM_AWS_INSTANCE_X1E_XLARGE
	bool "x1e.xlarge"
	help
	  vCPUs: 4
	  Memory: 122.0 GB
	  Network: Up to 10 Gigabit
	  Price: pricing varies
	  Instance storage: 120 GB

config TERRAFORM_AWS_INSTANCE_X1E_2XLARGE
	bool "x1e.2xlarge"
	help
	  vCPUs: 8
	  Memory: 244.0 GB
	  Network: Up to 10 Gigabit
	  Price: pricing varies
	  Instance storage: 240 GB

config TERRAFORM_AWS_INSTANCE_X1E_4XLARGE
	bool "x1e.4xlarge"
	help
	  vCPUs: 16
	  Memory: 488.0 GB
	  Network: Up to 10 Gigabit
	  Price: pricing varies
	  Instance storage: 480 GB

config TERRAFORM_AWS_INSTANCE_X1E_8XLARGE
	bool "x1e.8xlarge"
	help
	  vCPUs: 32
	  Memory: 976.0 GB
	  Network: Up to 10 Gigabit
	  Price: pricing varies
	  Instance storage: 960 GB

config TERRAFORM_AWS_INSTANCE_X1E_16XLARGE
	bool "x1e.16xlarge"
	help
	  vCPUs: 64
	  Memory: 1952.0 GB
	  Network: 10 Gigabit
	  Price: pricing varies
	  Instance storage: 1920 GB

config TERRAFORM_AWS_INSTANCE_X1E_32XLARGE
	bool "x1e.32xlarge"
	help
	  vCPUs: 128
	  Memory: 3904.0 GB
	  Network: 25 Gigabit
	  Price: pricing varies
	  Instance storage: 3840 GB

endchoice

config TERRAFORM_AWS_X1E_SIZE
	string
	default "x1e.xlarge" if TERRAFORM_AWS_INSTANCE_X1E_XLARGE
	default "x1e.2xlarge" if TERRAFORM_AWS_INSTANCE_X1E_2XLARGE
	default "x1e.4xlarge" if TERRAFORM_AWS_INSTANCE_X1E_4XLARGE
	default "x1e.8xlarge" if TERRAFORM_AWS_INSTANCE_X1E_8XLARGE
	default "x1e.16xlarge" if TERRAFORM_AWS_INSTANCE_X1E_16XLARGE
	default "x1e.32xlarge" if TERRAFORM_AWS_INSTANCE_X1E_32XLARGE
	default "x1e.xlarge"
```
