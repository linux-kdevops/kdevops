## terraform/aws/kconfigs/instance-types/Kconfig.x2gd.static
```kconfig
# AWS X2GD instance sizes (dynamically generated)

choice
	prompt "Instance size for X2GD family"
	default TERRAFORM_AWS_INSTANCE_X2GD_MEDIUM
	help
	  Select the specific instance size within the X2GD family.

config TERRAFORM_AWS_INSTANCE_X2GD_MEDIUM
	bool "x2gd.medium"
	help
	  vCPUs: 1
	  Memory: 16.0 GB
	  Network: Up to 10 Gigabit
	  Price: pricing varies
	  Instance storage: 59 GB

config TERRAFORM_AWS_INSTANCE_X2GD_LARGE
	bool "x2gd.large"
	help
	  vCPUs: 2
	  Memory: 32.0 GB
	  Network: Up to 10 Gigabit
	  Price: pricing varies
	  Instance storage: 118 GB

config TERRAFORM_AWS_INSTANCE_X2GD_XLARGE
	bool "x2gd.xlarge"
	help
	  vCPUs: 4
	  Memory: 64.0 GB
	  Network: Up to 10 Gigabit
	  Price: pricing varies
	  Instance storage: 237 GB

config TERRAFORM_AWS_INSTANCE_X2GD_2XLARGE
	bool "x2gd.2xlarge"
	help
	  vCPUs: 8
	  Memory: 128.0 GB
	  Network: Up to 10 Gigabit
	  Price: pricing varies
	  Instance storage: 475 GB

config TERRAFORM_AWS_INSTANCE_X2GD_4XLARGE
	bool "x2gd.4xlarge"
	help
	  vCPUs: 16
	  Memory: 256.0 GB
	  Network: Up to 10 Gigabit
	  Price: pricing varies
	  Instance storage: 950 GB

config TERRAFORM_AWS_INSTANCE_X2GD_8XLARGE
	bool "x2gd.8xlarge"
	help
	  vCPUs: 32
	  Memory: 512.0 GB
	  Network: 12 Gigabit
	  Price: pricing varies
	  Instance storage: 1900 GB

config TERRAFORM_AWS_INSTANCE_X2GD_12XLARGE
	bool "x2gd.12xlarge"
	help
	  vCPUs: 48
	  Memory: 768.0 GB
	  Network: 20 Gigabit
	  Price: pricing varies
	  Instance storage: 2850 GB

config TERRAFORM_AWS_INSTANCE_X2GD_METAL
	bool "x2gd.metal"
	help
	  vCPUs: 64
	  Memory: 1024.0 GB
	  Network: 25 Gigabit
	  Price: pricing varies
	  Instance storage: 3800 GB

config TERRAFORM_AWS_INSTANCE_X2GD_16XLARGE
	bool "x2gd.16xlarge"
	help
	  vCPUs: 64
	  Memory: 1024.0 GB
	  Network: 25 Gigabit
	  Price: pricing varies
	  Instance storage: 3800 GB

endchoice

config TERRAFORM_AWS_X2GD_SIZE
	string
	default "x2gd.medium" if TERRAFORM_AWS_INSTANCE_X2GD_MEDIUM
	default "x2gd.large" if TERRAFORM_AWS_INSTANCE_X2GD_LARGE
	default "x2gd.xlarge" if TERRAFORM_AWS_INSTANCE_X2GD_XLARGE
	default "x2gd.2xlarge" if TERRAFORM_AWS_INSTANCE_X2GD_2XLARGE
	default "x2gd.4xlarge" if TERRAFORM_AWS_INSTANCE_X2GD_4XLARGE
	default "x2gd.8xlarge" if TERRAFORM_AWS_INSTANCE_X2GD_8XLARGE
	default "x2gd.12xlarge" if TERRAFORM_AWS_INSTANCE_X2GD_12XLARGE
	default "x2gd.metal" if TERRAFORM_AWS_INSTANCE_X2GD_METAL
	default "x2gd.16xlarge" if TERRAFORM_AWS_INSTANCE_X2GD_16XLARGE
	default "x2gd.medium"
```

## terraform/aws/kconfigs/instance-types/Kconfig.x2idn.static
```kconfig
# AWS X2IDN instance sizes (dynamically generated)

choice
	prompt "Instance size for X2IDN family"
	default TERRAFORM_AWS_INSTANCE_X2IDN_16XLARGE
	help
	  Select the specific instance size within the X2IDN family.

config TERRAFORM_AWS_INSTANCE_X2IDN_16XLARGE
	bool "x2idn.16xlarge"
	help
	  vCPUs: 64
	  Memory: 1024.0 GB
	  Network: 50 Gigabit
	  Price: pricing varies
	  Instance storage: 1900 GB

config TERRAFORM_AWS_INSTANCE_X2IDN_24XLARGE
	bool "x2idn.24xlarge"
	help
	  vCPUs: 96
	  Memory: 1536.0 GB
	  Network: 75 Gigabit
	  Price: pricing varies
	  Instance storage: 2850 GB

config TERRAFORM_AWS_INSTANCE_X2IDN_METAL
	bool "x2idn.metal"
	help
	  vCPUs: 128
	  Memory: 2048.0 GB
	  Network: 100 Gigabit
	  Price: pricing varies
	  Instance storage: 3800 GB

config TERRAFORM_AWS_INSTANCE_X2IDN_32XLARGE
	bool "x2idn.32xlarge"
	help
	  vCPUs: 128
	  Memory: 2048.0 GB
	  Network: 100 Gigabit
	  Price: pricing varies
	  Instance storage: 3800 GB

endchoice

config TERRAFORM_AWS_X2IDN_SIZE
	string
	default "x2idn.16xlarge" if TERRAFORM_AWS_INSTANCE_X2IDN_16XLARGE
	default "x2idn.24xlarge" if TERRAFORM_AWS_INSTANCE_X2IDN_24XLARGE
	default "x2idn.metal" if TERRAFORM_AWS_INSTANCE_X2IDN_METAL
	default "x2idn.32xlarge" if TERRAFORM_AWS_INSTANCE_X2IDN_32XLARGE
	default "x2idn.16xlarge"
```

## terraform/aws/kconfigs/instance-types/Kconfig.x2iedn.static
```kconfig
# AWS X2IEDN instance sizes (dynamically generated)

choice
	prompt "Instance size for X2IEDN family"
	default TERRAFORM_AWS_INSTANCE_X2IEDN_XLARGE
	help
	  Select the specific instance size within the X2IEDN family.

config TERRAFORM_AWS_INSTANCE_X2IEDN_XLARGE
	bool "x2iedn.xlarge"
	help
	  vCPUs: 4
	  Memory: 128.0 GB
	  Network: Up to 25 Gigabit
	  Price: pricing varies
	  Instance storage: 118 GB

config TERRAFORM_AWS_INSTANCE_X2IEDN_2XLARGE
	bool "x2iedn.2xlarge"
	help
	  vCPUs: 8
	  Memory: 256.0 GB
	  Network: Up to 25 Gigabit
	  Price: pricing varies
	  Instance storage: 237 GB

config TERRAFORM_AWS_INSTANCE_X2IEDN_4XLARGE
	bool "x2iedn.4xlarge"
	help
	  vCPUs: 16
	  Memory: 512.0 GB
	  Network: Up to 25 Gigabit
	  Price: pricing varies
	  Instance storage: 475 GB

config TERRAFORM_AWS_INSTANCE_X2IEDN_8XLARGE
	bool "x2iedn.8xlarge"
	help
	  vCPUs: 32
	  Memory: 1024.0 GB
	  Network: 25 Gigabit
	  Price: pricing varies
	  Instance storage: 950 GB

config TERRAFORM_AWS_INSTANCE_X2IEDN_16XLARGE
	bool "x2iedn.16xlarge"
	help
	  vCPUs: 64
	  Memory: 2048.0 GB
	  Network: 50 Gigabit
	  Price: pricing varies
	  Instance storage: 1900 GB

config TERRAFORM_AWS_INSTANCE_X2IEDN_24XLARGE
	bool "x2iedn.24xlarge"
	help
	  vCPUs: 96
	  Memory: 3072.0 GB
	  Network: 75 Gigabit
	  Price: pricing varies
	  Instance storage: 2850 GB

config TERRAFORM_AWS_INSTANCE_X2IEDN_METAL
	bool "x2iedn.metal"
	help
	  vCPUs: 128
	  Memory: 4096.0 GB
	  Network: 100 Gigabit
	  Price: pricing varies
	  Instance storage: 3800 GB

config TERRAFORM_AWS_INSTANCE_X2IEDN_32XLARGE
	bool "x2iedn.32xlarge"
	help
	  vCPUs: 128
	  Memory: 4096.0 GB
	  Network: 100 Gigabit
	  Price: pricing varies
	  Instance storage: 3800 GB

endchoice

config TERRAFORM_AWS_X2IEDN_SIZE
	string
	default "x2iedn.xlarge" if TERRAFORM_AWS_INSTANCE_X2IEDN_XLARGE
	default "x2iedn.2xlarge" if TERRAFORM_AWS_INSTANCE_X2IEDN_2XLARGE
	default "x2iedn.4xlarge" if TERRAFORM_AWS_INSTANCE_X2IEDN_4XLARGE
	default "x2iedn.8xlarge" if TERRAFORM_AWS_INSTANCE_X2IEDN_8XLARGE
	default "x2iedn.16xlarge" if TERRAFORM_AWS_INSTANCE_X2IEDN_16XLARGE
	default "x2iedn.24xlarge" if TERRAFORM_AWS_INSTANCE_X2IEDN_24XLARGE
	default "x2iedn.metal" if TERRAFORM_AWS_INSTANCE_X2IEDN_METAL
	default "x2iedn.32xlarge" if TERRAFORM_AWS_INSTANCE_X2IEDN_32XLARGE
	default "x2iedn.xlarge"
```

## terraform/aws/kconfigs/instance-types/Kconfig.x2iezn.static
```kconfig
# AWS X2IEZN instance sizes (dynamically generated)

choice
	prompt "Instance size for X2IEZN family"
	default TERRAFORM_AWS_INSTANCE_X2IEZN_2XLARGE
	help
	  Select the specific instance size within the X2IEZN family.

config TERRAFORM_AWS_INSTANCE_X2IEZN_2XLARGE
	bool "x2iezn.2xlarge"
	help
	  vCPUs: 8
	  Memory: 256.0 GB
	  Network: Up to 25 Gigabit
	  Price: pricing varies

config TERRAFORM_AWS_INSTANCE_X2IEZN_4XLARGE
	bool "x2iezn.4xlarge"
	help
	  vCPUs: 16
	  Memory: 512.0 GB
	  Network: Up to 25 Gigabit
	  Price: pricing varies

config TERRAFORM_AWS_INSTANCE_X2IEZN_6XLARGE
	bool "x2iezn.6xlarge"
	help
	  vCPUs: 24
	  Memory: 768.0 GB
	  Network: 50 Gigabit
	  Price: pricing varies

config TERRAFORM_AWS_INSTANCE_X2IEZN_8XLARGE
	bool "x2iezn.8xlarge"
	help
	  vCPUs: 32
	  Memory: 1024.0 GB
	  Network: 75 Gigabit
	  Price: pricing varies

config TERRAFORM_AWS_INSTANCE_X2IEZN_12XLARGE
	bool "x2iezn.12xlarge"
	help
	  vCPUs: 48
	  Memory: 1536.0 GB
	  Network: 100 Gigabit
	  Price: pricing varies

config TERRAFORM_AWS_INSTANCE_X2IEZN_METAL
	bool "x2iezn.metal"
	help
	  vCPUs: 48
	  Memory: 1536.0 GB
	  Network: 100 Gigabit
	  Price: pricing varies

endchoice

config TERRAFORM_AWS_X2IEZN_SIZE
	string
	default "x2iezn.2xlarge" if TERRAFORM_AWS_INSTANCE_X2IEZN_2XLARGE
	default "x2iezn.4xlarge" if TERRAFORM_AWS_INSTANCE_X2IEZN_4XLARGE
	default "x2iezn.6xlarge" if TERRAFORM_AWS_INSTANCE_X2IEZN_6XLARGE
	default "x2iezn.8xlarge" if TERRAFORM_AWS_INSTANCE_X2IEZN_8XLARGE
	default "x2iezn.12xlarge" if TERRAFORM_AWS_INSTANCE_X2IEZN_12XLARGE
	default "x2iezn.metal" if TERRAFORM_AWS_INSTANCE_X2IEZN_METAL
	default "x2iezn.2xlarge"
```

## terraform/aws/kconfigs/instance-types/Kconfig.x8g.static
```kconfig
# AWS X8G instance sizes (dynamically generated)

choice
	prompt "Instance size for X8G family"
	default TERRAFORM_AWS_INSTANCE_X8G_MEDIUM
	help
	  Select the specific instance size within the X8G family.

config TERRAFORM_AWS_INSTANCE_X8G_MEDIUM
	bool "x8g.medium"
	help
	  vCPUs: 1
	  Memory: 16.0 GB
	  Network: Up to 12.5 Gigabit
	  Price: pricing varies

config TERRAFORM_AWS_INSTANCE_X8G_LARGE
	bool "x8g.large"
	help
	  vCPUs: 2
	  Memory: 32.0 GB
	  Network: Up to 12.5 Gigabit
	  Price: pricing varies

config TERRAFORM_AWS_INSTANCE_X8G_XLARGE
	bool "x8g.xlarge"
	help
	  vCPUs: 4
	  Memory: 64.0 GB
	  Network: Up to 12.5 Gigabit
	  Price: pricing varies

config TERRAFORM_AWS_INSTANCE_X8G_2XLARGE
	bool "x8g.2xlarge"
	help
	  vCPUs: 8
	  Memory: 128.0 GB
	  Network: Up to 15 Gigabit
	  Price: pricing varies

config TERRAFORM_AWS_INSTANCE_X8G_4XLARGE
	bool "x8g.4xlarge"
	help
	  vCPUs: 16
	  Memory: 256.0 GB
	  Network: Up to 15 Gigabit
	  Price: pricing varies

config TERRAFORM_AWS_INSTANCE_X8G_8XLARGE
	bool "x8g.8xlarge"
	help
	  vCPUs: 32
	  Memory: 512.0 GB
	  Network: 15 Gigabit
	  Price: pricing varies

config TERRAFORM_AWS_INSTANCE_X8G_12XLARGE
	bool "x8g.12xlarge"
	help
	  vCPUs: 48
	  Memory: 768.0 GB
	  Network: 22.5 Gigabit
	  Price: pricing varies

config TERRAFORM_AWS_INSTANCE_X8G_16XLARGE
	bool "x8g.16xlarge"
	help
	  vCPUs: 64
	  Memory: 1024.0 GB
	  Network: 30 Gigabit
	  Price: pricing varies

config TERRAFORM_AWS_INSTANCE_X8G_24XLARGE
	bool "x8g.24xlarge"
	help
	  vCPUs: 96
	  Memory: 1536.0 GB
	  Network: 40 Gigabit
	  Price: pricing varies

config TERRAFORM_AWS_INSTANCE_X8G_METAL_24XL
	bool "x8g.metal-24xl"
	help
	  vCPUs: 96
	  Memory: 1536.0 GB
	  Network: 40 Gigabit
	  Price: pricing varies

config TERRAFORM_AWS_INSTANCE_X8G_48XLARGE
	bool "x8g.48xlarge"
	help
	  vCPUs: 192
	  Memory: 3072.0 GB
	  Network: 50 Gigabit
	  Price: pricing varies

config TERRAFORM_AWS_INSTANCE_X8G_METAL_48XL
	bool "x8g.metal-48xl"
	help
	  vCPUs: 192
	  Memory: 3072.0 GB
	  Network: 50 Gigabit
	  Price: pricing varies

endchoice

config TERRAFORM_AWS_X8G_SIZE
	string
	default "x8g.medium" if TERRAFORM_AWS_INSTANCE_X8G_MEDIUM
	default "x8g.large" if TERRAFORM_AWS_INSTANCE_X8G_LARGE
	default "x8g.xlarge" if TERRAFORM_AWS_INSTANCE_X8G_XLARGE
	default "x8g.2xlarge" if TERRAFORM_AWS_INSTANCE_X8G_2XLARGE
	default "x8g.4xlarge" if TERRAFORM_AWS_INSTANCE_X8G_4XLARGE
	default "x8g.8xlarge" if TERRAFORM_AWS_INSTANCE_X8G_8XLARGE
	default "x8g.12xlarge" if TERRAFORM_AWS_INSTANCE_X8G_12XLARGE
	default "x8g.16xlarge" if TERRAFORM_AWS_INSTANCE_X8G_16XLARGE
	default "x8g.24xlarge" if TERRAFORM_AWS_INSTANCE_X8G_24XLARGE
	default "x8g.metal-24xl" if TERRAFORM_AWS_INSTANCE_X8G_METAL_24XL
	default "x8g.48xlarge" if TERRAFORM_AWS_INSTANCE_X8G_48XLARGE
	default "x8g.metal-48xl" if TERRAFORM_AWS_INSTANCE_X8G_METAL_48XL
	default "x8g.medium"
```

## terraform/aws/kconfigs/instance-types/Kconfig.z1d.static
```kconfig
# AWS Z1D instance sizes (dynamically generated)

choice
	prompt "Instance size for Z1D family"
	default TERRAFORM_AWS_INSTANCE_Z1D_LARGE
	help
	  Select the specific instance size within the Z1D family.

config TERRAFORM_AWS_INSTANCE_Z1D_LARGE
	bool "z1d.large"
	help
	  vCPUs: 2
	  Memory: 16.0 GB
	  Network: Up to 10 Gigabit
	  Price: pricing varies
	  Instance storage: 75 GB

config TERRAFORM_AWS_INSTANCE_Z1D_XLARGE
	bool "z1d.xlarge"
	help
	  vCPUs: 4
	  Memory: 32.0 GB
	  Network: Up to 10 Gigabit
	  Price: pricing varies
	  Instance storage: 150 GB

config TERRAFORM_AWS_INSTANCE_Z1D_2XLARGE
	bool "z1d.2xlarge"
	help
	  vCPUs: 8
	  Memory: 64.0 GB
	  Network: Up to 10 Gigabit
	  Price: pricing varies
	  Instance storage: 300 GB

config TERRAFORM_AWS_INSTANCE_Z1D_3XLARGE
	bool "z1d.3xlarge"
	help
	  vCPUs: 12
	  Memory: 96.0 GB
	  Network: Up to 10 Gigabit
	  Price: pricing varies
	  Instance storage: 450 GB

config TERRAFORM_AWS_INSTANCE_Z1D_6XLARGE
	bool "z1d.6xlarge"
	help
	  vCPUs: 24
	  Memory: 192.0 GB
	  Network: 12 Gigabit
	  Price: pricing varies
	  Instance storage: 900 GB

config TERRAFORM_AWS_INSTANCE_Z1D_12XLARGE
	bool "z1d.12xlarge"
	help
	  vCPUs: 48
	  Memory: 384.0 GB
	  Network: 25 Gigabit
	  Price: pricing varies
	  Instance storage: 1800 GB

config TERRAFORM_AWS_INSTANCE_Z1D_METAL
	bool "z1d.metal"
	help
	  vCPUs: 48
	  Memory: 384.0 GB
	  Network: 25 Gigabit
	  Price: pricing varies
	  Instance storage: 1800 GB

endchoice

config TERRAFORM_AWS_Z1D_SIZE
	string
	default "z1d.large" if TERRAFORM_AWS_INSTANCE_Z1D_LARGE
	default "z1d.xlarge" if TERRAFORM_AWS_INSTANCE_Z1D_XLARGE
	default "z1d.2xlarge" if TERRAFORM_AWS_INSTANCE_Z1D_2XLARGE
	default "z1d.3xlarge" if TERRAFORM_AWS_INSTANCE_Z1D_3XLARGE
	default "z1d.6xlarge" if TERRAFORM_AWS_INSTANCE_Z1D_6XLARGE
	default "z1d.12xlarge" if TERRAFORM_AWS_INSTANCE_Z1D_12XLARGE
	default "z1d.metal" if TERRAFORM_AWS_INSTANCE_Z1D_METAL
	default "z1d.large"
```

## terraform/azure/Kconfig
```kconfig
if TERRAFORM_AZURE

menu "Resource Location"
source "terraform/azure/kconfigs/Kconfig.location.generated"
endmenu
menu "Compute"
comment "Size selection"
source "terraform/azure/kconfigs/Kconfig.size.generated"
comment "OS image selection"
source "terraform/azure/kconfigs/Kconfig.image.generated"
endmenu
menu "Storage"
source "terraform/azure/kconfigs/Kconfig.storage"
endmenu
menu "Identity & Access"
source "terraform/azure/kconfigs/Kconfig.identity"
endmenu

endif # TERRAFORM_AZURE
```
