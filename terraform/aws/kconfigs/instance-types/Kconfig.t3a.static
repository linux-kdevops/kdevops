## terraform/azure/kconfigs/Kconfig.compute
```kconfig
choice
	prompt "Azure vmsize"
	default TERRAFORM_AZURE_VM_SIZE_STANDARD_DS3_V2
	help
	  This option chooses the size of the virtual machine instances
	  to be created for the kdevops target nodes.

config TERRAFORM_AZURE_VM_SIZE_STANDARD_DS1_V2
	bool "Standard_DS1_v2"
	depends on TARGET_ARCH_X86_64
	help
	  This virtual machine size has one vCPU and 3.5GB of memory.
	  Azure documentation notes that this size is part of a
	  previous generation series, and is to become unavailable
	  after May 1, 2028.

config TERRAFORM_AZURE_VM_SIZE_STANDARD_DS3_V2
	bool "Standard_DS3_v2"
	depends on TARGET_ARCH_X86_64
	help
	  This virtual machine size has four vCPUs and 14GB of memory.
	  Azure documentation notes that this size is part of a
	  previous generation series, and is to become unavailable
	  after May 1, 2028.

config TERRAFORM_AZURE_VM_SIZE_STANDARD_D2S_V3
	bool "Standard_D2s_v3"
	depends on TARGET_ARCH_X86_64
	help
	  This virtual machine size has two vCPUs and 8GB of memory.

config TERRAFORM_AZURE_VM_SIZE_STANDARD_D4S_V3
	bool "Standard_D4s_v3"
	depends on TARGET_ARCH_X86_64
	help
	  This virtual machine size has four vCPUs and 16GB of memory.

config TERRAFORM_AZURE_VM_SIZE_STANDARD_D8S_V3
	bool "Standard_D8s_v3"
	depends on TARGET_ARCH_X86_64
	help
	  This virtual machine size has eight vCPUs and 32GB of memory.

config TERRAFORM_AZURE_VM_SIZE_STANDARD_D2S_V4
	bool "Standard_D2s_v4"
	depends on TARGET_ARCH_X86_64
	help
	  This virtual machine size has two vCPUs and 8GB of memory.

config TERRAFORM_AZURE_VM_SIZE_STANDARD_D4S_V4
	bool "Standard_D4s_v4"
	depends on TARGET_ARCH_X86_64
	help
	  This virtual machine size has four vCPUs and 16GB of memory.

config TERRAFORM_AZURE_VM_SIZE_STANDARD_D8S_V4
	bool "Standard_D8s_v4"
	depends on TARGET_ARCH_X86_64
	help
	  This virtual machine size has eight vCPUs and 32GB of memory.

config TERRAFORM_AZURE_VM_SIZE_STANDARD_D2S_V6
	bool "Standard_D2s_v6"
	depends on TARGET_ARCH_X86_64
	help
	  This virtual machine size has two vCPUs and 8GB of memory.

config TERRAFORM_AZURE_VM_SIZE_STANDARD_D4S_V6
	bool "Standard_D4s_v6"
	depends on TARGET_ARCH_X86_64
	help
	  This virtual machine size has four vCPUs and 16GB of memory.

config TERRAFORM_AZURE_VM_SIZE_STANDARD_D8S_V6
	bool "Standard_D8s_v6"
	depends on TARGET_ARCH_X86_64
	help
	  This virtual machine size has eight vCPUs and 32GB of memory.

endchoice

config TERRAFORM_AZURE_VM_SIZE
	string
	output yaml
	default "Standard_DS1_v2" if TERRAFORM_AZURE_VM_SIZE_STANDARD_DS1_V2
	default "Standard_DS3_v2" if TERRAFORM_AZURE_VM_SIZE_STANDARD_DS3_V2
	default "Standard_D2s_v3" if TERRAFORM_AZURE_VM_SIZE_STANDARD_D2S_V3
	default "Standard_D4s_v3" if TERRAFORM_AZURE_VM_SIZE_STANDARD_D4S_V3
	default "Standard_D8s_v3" if TERRAFORM_AZURE_VM_SIZE_STANDARD_D8S_V3
	default "Standard_D2s_v4" if TERRAFORM_AZURE_VM_SIZE_STANDARD_D2S_V4
	default "Standard_D4s_v4" if TERRAFORM_AZURE_VM_SIZE_STANDARD_D4S_V4
	default "Standard_D8s_v4" if TERRAFORM_AZURE_VM_SIZE_STANDARD_D8S_V4
	default "Standard_D2s_v6" if TERRAFORM_AZURE_VM_SIZE_STANDARD_D2S_V6
	default "Standard_D4s_v6" if TERRAFORM_AZURE_VM_SIZE_STANDARD_D4S_V6
	default "Standard_D8s_v6" if TERRAFORM_AZURE_VM_SIZE_STANDARD_D8S_V6

choice
	prompt "Azure image publisher"
	default TERRAFORM_AZURE_IMAGE_PUBLISHER_DEBIAN
	help
	  This option specifies the publisher of the boot image used to
	  create the kdevops target nodes.

config TERRAFORM_AZURE_IMAGE_PUBLISHER_DEBIAN
	bool "Debian"
	help
	  This option sets the boot image publisher to "Debian".

config TERRAFORM_AZURE_IMAGE_PUBLISHER_REDHAT
	bool "Red Hat"
	help
	  This option sets the boot image publisher to "RedHat".

endchoice

config TERRAFORM_AZURE_IMAGE_PUBLISHER
	string
	output yaml
	default "Debian" if TERRAFORM_AZURE_IMAGE_PUBLISHER_DEBIAN
	default "RedHat" if TERRAFORM_AZURE_IMAGE_PUBLISHER_REDHAT

source "terraform/azure/kconfigs/publishers/Kconfig.debian"
source "terraform/azure/kconfigs/publishers/Kconfig.rhel"
```

## terraform/azure/kconfigs/Kconfig.identity
```kconfig
config TERRAFORM_AZURE_SUBSCRIPTION_ID
	string "Azure subscription ID"
	output yaml
	help
	  This option specifies the Azure subscription ID to use.
	  Retrieve your subscription ID by following these
	  instructions:

	  https://learn.microsoft.com/en-us/azure/azure-portal/get-subscription-tenant-id
```

## terraform/azure/kconfigs/Kconfig.image
```kconfig
choice
	prompt "Azure image publisher"
	default TERRAFORM_AZURE_IMAGE_PUBLISHER_DEBIAN
	help
	  This option specifies the publisher of the boot image used to
	  create the kdevops target nodes.

config TERRAFORM_AZURE_IMAGE_PUBLISHER_DEBIAN
	bool "Debian"
	help
	  This option sets the boot image publisher to "Debian".

config TERRAFORM_AZURE_IMAGE_PUBLISHER_REDHAT
	bool "Red Hat"
	help
	  This option sets the boot image publisher to "RedHat".

endchoice

config TERRAFORM_AZURE_IMAGE_PUBLISHER
	string
	output yaml
	default "Debian" if TERRAFORM_AZURE_IMAGE_PUBLISHER_DEBIAN
	default "RedHat" if TERRAFORM_AZURE_IMAGE_PUBLISHER_REDHAT

if TERRAFORM_AZURE_IMAGE_PUBLISHER_DEBIAN

if TARGET_ARCH_X86_64

choice
	prompt "Debian release"
	default TERRAFORM_AZURE_IMAGE_LINUX_DEBIAN_11
	help
	  This option specifies which of a publisher's offers to use
	  when creating kdevops compute instances.

config TERRAFORM_AZURE_IMAGE_LINUX_DEBIAN_10
	bool "debian-10 (x86)"
	help
	  This option sets the OS image to Debian 10 (Buster).

config TERRAFORM_AZURE_IMAGE_LINUX_DEBIAN_11
	bool "debian-11 (x86)"
	help
	  This option sets the OS image to Debian 11 (Bullseye).

config TERRAFORM_AZURE_IMAGE_LINUX_DEBIAN_12
	bool "debian-12 (x86)"
	help
	  This option sets the OS image to Debian 12 (Bookworm).

config TERRAFORM_AZURE_IMAGE_LINUX_DEBIAN_13_DAILY
	bool "debian-13-daily (x86)"
	help
	  This option sets the OS image to Debian 13's daily build.

config TERRAFORM_AZURE_IMAGE_LINUX_DEBIAN_SID_DAILY
	bool "debian-sid-daily (x86)"
	help
	  This option sets the OS image to the Debian unstable daily
	  build.

endchoice

config TERRAFORM_AZURE_IMAGE_OFFER
	string
	output yaml
	default "debian-10" if TERRAFORM_AZURE_IMAGE_LINUX_DEBIAN_10
	default "debian-11" if TERRAFORM_AZURE_IMAGE_LINUX_DEBIAN_11
	default "debian-12" if TERRAFORM_AZURE_IMAGE_LINUX_DEBIAN_12
	default "debian-13-daily" if TERRAFORM_AZURE_IMAGE_LINUX_DEBIAN_13_DAILY
	default "debian-sid-daily" if TERRAFORM_AZURE_IMAGE_LINUX_DEBIAN_SID_DAILY

config TERRAFORM_AZURE_IMAGE_SKU
	string
	output yaml
	default "10" if TERRAFORM_AZURE_IMAGE_LINUX_DEBIAN_10
	default "11" if TERRAFORM_AZURE_IMAGE_LINUX_DEBIAN_11
	default "12" if TERRAFORM_AZURE_IMAGE_LINUX_DEBIAN_12
	default "13" if TERRAFORM_AZURE_IMAGE_LINUX_DEBIAN_13_DAILY
	default "sid" if TERRAFORM_AZURE_IMAGE_LINUX_DEBIAN_SID_DAILY

endif # TARGET_ARCH_X86_64

endif # TERRAFORM_AZURE_IMAGE_PUBLISHER_DEBIAN

if TERRAFORM_AZURE_IMAGE_PUBLISHER_REDHAT

if TARGET_ARCH_X86_64

choice
	prompt "Red Hat Enterprise Linux release"
	default TERRAFORM_AZURE_IMAGE_LINUX_RHEL_9_6
	help
	  This option specifies which of a publisher's offers to use
	  when creating kdevops compute instances.

config TERRAFORM_AZURE_IMAGE_LINUX_RHEL_7_9
	bool "RHEL 7.9 x64"
	help
	  This option sets the OS image to Red Hat Enterprise Linux
	  release 7 update 9.

config TERRAFORM_AZURE_IMAGE_LINUX_RHEL_8_9
	bool "RHEL 8.9 x64"
	help
	  This option sets the OS image to Red Hat Enterprise Linux
	  release 8 update 9.

config TERRAFORM_AZURE_IMAGE_LINUX_RHEL_8_10
	bool "RHEL 8.10 x64"
	help
	  This option sets the OS image to Red Hat Enterprise Linux
	  release 8 update 10.

config TERRAFORM_AZURE_IMAGE_LINUX_RHEL_9_5
	bool "RHEL 9.5 x64"
	help
	  This option sets the OS image to Red Hat Enterprise Linux
	  release 9 update 5.

config TERRAFORM_AZURE_IMAGE_LINUX_RHEL_9_6
	bool "RHEL 9.6 x64"
	help
	  This option sets the OS image to Red Hat Enterprise Linux
	  release 9 update 6.

endchoice

config TERRAFORM_AZURE_IMAGE_OFFER
	string
	output yaml
	default "RHEL" if TERRAFORM_AZURE_IMAGE_LINUX_RHEL_7_9
	default "RHEL" if TERRAFORM_AZURE_IMAGE_LINUX_RHEL_8_9
	default "RHEL" if TERRAFORM_AZURE_IMAGE_LINUX_RHEL_8_10
	default "RHEL" if TERRAFORM_AZURE_IMAGE_LINUX_RHEL_9_5
	default "RHEL" if TERRAFORM_AZURE_IMAGE_LINUX_RHEL_9_6

config TERRAFORM_AZURE_IMAGE_SKU
	string
	output yaml
	default "7_9" if TERRAFORM_AZURE_IMAGE_LINUX_RHEL_7_9
	default "8_9" if TERRAFORM_AZURE_IMAGE_LINUX_RHEL_8_9
	default "8_10" if TERRAFORM_AZURE_IMAGE_LINUX_RHEL_8_10
	default "9_5" if TERRAFORM_AZURE_IMAGE_LINUX_RHEL_9_5
	default "9_6" if TERRAFORM_AZURE_IMAGE_LINUX_RHEL_9_6

endif # TARGET_ARCH_X86_64

endif # TERRAFORM_AZURE_IMAGE_PUBLISHER_REDHAT
```
