## terraform/aws/kconfigs/instance-types/Kconfig.g6.static
```kconfig
# AWS G6 instance sizes (dynamically generated)

choice
	prompt "Instance size for G6 family"
	default TERRAFORM_AWS_INSTANCE_G6_XLARGE
	help
	  Select the specific instance size within the G6 family.

config TERRAFORM_AWS_INSTANCE_G6_XLARGE
	bool "g6.xlarge"
	help
	  vCPUs: 4
	  Memory: 16.0 GB
	  Network: Up to 10 Gigabit
	  Price: pricing varies
	  Instance storage: 250 GB

config TERRAFORM_AWS_INSTANCE_G6_2XLARGE
	bool "g6.2xlarge"
	help
	  vCPUs: 8
	  Memory: 32.0 GB
	  Network: Up to 10 Gigabit
	  Price: pricing varies
	  Instance storage: 450 GB

config TERRAFORM_AWS_INSTANCE_G6_4XLARGE
	bool "g6.4xlarge"
	help
	  vCPUs: 16
	  Memory: 64.0 GB
	  Network: Up to 25 Gigabit
	  Price: pricing varies
	  Instance storage: 600 GB

config TERRAFORM_AWS_INSTANCE_G6_8XLARGE
	bool "g6.8xlarge"
	help
	  vCPUs: 32
	  Memory: 128.0 GB
	  Network: 25 Gigabit
	  Price: pricing varies
	  Instance storage: 900 GB

config TERRAFORM_AWS_INSTANCE_G6_12XLARGE
	bool "g6.12xlarge"
	help
	  vCPUs: 48
	  Memory: 192.0 GB
	  Network: 40 Gigabit
	  Price: pricing varies
	  Instance storage: 3760 GB

config TERRAFORM_AWS_INSTANCE_G6_16XLARGE
	bool "g6.16xlarge"
	help
	  vCPUs: 64
	  Memory: 256.0 GB
	  Network: 25 Gigabit
	  Price: pricing varies
	  Instance storage: 1880 GB

config TERRAFORM_AWS_INSTANCE_G6_24XLARGE
	bool "g6.24xlarge"
	help
	  vCPUs: 96
	  Memory: 384.0 GB
	  Network: 50 Gigabit
	  Price: pricing varies
	  Instance storage: 3760 GB

config TERRAFORM_AWS_INSTANCE_G6_48XLARGE
	bool "g6.48xlarge"
	help
	  vCPUs: 192
	  Memory: 768.0 GB
	  Network: 100 Gigabit
	  Price: pricing varies
	  Instance storage: 7520 GB

endchoice

config TERRAFORM_AWS_G6_SIZE
	string
	default "g6.xlarge" if TERRAFORM_AWS_INSTANCE_G6_XLARGE
	default "g6.2xlarge" if TERRAFORM_AWS_INSTANCE_G6_2XLARGE
	default "g6.4xlarge" if TERRAFORM_AWS_INSTANCE_G6_4XLARGE
	default "g6.8xlarge" if TERRAFORM_AWS_INSTANCE_G6_8XLARGE
	default "g6.12xlarge" if TERRAFORM_AWS_INSTANCE_G6_12XLARGE
	default "g6.16xlarge" if TERRAFORM_AWS_INSTANCE_G6_16XLARGE
	default "g6.24xlarge" if TERRAFORM_AWS_INSTANCE_G6_24XLARGE
	default "g6.48xlarge" if TERRAFORM_AWS_INSTANCE_G6_48XLARGE
	default "g6.xlarge"
```

## terraform/aws/kconfigs/instance-types/Kconfig.g6e.static
```kconfig
# AWS G6E instance sizes (dynamically generated)

choice
	prompt "Instance size for G6E family"
	default TERRAFORM_AWS_INSTANCE_G6E_XLARGE
	help
	  Select the specific instance size within the G6E family.

config TERRAFORM_AWS_INSTANCE_G6E_XLARGE
	bool "g6e.xlarge"
	help
	  vCPUs: 4
	  Memory: 32.0 GB
	  Network: Up to 20 Gigabit
	  Price: pricing varies
	  Instance storage: 250 GB

config TERRAFORM_AWS_INSTANCE_G6E_2XLARGE
	bool "g6e.2xlarge"
	help
	  vCPUs: 8
	  Memory: 64.0 GB
	  Network: Up to 20 Gigabit
	  Price: pricing varies
	  Instance storage: 450 GB

config TERRAFORM_AWS_INSTANCE_G6E_4XLARGE
	bool "g6e.4xlarge"
	help
	  vCPUs: 16
	  Memory: 128.0 GB
	  Network: 20 Gigabit
	  Price: pricing varies
	  Instance storage: 600 GB

config TERRAFORM_AWS_INSTANCE_G6E_8XLARGE
	bool "g6e.8xlarge"
	help
	  vCPUs: 32
	  Memory: 256.0 GB
	  Network: 25 Gigabit
	  Price: pricing varies
	  Instance storage: 900 GB

config TERRAFORM_AWS_INSTANCE_G6E_12XLARGE
	bool "g6e.12xlarge"
	help
	  vCPUs: 48
	  Memory: 384.0 GB
	  Network: 100 Gigabit
	  Price: pricing varies
	  Instance storage: 3800 GB

config TERRAFORM_AWS_INSTANCE_G6E_16XLARGE
	bool "g6e.16xlarge"
	help
	  vCPUs: 64
	  Memory: 512.0 GB
	  Network: 35 Gigabit
	  Price: pricing varies
	  Instance storage: 1900 GB

config TERRAFORM_AWS_INSTANCE_G6E_24XLARGE
	bool "g6e.24xlarge"
	help
	  vCPUs: 96
	  Memory: 768.0 GB
	  Network: 200 Gigabit
	  Price: pricing varies
	  Instance storage: 3800 GB

config TERRAFORM_AWS_INSTANCE_G6E_48XLARGE
	bool "g6e.48xlarge"
	help
	  vCPUs: 192
	  Memory: 1536.0 GB
	  Network: 400 Gigabit
	  Price: pricing varies
	  Instance storage: 7600 GB

endchoice

config TERRAFORM_AWS_G6E_SIZE
	string
	default "g6e.xlarge" if TERRAFORM_AWS_INSTANCE_G6E_XLARGE
	default "g6e.2xlarge" if TERRAFORM_AWS_INSTANCE_G6E_2XLARGE
	default "g6e.4xlarge" if TERRAFORM_AWS_INSTANCE_G6E_4XLARGE
	default "g6e.8xlarge" if TERRAFORM_AWS_INSTANCE_G6E_8XLARGE
	default "g6e.12xlarge" if TERRAFORM_AWS_INSTANCE_G6E_12XLARGE
	default "g6e.16xlarge" if TERRAFORM_AWS_INSTANCE_G6E_16XLARGE
	default "g6e.24xlarge" if TERRAFORM_AWS_INSTANCE_G6E_24XLARGE
	default "g6e.48xlarge" if TERRAFORM_AWS_INSTANCE_G6E_48XLARGE
	default "g6e.xlarge"
```

## terraform/aws/kconfigs/instance-types/Kconfig.g6f.static
```kconfig
# AWS G6F instance sizes (dynamically generated)

choice
	prompt "Instance size for G6F family"
	default TERRAFORM_AWS_INSTANCE_G6F_LARGE
	help
	  Select the specific instance size within the G6F family.

config TERRAFORM_AWS_INSTANCE_G6F_LARGE
	bool "g6f.large"
	help
	  vCPUs: 2
	  Memory: 8.0 GB
	  Network: Up to 10 Gigabit
	  Price: pricing varies
	  Instance storage: 100 GB

config TERRAFORM_AWS_INSTANCE_G6F_XLARGE
	bool "g6f.xlarge"
	help
	  vCPUs: 4
	  Memory: 16.0 GB
	  Network: Up to 10 Gigabit
	  Price: pricing varies
	  Instance storage: 100 GB

config TERRAFORM_AWS_INSTANCE_G6F_2XLARGE
	bool "g6f.2xlarge"
	help
	  vCPUs: 8
	  Memory: 32.0 GB
	  Network: Up to 10 Gigabit
	  Price: pricing varies
	  Instance storage: 200 GB

config TERRAFORM_AWS_INSTANCE_G6F_4XLARGE
	bool "g6f.4xlarge"
	help
	  vCPUs: 16
	  Memory: 64.0 GB
	  Network: Up to 25 Gigabit
	  Price: pricing varies
	  Instance storage: 450 GB

endchoice

config TERRAFORM_AWS_G6F_SIZE
	string
	default "g6f.large" if TERRAFORM_AWS_INSTANCE_G6F_LARGE
	default "g6f.xlarge" if TERRAFORM_AWS_INSTANCE_G6F_XLARGE
	default "g6f.2xlarge" if TERRAFORM_AWS_INSTANCE_G6F_2XLARGE
	default "g6f.4xlarge" if TERRAFORM_AWS_INSTANCE_G6F_4XLARGE
	default "g6f.large"
```

## terraform/aws/kconfigs/instance-types/Kconfig.gr6.static
```kconfig
# AWS GR6 instance sizes (dynamically generated)

choice
	prompt "Instance size for GR6 family"
	default TERRAFORM_AWS_INSTANCE_GR6_4XLARGE
	help
	  Select the specific instance size within the GR6 family.

config TERRAFORM_AWS_INSTANCE_GR6_4XLARGE
	bool "gr6.4xlarge"
	help
	  vCPUs: 16
	  Memory: 128.0 GB
	  Network: Up to 25 Gigabit
	  Price: pricing varies
	  Instance storage: 600 GB

config TERRAFORM_AWS_INSTANCE_GR6_8XLARGE
	bool "gr6.8xlarge"
	help
	  vCPUs: 32
	  Memory: 256.0 GB
	  Network: 25 Gigabit
	  Price: pricing varies
	  Instance storage: 900 GB

endchoice

config TERRAFORM_AWS_GR6_SIZE
	string
	default "gr6.4xlarge" if TERRAFORM_AWS_INSTANCE_GR6_4XLARGE
	default "gr6.8xlarge" if TERRAFORM_AWS_INSTANCE_GR6_8XLARGE
	default "gr6.4xlarge"
```

## terraform/aws/kconfigs/instance-types/Kconfig.gr6f.static
```kconfig
# AWS GR6F instance sizes (dynamically generated)

choice
	prompt "Instance size for GR6F family"
	default TERRAFORM_AWS_INSTANCE_GR6F_4XLARGE
	help
	  Select the specific instance size within the GR6F family.

config TERRAFORM_AWS_INSTANCE_GR6F_4XLARGE
	bool "gr6f.4xlarge"
	help
	  vCPUs: 16
	  Memory: 128.0 GB
	  Network: Up to 25 Gigabit
	  Price: pricing varies
	  Instance storage: 450 GB

endchoice

config TERRAFORM_AWS_GR6F_SIZE
	string
	default "gr6f.4xlarge" if TERRAFORM_AWS_INSTANCE_GR6F_4XLARGE
	default "gr6f.4xlarge"
```

## terraform/aws/kconfigs/instance-types/Kconfig.h1.static
```kconfig
# AWS H1 instance sizes (dynamically generated)

choice
	prompt "Instance size for H1 family"
	default TERRAFORM_AWS_INSTANCE_H1_2XLARGE
	help
	  Select the specific instance size within the H1 family.

config TERRAFORM_AWS_INSTANCE_H1_2XLARGE
	bool "h1.2xlarge"
	help
	  vCPUs: 8
	  Memory: 32.0 GB
	  Network: Up to 10 Gigabit
	  Price: pricing varies
	  Instance storage: 2000 GB

config TERRAFORM_AWS_INSTANCE_H1_4XLARGE
	bool "h1.4xlarge"
	help
	  vCPUs: 16
	  Memory: 64.0 GB
	  Network: Up to 10 Gigabit
	  Price: pricing varies
	  Instance storage: 4000 GB

config TERRAFORM_AWS_INSTANCE_H1_8XLARGE
	bool "h1.8xlarge"
	help
	  vCPUs: 32
	  Memory: 128.0 GB
	  Network: 10 Gigabit
	  Price: pricing varies
	  Instance storage: 8000 GB

config TERRAFORM_AWS_INSTANCE_H1_16XLARGE
	bool "h1.16xlarge"
	help
	  vCPUs: 64
	  Memory: 256.0 GB
	  Network: 25 Gigabit
	  Price: pricing varies
	  Instance storage: 16000 GB

endchoice

config TERRAFORM_AWS_H1_SIZE
	string
	default "h1.2xlarge" if TERRAFORM_AWS_INSTANCE_H1_2XLARGE
	default "h1.4xlarge" if TERRAFORM_AWS_INSTANCE_H1_4XLARGE
	default "h1.8xlarge" if TERRAFORM_AWS_INSTANCE_H1_8XLARGE
	default "h1.16xlarge" if TERRAFORM_AWS_INSTANCE_H1_16XLARGE
	default "h1.2xlarge"
```

## terraform/aws/kconfigs/instance-types/Kconfig.hpc7g.static
```kconfig
# AWS HPC7G instance sizes (dynamically generated)

choice
	prompt "Instance size for HPC7G family"
	default TERRAFORM_AWS_INSTANCE_HPC7G_4XLARGE
	help
	  Select the specific instance size within the HPC7G family.

config TERRAFORM_AWS_INSTANCE_HPC7G_4XLARGE
	bool "hpc7g.4xlarge"
	help
	  vCPUs: 16
	  Memory: 128.0 GB
	  Network: 200 Gigabit
	  Price: pricing varies

config TERRAFORM_AWS_INSTANCE_HPC7G_8XLARGE
	bool "hpc7g.8xlarge"
	help
	  vCPUs: 32
	  Memory: 128.0 GB
	  Network: 200 Gigabit
	  Price: pricing varies

config TERRAFORM_AWS_INSTANCE_HPC7G_16XLARGE
	bool "hpc7g.16xlarge"
	help
	  vCPUs: 64
	  Memory: 128.0 GB
	  Network: 200 Gigabit
	  Price: pricing varies

endchoice

config TERRAFORM_AWS_HPC7G_SIZE
	string
	default "hpc7g.4xlarge" if TERRAFORM_AWS_INSTANCE_HPC7G_4XLARGE
	default "hpc7g.8xlarge" if TERRAFORM_AWS_INSTANCE_HPC7G_8XLARGE
	default "hpc7g.16xlarge" if TERRAFORM_AWS_INSTANCE_HPC7G_16XLARGE
	default "hpc7g.4xlarge"
```

## terraform/aws/kconfigs/instance-types/Kconfig.i2.static
```kconfig
# AWS I2 instance sizes (dynamically generated)

choice
	prompt "Instance size for I2 family"
	default TERRAFORM_AWS_INSTANCE_I2_XLARGE
	help
	  Select the specific instance size within the I2 family.

config TERRAFORM_AWS_INSTANCE_I2_XLARGE
	bool "i2.xlarge"
	help
	  vCPUs: 4
	  Memory: 30.5 GB
	  Network: Moderate
	  Price: pricing varies
	  Instance storage: 800 GB

config TERRAFORM_AWS_INSTANCE_I2_2XLARGE
	bool "i2.2xlarge"
	help
	  vCPUs: 8
	  Memory: 61.0 GB
	  Network: High
	  Price: pricing varies
	  Instance storage: 1600 GB

config TERRAFORM_AWS_INSTANCE_I2_4XLARGE
	bool "i2.4xlarge"
	help
	  vCPUs: 16
	  Memory: 122.0 GB
	  Network: High
	  Price: pricing varies
	  Instance storage: 3200 GB

config TERRAFORM_AWS_INSTANCE_I2_8XLARGE
	bool "i2.8xlarge"
	help
	  vCPUs: 32
	  Memory: 244.0 GB
	  Network: 10 Gigabit
	  Price: pricing varies
	  Instance storage: 6400 GB

endchoice

config TERRAFORM_AWS_I2_SIZE
	string
	default "i2.xlarge" if TERRAFORM_AWS_INSTANCE_I2_XLARGE
	default "i2.2xlarge" if TERRAFORM_AWS_INSTANCE_I2_2XLARGE
	default "i2.4xlarge" if TERRAFORM_AWS_INSTANCE_I2_4XLARGE
	default "i2.8xlarge" if TERRAFORM_AWS_INSTANCE_I2_8XLARGE
	default "i2.xlarge"
```

## terraform/aws/kconfigs/instance-types/Kconfig.i3.static
```kconfig
# AWS I3 instance sizes (dynamically generated)

choice
	prompt "Instance size for I3 family"
	default TERRAFORM_AWS_INSTANCE_I3_LARGE
	help
	  Select the specific instance size within the I3 family.

config TERRAFORM_AWS_INSTANCE_I3_LARGE
	bool "i3.large"
	help
	  vCPUs: 2
	  Memory: 15.2 GB
	  Network: Up to 10 Gigabit
	  Price: pricing varies
	  Instance storage: 475 GB

config TERRAFORM_AWS_INSTANCE_I3_XLARGE
	bool "i3.xlarge"
	help
	  vCPUs: 4
	  Memory: 30.5 GB
	  Network: Up to 10 Gigabit
	  Price: pricing varies
	  Instance storage: 950 GB

config TERRAFORM_AWS_INSTANCE_I3_2XLARGE
	bool "i3.2xlarge"
	help
	  vCPUs: 8
	  Memory: 61.0 GB
	  Network: Up to 10 Gigabit
	  Price: pricing varies
	  Instance storage: 1900 GB

config TERRAFORM_AWS_INSTANCE_I3_4XLARGE
	bool "i3.4xlarge"
	help
	  vCPUs: 16
	  Memory: 122.0 GB
	  Network: Up to 10 Gigabit
	  Price: pricing varies
	  Instance storage: 3800 GB

config TERRAFORM_AWS_INSTANCE_I3_8XLARGE
	bool "i3.8xlarge"
	help
	  vCPUs: 32
	  Memory: 244.0 GB
	  Network: 10 Gigabit
	  Price: pricing varies
	  Instance storage: 7600 GB

config TERRAFORM_AWS_INSTANCE_I3_16XLARGE
	bool "i3.16xlarge"
	help
	  vCPUs: 64
	  Memory: 488.0 GB
	  Network: 25 Gigabit
	  Price: pricing varies
	  Instance storage: 15200 GB

endchoice

config TERRAFORM_AWS_I3_SIZE
	string
	default "i3.large" if TERRAFORM_AWS_INSTANCE_I3_LARGE
	default "i3.xlarge" if TERRAFORM_AWS_INSTANCE_I3_XLARGE
	default "i3.2xlarge" if TERRAFORM_AWS_INSTANCE_I3_2XLARGE
	default "i3.4xlarge" if TERRAFORM_AWS_INSTANCE_I3_4XLARGE
	default "i3.8xlarge" if TERRAFORM_AWS_INSTANCE_I3_8XLARGE
	default "i3.16xlarge" if TERRAFORM_AWS_INSTANCE_I3_16XLARGE
	default "i3.large"
```

## terraform/aws/kconfigs/instance-types/Kconfig.i3en.static
```kconfig
# AWS I3EN instance sizes (dynamically generated)

choice
	prompt "Instance size for I3EN family"
	default TERRAFORM_AWS_INSTANCE_I3EN_LARGE
	help
	  Select the specific instance size within the I3EN family.

config TERRAFORM_AWS_INSTANCE_I3EN_LARGE
	bool "i3en.large"
	help
	  vCPUs: 2
	  Memory: 16.0 GB
	  Network: Up to 25 Gigabit
	  Price: pricing varies
	  Instance storage: 1250 GB

config TERRAFORM_AWS_INSTANCE_I3EN_XLARGE
	bool "i3en.xlarge"
	help
	  vCPUs: 4
	  Memory: 32.0 GB
	  Network: Up to 25 Gigabit
	  Price: pricing varies
	  Instance storage: 2500 GB

config TERRAFORM_AWS_INSTANCE_I3EN_2XLARGE
	bool "i3en.2xlarge"
	help
	  vCPUs: 8
	  Memory: 64.0 GB
	  Network: Up to 25 Gigabit
	  Price: pricing varies
	  Instance storage: 5000 GB

config TERRAFORM_AWS_INSTANCE_I3EN_3XLARGE
	bool "i3en.3xlarge"
	help
	  vCPUs: 12
	  Memory: 96.0 GB
	  Network: Up to 25 Gigabit
	  Price: pricing varies
	  Instance storage: 7500 GB

config TERRAFORM_AWS_INSTANCE_I3EN_6XLARGE
	bool "i3en.6xlarge"
	help
	  vCPUs: 24
	  Memory: 192.0 GB
	  Network: 25 Gigabit
	  Price: pricing varies
	  Instance storage: 15000 GB

config TERRAFORM_AWS_INSTANCE_I3EN_12XLARGE
	bool "i3en.12xlarge"
	help
	  vCPUs: 48
	  Memory: 384.0 GB
	  Network: 50 Gigabit
	  Price: pricing varies
	  Instance storage: 30000 GB

config TERRAFORM_AWS_INSTANCE_I3EN_24XLARGE
	bool "i3en.24xlarge"
	help
	  vCPUs: 96
	  Memory: 768.0 GB
	  Network: 100 Gigabit
	  Price: pricing varies
	  Instance storage: 60000 GB

config TERRAFORM_AWS_INSTANCE_I3EN_METAL
	bool "i3en.metal"
	help
	  vCPUs: 96
	  Memory: 768.0 GB
	  Network: 100 Gigabit
	  Price: pricing varies
	  Instance storage: 60000 GB

endchoice

config TERRAFORM_AWS_I3EN_SIZE
	string
	default "i3en.large" if TERRAFORM_AWS_INSTANCE_I3EN_LARGE
	default "i3en.xlarge" if TERRAFORM_AWS_INSTANCE_I3EN_XLARGE
	default "i3en.2xlarge" if TERRAFORM_AWS_INSTANCE_I3EN_2XLARGE
	default "i3en.3xlarge" if TERRAFORM_AWS_INSTANCE_I3EN_3XLARGE
	default "i3en.6xlarge" if TERRAFORM_AWS_INSTANCE_I3EN_6XLARGE
	default "i3en.12xlarge" if TERRAFORM_AWS_INSTANCE_I3EN_12XLARGE
	default "i3en.24xlarge" if TERRAFORM_AWS_INSTANCE_I3EN_24XLARGE
	default "i3en.metal" if TERRAFORM_AWS_INSTANCE_I3EN_METAL
	default "i3en.large"
```
