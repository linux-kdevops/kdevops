## terraform/aws/kconfigs/instance-types/Kconfig.d3en.static
```kconfig
# AWS D3EN instance sizes (dynamically generated)

choice
	prompt "Instance size for D3EN family"
	default TERRAFORM_AWS_INSTANCE_D3EN_XLARGE
	help
	  Select the specific instance size within the D3EN family.

config TERRAFORM_AWS_INSTANCE_D3EN_XLARGE
	bool "d3en.xlarge"
	help
	  vCPUs: 4
	  Memory: 16.0 GB
	  Network: Up to 25 Gigabit
	  Price: pricing varies
	  Instance storage: 27960 GB

config TERRAFORM_AWS_INSTANCE_D3EN_2XLARGE
	bool "d3en.2xlarge"
	help
	  vCPUs: 8
	  Memory: 32.0 GB
	  Network: Up to 25 Gigabit
	  Price: pricing varies
	  Instance storage: 55920 GB

config TERRAFORM_AWS_INSTANCE_D3EN_4XLARGE
	bool "d3en.4xlarge"
	help
	  vCPUs: 16
	  Memory: 64.0 GB
	  Network: 25 Gigabit
	  Price: pricing varies
	  Instance storage: 111840 GB

config TERRAFORM_AWS_INSTANCE_D3EN_6XLARGE
	bool "d3en.6xlarge"
	help
	  vCPUs: 24
	  Memory: 96.0 GB
	  Network: 40 Gigabit
	  Price: pricing varies
	  Instance storage: 167760 GB

config TERRAFORM_AWS_INSTANCE_D3EN_8XLARGE
	bool "d3en.8xlarge"
	help
	  vCPUs: 32
	  Memory: 128.0 GB
	  Network: 50 Gigabit
	  Price: pricing varies
	  Instance storage: 223680 GB

config TERRAFORM_AWS_INSTANCE_D3EN_12XLARGE
	bool "d3en.12xlarge"
	help
	  vCPUs: 48
	  Memory: 192.0 GB
	  Network: 75 Gigabit
	  Price: pricing varies
	  Instance storage: 335520 GB

endchoice

config TERRAFORM_AWS_D3EN_SIZE
	string
	default "d3en.xlarge" if TERRAFORM_AWS_INSTANCE_D3EN_XLARGE
	default "d3en.2xlarge" if TERRAFORM_AWS_INSTANCE_D3EN_2XLARGE
	default "d3en.4xlarge" if TERRAFORM_AWS_INSTANCE_D3EN_4XLARGE
	default "d3en.6xlarge" if TERRAFORM_AWS_INSTANCE_D3EN_6XLARGE
	default "d3en.8xlarge" if TERRAFORM_AWS_INSTANCE_D3EN_8XLARGE
	default "d3en.12xlarge" if TERRAFORM_AWS_INSTANCE_D3EN_12XLARGE
	default "d3en.xlarge"
```

## terraform/aws/kconfigs/instance-types/Kconfig.dl1.static
```kconfig
# AWS DL1 instance sizes (dynamically generated)

choice
	prompt "Instance size for DL1 family"
	default TERRAFORM_AWS_INSTANCE_DL1_24XLARGE
	help
	  Select the specific instance size within the DL1 family.

config TERRAFORM_AWS_INSTANCE_DL1_24XLARGE
	bool "dl1.24xlarge"
	help
	  vCPUs: 96
	  Memory: 768.0 GB
	  Network: 4x 100 Gigabit
	  Price: pricing varies
	  Instance storage: 4000 GB

endchoice

config TERRAFORM_AWS_DL1_SIZE
	string
	default "dl1.24xlarge" if TERRAFORM_AWS_INSTANCE_DL1_24XLARGE
	default "dl1.24xlarge"
```

## terraform/aws/kconfigs/instance-types/Kconfig.f1.static
```kconfig
# AWS F1 instance sizes (dynamically generated)

choice
	prompt "Instance size for F1 family"
	default TERRAFORM_AWS_INSTANCE_F1_2XLARGE
	help
	  Select the specific instance size within the F1 family.

config TERRAFORM_AWS_INSTANCE_F1_2XLARGE
	bool "f1.2xlarge"
	help
	  vCPUs: 8
	  Memory: 122.0 GB
	  Network: Up to 10 Gigabit
	  Price: pricing varies
	  Instance storage: 470 GB

config TERRAFORM_AWS_INSTANCE_F1_4XLARGE
	bool "f1.4xlarge"
	help
	  vCPUs: 16
	  Memory: 244.0 GB
	  Network: Up to 10 Gigabit
	  Price: pricing varies
	  Instance storage: 940 GB

config TERRAFORM_AWS_INSTANCE_F1_16XLARGE
	bool "f1.16xlarge"
	help
	  vCPUs: 64
	  Memory: 976.0 GB
	  Network: 25 Gigabit
	  Price: pricing varies
	  Instance storage: 3760 GB

endchoice

config TERRAFORM_AWS_F1_SIZE
	string
	default "f1.2xlarge" if TERRAFORM_AWS_INSTANCE_F1_2XLARGE
	default "f1.4xlarge" if TERRAFORM_AWS_INSTANCE_F1_4XLARGE
	default "f1.16xlarge" if TERRAFORM_AWS_INSTANCE_F1_16XLARGE
	default "f1.2xlarge"
```

## terraform/aws/kconfigs/instance-types/Kconfig.f2.static
```kconfig
# AWS F2 instance sizes (dynamically generated)

choice
	prompt "Instance size for F2 family"
	default TERRAFORM_AWS_INSTANCE_F2_6XLARGE
	help
	  Select the specific instance size within the F2 family.

config TERRAFORM_AWS_INSTANCE_F2_6XLARGE
	bool "f2.6xlarge"
	help
	  vCPUs: 24
	  Memory: 256.0 GB
	  Network: 12.5 Gigabit
	  Price: pricing varies
	  Instance storage: 940 GB

config TERRAFORM_AWS_INSTANCE_F2_12XLARGE
	bool "f2.12xlarge"
	help
	  vCPUs: 48
	  Memory: 512.0 GB
	  Network: 25 Gigabit
	  Price: pricing varies
	  Instance storage: 1880 GB

config TERRAFORM_AWS_INSTANCE_F2_48XLARGE
	bool "f2.48xlarge"
	help
	  vCPUs: 192
	  Memory: 2048.0 GB
	  Network: 100 Gigabit
	  Price: pricing varies
	  Instance storage: 7520 GB

endchoice

config TERRAFORM_AWS_F2_SIZE
	string
	default "f2.6xlarge" if TERRAFORM_AWS_INSTANCE_F2_6XLARGE
	default "f2.12xlarge" if TERRAFORM_AWS_INSTANCE_F2_12XLARGE
	default "f2.48xlarge" if TERRAFORM_AWS_INSTANCE_F2_48XLARGE
	default "f2.6xlarge"
```

## terraform/aws/kconfigs/instance-types/Kconfig.g4ad.static
```kconfig
# AWS G4AD instance sizes (dynamically generated)

choice
	prompt "Instance size for G4AD family"
	default TERRAFORM_AWS_INSTANCE_G4AD_XLARGE
	help
	  Select the specific instance size within the G4AD family.

config TERRAFORM_AWS_INSTANCE_G4AD_XLARGE
	bool "g4ad.xlarge"
	help
	  vCPUs: 4
	  Memory: 16.0 GB
	  Network: Up to 10 Gigabit
	  Price: pricing varies
	  Instance storage: 150 GB

config TERRAFORM_AWS_INSTANCE_G4AD_2XLARGE
	bool "g4ad.2xlarge"
	help
	  vCPUs: 8
	  Memory: 32.0 GB
	  Network: Up to 10 Gigabit
	  Price: pricing varies
	  Instance storage: 300 GB

config TERRAFORM_AWS_INSTANCE_G4AD_4XLARGE
	bool "g4ad.4xlarge"
	help
	  vCPUs: 16
	  Memory: 64.0 GB
	  Network: Up to 10 Gigabit
	  Price: pricing varies
	  Instance storage: 600 GB

config TERRAFORM_AWS_INSTANCE_G4AD_8XLARGE
	bool "g4ad.8xlarge"
	help
	  vCPUs: 32
	  Memory: 128.0 GB
	  Network: 15 Gigabit
	  Price: pricing varies
	  Instance storage: 1200 GB

config TERRAFORM_AWS_INSTANCE_G4AD_16XLARGE
	bool "g4ad.16xlarge"
	help
	  vCPUs: 64
	  Memory: 256.0 GB
	  Network: 25 Gigabit
	  Price: pricing varies
	  Instance storage: 2400 GB

endchoice

config TERRAFORM_AWS_G4AD_SIZE
	string
	default "g4ad.xlarge" if TERRAFORM_AWS_INSTANCE_G4AD_XLARGE
	default "g4ad.2xlarge" if TERRAFORM_AWS_INSTANCE_G4AD_2XLARGE
	default "g4ad.4xlarge" if TERRAFORM_AWS_INSTANCE_G4AD_4XLARGE
	default "g4ad.8xlarge" if TERRAFORM_AWS_INSTANCE_G4AD_8XLARGE
	default "g4ad.16xlarge" if TERRAFORM_AWS_INSTANCE_G4AD_16XLARGE
	default "g4ad.xlarge"
```

## terraform/aws/kconfigs/instance-types/Kconfig.g4dn.static
```kconfig
# AWS G4DN instance sizes (dynamically generated)

choice
	prompt "Instance size for G4DN family"
	default TERRAFORM_AWS_INSTANCE_G4DN_XLARGE
	help
	  Select the specific instance size within the G4DN family.

config TERRAFORM_AWS_INSTANCE_G4DN_XLARGE
	bool "g4dn.xlarge"
	help
	  vCPUs: 4
	  Memory: 16.0 GB
	  Network: Up to 25 Gigabit
	  Price: pricing varies
	  Instance storage: 125 GB

config TERRAFORM_AWS_INSTANCE_G4DN_2XLARGE
	bool "g4dn.2xlarge"
	help
	  vCPUs: 8
	  Memory: 32.0 GB
	  Network: Up to 25 Gigabit
	  Price: pricing varies
	  Instance storage: 225 GB

config TERRAFORM_AWS_INSTANCE_G4DN_4XLARGE
	bool "g4dn.4xlarge"
	help
	  vCPUs: 16
	  Memory: 64.0 GB
	  Network: Up to 25 Gigabit
	  Price: pricing varies
	  Instance storage: 225 GB

config TERRAFORM_AWS_INSTANCE_G4DN_8XLARGE
	bool "g4dn.8xlarge"
	help
	  vCPUs: 32
	  Memory: 128.0 GB
	  Network: 50 Gigabit
	  Price: pricing varies
	  Instance storage: 900 GB

config TERRAFORM_AWS_INSTANCE_G4DN_12XLARGE
	bool "g4dn.12xlarge"
	help
	  vCPUs: 48
	  Memory: 192.0 GB
	  Network: 50 Gigabit
	  Price: pricing varies
	  Instance storage: 900 GB

config TERRAFORM_AWS_INSTANCE_G4DN_16XLARGE
	bool "g4dn.16xlarge"
	help
	  vCPUs: 64
	  Memory: 256.0 GB
	  Network: 50 Gigabit
	  Price: pricing varies
	  Instance storage: 900 GB

config TERRAFORM_AWS_INSTANCE_G4DN_METAL
	bool "g4dn.metal"
	help
	  vCPUs: 96
	  Memory: 384.0 GB
	  Network: 100 Gigabit
	  Price: pricing varies
	  Instance storage: 1800 GB

endchoice

config TERRAFORM_AWS_G4DN_SIZE
	string
	default "g4dn.xlarge" if TERRAFORM_AWS_INSTANCE_G4DN_XLARGE
	default "g4dn.2xlarge" if TERRAFORM_AWS_INSTANCE_G4DN_2XLARGE
	default "g4dn.4xlarge" if TERRAFORM_AWS_INSTANCE_G4DN_4XLARGE
	default "g4dn.8xlarge" if TERRAFORM_AWS_INSTANCE_G4DN_8XLARGE
	default "g4dn.12xlarge" if TERRAFORM_AWS_INSTANCE_G4DN_12XLARGE
	default "g4dn.16xlarge" if TERRAFORM_AWS_INSTANCE_G4DN_16XLARGE
	default "g4dn.metal" if TERRAFORM_AWS_INSTANCE_G4DN_METAL
	default "g4dn.xlarge"
```

## terraform/aws/kconfigs/instance-types/Kconfig.g5
```kconfig
if TERRAFORM_AWS_INSTANCE_TYPE_G5

choice
	prompt "G5 instance size"
	default TERRAFORM_AWS_INSTANCE_G5_XLARGE_CHOICE
	help
	  Select the size of the G5 instance. All G5 instances
	  include NVIDIA A10G GPUs for graphics and ML workloads.

config TERRAFORM_AWS_INSTANCE_G5_XLARGE_CHOICE
	bool "g5.xlarge (1 GPU, 4 vCPUs, 16 GiB)"
	help
	  1x NVIDIA A10G GPU, 4 vCPUs, 16 GiB memory
	  Up to 10 Gbps network, 3.8 Gbps EBS
	  ~$1.00/hour on-demand

config TERRAFORM_AWS_INSTANCE_G5_2XLARGE_CHOICE
	bool "g5.2xlarge (1 GPU, 8 vCPUs, 32 GiB)"
	help
	  1x NVIDIA A10G GPU, 8 vCPUs, 32 GiB memory
	  Up to 10 Gbps network, 3.8 Gbps EBS
	  ~$1.21/hour on-demand

config TERRAFORM_AWS_INSTANCE_G5_4XLARGE_CHOICE
	bool "g5.4xlarge (1 GPU, 16 vCPUs, 64 GiB)"
	help
	  1x NVIDIA A10G GPU, 16 vCPUs, 64 GiB memory
	  Up to 25 Gbps network, 8 Gbps EBS
	  ~$1.62/hour on-demand

config TERRAFORM_AWS_INSTANCE_G5_8XLARGE_CHOICE
	bool "g5.8xlarge (1 GPU, 32 vCPUs, 128 GiB)"
	help
	  1x NVIDIA A10G GPU, 32 vCPUs, 128 GiB memory
	  25 Gbps network, 16 Gbps EBS
	  ~$2.45/hour on-demand

config TERRAFORM_AWS_INSTANCE_G5_12XLARGE_CHOICE
	bool "g5.12xlarge (4 GPUs, 48 vCPUs, 192 GiB)"
	help
	  4x NVIDIA A10G GPUs, 48 vCPUs, 192 GiB memory
	  40 Gbps network, 20 Gbps EBS
	  3.8 TB local NVMe SSD storage
	  ~$5.67/hour on-demand

config TERRAFORM_AWS_INSTANCE_G5_16XLARGE_CHOICE
	bool "g5.16xlarge (1 GPU, 64 vCPUs, 256 GiB)"
	help
	  1x NVIDIA A10G GPU, 64 vCPUs, 256 GiB memory
	  25 Gbps network, 20 Gbps EBS
	  ~$4.10/hour on-demand

config TERRAFORM_AWS_INSTANCE_G5_24XLARGE_CHOICE
	bool "g5.24xlarge (4 GPUs, 96 vCPUs, 384 GiB)"
	help
	  4x NVIDIA A10G GPUs, 96 vCPUs, 384 GiB memory
	  50 Gbps network, 30 Gbps EBS
	  7.6 TB local NVMe SSD storage
	  ~$8.14/hour on-demand

config TERRAFORM_AWS_INSTANCE_G5_48XLARGE_CHOICE
	bool "g5.48xlarge (8 GPUs, 192 vCPUs, 768 GiB)"
	help
	  8x NVIDIA A10G GPUs, 192 vCPUs, 768 GiB memory
	  100 Gbps network, 60 Gbps EBS
	  15.2 TB local NVMe SSD storage
	  ~$16.29/hour on-demand

endchoice

endif # TERRAFORM_AWS_INSTANCE_TYPE_G5

config TERRAFORM_AWS_INSTANCE_FAMILY_G5
	bool
	default y if TERRAFORM_AWS_INSTANCE_TYPE_G5
	output yaml

config TERRAFORM_AWS_INSTANCE_G5_XLARGE
	bool
	default y if TERRAFORM_AWS_INSTANCE_TYPE_G5 && TERRAFORM_AWS_INSTANCE_G5_XLARGE_CHOICE
	output yaml

config TERRAFORM_AWS_INSTANCE_G5_2XLARGE
	bool
	default y if TERRAFORM_AWS_INSTANCE_TYPE_G5 && TERRAFORM_AWS_INSTANCE_G5_2XLARGE_CHOICE
	output yaml

config TERRAFORM_AWS_INSTANCE_G5_4XLARGE
	bool
	default y if TERRAFORM_AWS_INSTANCE_TYPE_G5 && TERRAFORM_AWS_INSTANCE_G5_4XLARGE_CHOICE
	output yaml

config TERRAFORM_AWS_INSTANCE_G5_8XLARGE
	bool
	default y if TERRAFORM_AWS_INSTANCE_TYPE_G5 && TERRAFORM_AWS_INSTANCE_G5_8XLARGE_CHOICE
	output yaml

config TERRAFORM_AWS_INSTANCE_G5_12XLARGE
	bool
	default y if TERRAFORM_AWS_INSTANCE_TYPE_G5 && TERRAFORM_AWS_INSTANCE_G5_12XLARGE_CHOICE
	output yaml

config TERRAFORM_AWS_INSTANCE_G5_16XLARGE
	bool
	default y if TERRAFORM_AWS_INSTANCE_TYPE_G5 && TERRAFORM_AWS_INSTANCE_G5_16XLARGE_CHOICE
	output yaml

config TERRAFORM_AWS_INSTANCE_G5_24XLARGE
	bool
	default y if TERRAFORM_AWS_INSTANCE_TYPE_G5 && TERRAFORM_AWS_INSTANCE_G5_24XLARGE_CHOICE
	output yaml

config TERRAFORM_AWS_INSTANCE_G5_48XLARGE
	bool
	default y if TERRAFORM_AWS_INSTANCE_TYPE_G5 && TERRAFORM_AWS_INSTANCE_G5_48XLARGE_CHOICE
	output yaml
```

## terraform/aws/kconfigs/instance-types/Kconfig.g5.static
```kconfig
# AWS G5 instance sizes (dynamically generated)

choice
	prompt "Instance size for G5 family"
	default TERRAFORM_AWS_INSTANCE_G5_XLARGE
	help
	  Select the specific instance size within the G5 family.

config TERRAFORM_AWS_INSTANCE_G5_XLARGE
	bool "g5.xlarge"
	help
	  vCPUs: 4
	  Memory: 16.0 GB
	  Network: Up to 10 Gigabit
	  Price: pricing varies
	  Instance storage: 250 GB

config TERRAFORM_AWS_INSTANCE_G5_2XLARGE
	bool "g5.2xlarge"
	help
	  vCPUs: 8
	  Memory: 32.0 GB
	  Network: Up to 10 Gigabit
	  Price: pricing varies
	  Instance storage: 450 GB

config TERRAFORM_AWS_INSTANCE_G5_4XLARGE
	bool "g5.4xlarge"
	help
	  vCPUs: 16
	  Memory: 64.0 GB
	  Network: Up to 25 Gigabit
	  Price: pricing varies
	  Instance storage: 600 GB

config TERRAFORM_AWS_INSTANCE_G5_8XLARGE
	bool "g5.8xlarge"
	help
	  vCPUs: 32
	  Memory: 128.0 GB
	  Network: 25 Gigabit
	  Price: pricing varies
	  Instance storage: 900 GB

config TERRAFORM_AWS_INSTANCE_G5_12XLARGE
	bool "g5.12xlarge"
	help
	  vCPUs: 48
	  Memory: 192.0 GB
	  Network: 40 Gigabit
	  Price: pricing varies
	  Instance storage: 3800 GB

config TERRAFORM_AWS_INSTANCE_G5_16XLARGE
	bool "g5.16xlarge"
	help
	  vCPUs: 64
	  Memory: 256.0 GB
	  Network: 25 Gigabit
	  Price: pricing varies
	  Instance storage: 1900 GB

config TERRAFORM_AWS_INSTANCE_G5_24XLARGE
	bool "g5.24xlarge"
	help
	  vCPUs: 96
	  Memory: 384.0 GB
	  Network: 50 Gigabit
	  Price: pricing varies
	  Instance storage: 3800 GB

config TERRAFORM_AWS_INSTANCE_G5_48XLARGE
	bool "g5.48xlarge"
	help
	  vCPUs: 192
	  Memory: 768.0 GB
	  Network: 100 Gigabit
	  Price: pricing varies
	  Instance storage: 7600 GB

endchoice

config TERRAFORM_AWS_G5_SIZE
	string
	default "g5.xlarge" if TERRAFORM_AWS_INSTANCE_G5_XLARGE
	default "g5.2xlarge" if TERRAFORM_AWS_INSTANCE_G5_2XLARGE
	default "g5.4xlarge" if TERRAFORM_AWS_INSTANCE_G5_4XLARGE
	default "g5.8xlarge" if TERRAFORM_AWS_INSTANCE_G5_8XLARGE
	default "g5.12xlarge" if TERRAFORM_AWS_INSTANCE_G5_12XLARGE
	default "g5.16xlarge" if TERRAFORM_AWS_INSTANCE_G5_16XLARGE
	default "g5.24xlarge" if TERRAFORM_AWS_INSTANCE_G5_24XLARGE
	default "g5.48xlarge" if TERRAFORM_AWS_INSTANCE_G5_48XLARGE
	default "g5.xlarge"
```

## terraform/aws/kconfigs/instance-types/Kconfig.g5g.static
```kconfig
# AWS G5G instance sizes (dynamically generated)

choice
	prompt "Instance size for G5G family"
	default TERRAFORM_AWS_INSTANCE_G5G_XLARGE
	help
	  Select the specific instance size within the G5G family.

config TERRAFORM_AWS_INSTANCE_G5G_XLARGE
	bool "g5g.xlarge"
	help
	  vCPUs: 4
	  Memory: 8.0 GB
	  Network: Up to 10 Gigabit
	  Price: pricing varies

config TERRAFORM_AWS_INSTANCE_G5G_2XLARGE
	bool "g5g.2xlarge"
	help
	  vCPUs: 8
	  Memory: 16.0 GB
	  Network: Up to 10 Gigabit
	  Price: pricing varies

config TERRAFORM_AWS_INSTANCE_G5G_4XLARGE
	bool "g5g.4xlarge"
	help
	  vCPUs: 16
	  Memory: 32.0 GB
	  Network: Up to 10 Gigabit
	  Price: pricing varies

config TERRAFORM_AWS_INSTANCE_G5G_8XLARGE
	bool "g5g.8xlarge"
	help
	  vCPUs: 32
	  Memory: 64.0 GB
	  Network: 12 Gigabit
	  Price: pricing varies

config TERRAFORM_AWS_INSTANCE_G5G_16XLARGE
	bool "g5g.16xlarge"
	help
	  vCPUs: 64
	  Memory: 128.0 GB
	  Network: 25 Gigabit
	  Price: pricing varies

config TERRAFORM_AWS_INSTANCE_G5G_METAL
	bool "g5g.metal"
	help
	  vCPUs: 64
	  Memory: 128.0 GB
	  Network: 25 Gigabit
	  Price: pricing varies

endchoice

config TERRAFORM_AWS_G5G_SIZE
	string
	default "g5g.xlarge" if TERRAFORM_AWS_INSTANCE_G5G_XLARGE
	default "g5g.2xlarge" if TERRAFORM_AWS_INSTANCE_G5G_2XLARGE
	default "g5g.4xlarge" if TERRAFORM_AWS_INSTANCE_G5G_4XLARGE
	default "g5g.8xlarge" if TERRAFORM_AWS_INSTANCE_G5G_8XLARGE
	default "g5g.16xlarge" if TERRAFORM_AWS_INSTANCE_G5G_16XLARGE
	default "g5g.metal" if TERRAFORM_AWS_INSTANCE_G5G_METAL
	default "g5g.xlarge"
```
