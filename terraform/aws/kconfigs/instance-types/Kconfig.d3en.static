## terraform/aws/kconfigs/instance-types/Kconfig.i4g.static
```kconfig
# AWS I4G instance sizes (dynamically generated)

choice
	prompt "Instance size for I4G family"
	default TERRAFORM_AWS_INSTANCE_I4G_LARGE
	help
	  Select the specific instance size within the I4G family.

config TERRAFORM_AWS_INSTANCE_I4G_LARGE
	bool "i4g.large"
	help
	  vCPUs: 2
	  Memory: 16.0 GB
	  Network: Up to 10 Gigabit
	  Price: pricing varies
	  Instance storage: 468 GB

config TERRAFORM_AWS_INSTANCE_I4G_XLARGE
	bool "i4g.xlarge"
	help
	  vCPUs: 4
	  Memory: 32.0 GB
	  Network: Up to 10 Gigabit
	  Price: pricing varies
	  Instance storage: 937 GB

config TERRAFORM_AWS_INSTANCE_I4G_2XLARGE
	bool "i4g.2xlarge"
	help
	  vCPUs: 8
	  Memory: 64.0 GB
	  Network: Up to 12 Gigabit
	  Price: pricing varies
	  Instance storage: 1875 GB

config TERRAFORM_AWS_INSTANCE_I4G_4XLARGE
	bool "i4g.4xlarge"
	help
	  vCPUs: 16
	  Memory: 128.0 GB
	  Network: Up to 25 Gigabit
	  Price: pricing varies
	  Instance storage: 3750 GB

config TERRAFORM_AWS_INSTANCE_I4G_8XLARGE
	bool "i4g.8xlarge"
	help
	  vCPUs: 32
	  Memory: 256.0 GB
	  Network: 18.75 Gigabit
	  Price: pricing varies
	  Instance storage: 7500 GB

config TERRAFORM_AWS_INSTANCE_I4G_16XLARGE
	bool "i4g.16xlarge"
	help
	  vCPUs: 64
	  Memory: 512.0 GB
	  Network: 37.5 Gigabit
	  Price: pricing varies
	  Instance storage: 15000 GB

endchoice

config TERRAFORM_AWS_I4G_SIZE
	string
	default "i4g.large" if TERRAFORM_AWS_INSTANCE_I4G_LARGE
	default "i4g.xlarge" if TERRAFORM_AWS_INSTANCE_I4G_XLARGE
	default "i4g.2xlarge" if TERRAFORM_AWS_INSTANCE_I4G_2XLARGE
	default "i4g.4xlarge" if TERRAFORM_AWS_INSTANCE_I4G_4XLARGE
	default "i4g.8xlarge" if TERRAFORM_AWS_INSTANCE_I4G_8XLARGE
	default "i4g.16xlarge" if TERRAFORM_AWS_INSTANCE_I4G_16XLARGE
	default "i4g.large"
```

## terraform/aws/kconfigs/instance-types/Kconfig.i4i
```kconfig
if TERRAFORM_AWS_INSTANCE_TYPE_I4I

choice
	prompt "AWS instance type"
	default TERRAFORM_AWS_INSTANCE_SIZE_I4I_4XLARGE

config TERRAFORM_AWS_INSTANCE_SIZE_I4I_LARGE
	bool "i4i.large"
	help
	  16 GiB RAM, 2 vcpus, 1 x 468 AWS Nitro SSD, 10 Gbps Net, 10 Gbps EBS.

config TERRAFORM_AWS_INSTANCE_SIZE_I4I_4XLARGE
	bool "i4i.4xlarge"
	help
	  128 GiB RAM, 16 vcpus, 1 x 3,750 AWS Nitro SSD, 25 Gbps Net,
	  10 Gbps EBS.

config TERRAFORM_AWS_INSTANCE_SIZE_I4I_METAL
	bool "i4i.metal"
	help
	  1024 GiB RAM, 128 real cpus?, 8 x 3,750 AWS Nitro SSD,
	  75 Gbps Net, 40 Gbps EBS. The bees' knees I guess.

endchoice

config TERRAFORM_AWS_INSTANCE_TYPE
	string
	output yaml
	default "i4i.large" if TERRAFORM_AWS_INSTANCE_SIZE_I4I_LARGE
	default "i4i.4xlarge" if TERRAFORM_AWS_INSTANCE_SIZE_I4I_4XLARGE
	default "i4i.metal" if TERRAFORM_AWS_INSTANCE_SIZE_I4I_METAL

endif # TERRAFORM_AWS_INSTANCE_TYPE_I4I
```

## terraform/aws/kconfigs/instance-types/Kconfig.i4i.static
```kconfig
# AWS I4I instance sizes (dynamically generated)

choice
	prompt "Instance size for I4I family"
	default TERRAFORM_AWS_INSTANCE_I4I_LARGE
	help
	  Select the specific instance size within the I4I family.

config TERRAFORM_AWS_INSTANCE_I4I_LARGE
	bool "i4i.large"
	help
	  vCPUs: 2
	  Memory: 16.0 GB
	  Network: Up to 10 Gigabit
	  Price: $0.117/hour
	  Instance storage: 468 GB

config TERRAFORM_AWS_INSTANCE_I4I_XLARGE
	bool "i4i.xlarge"
	help
	  vCPUs: 4
	  Memory: 32.0 GB
	  Network: Up to 10 Gigabit
	  Price: $0.234/hour
	  Instance storage: 937 GB

config TERRAFORM_AWS_INSTANCE_I4I_2XLARGE
	bool "i4i.2xlarge"
	help
	  vCPUs: 8
	  Memory: 64.0 GB
	  Network: Up to 12 Gigabit
	  Price: $0.468/hour
	  Instance storage: 1875 GB

config TERRAFORM_AWS_INSTANCE_I4I_4XLARGE
	bool "i4i.4xlarge"
	help
	  vCPUs: 16
	  Memory: 128.0 GB
	  Network: Up to 25 Gigabit
	  Price: $0.936/hour
	  Instance storage: 3750 GB

config TERRAFORM_AWS_INSTANCE_I4I_8XLARGE
	bool "i4i.8xlarge"
	help
	  vCPUs: 32
	  Memory: 256.0 GB
	  Network: 18.75 Gigabit
	  Price: $1.872/hour
	  Instance storage: 7500 GB

config TERRAFORM_AWS_INSTANCE_I4I_12XLARGE
	bool "i4i.12xlarge"
	help
	  vCPUs: 48
	  Memory: 384.0 GB
	  Network: 28.12 Gigabit
	  Price: pricing varies
	  Instance storage: 11250 GB

config TERRAFORM_AWS_INSTANCE_I4I_16XLARGE
	bool "i4i.16xlarge"
	help
	  vCPUs: 64
	  Memory: 512.0 GB
	  Network: 37.5 Gigabit
	  Price: $3.744/hour
	  Instance storage: 15000 GB

config TERRAFORM_AWS_INSTANCE_I4I_24XLARGE
	bool "i4i.24xlarge"
	help
	  vCPUs: 96
	  Memory: 768.0 GB
	  Network: 56.25 Gigabit
	  Price: pricing varies
	  Instance storage: 22500 GB

config TERRAFORM_AWS_INSTANCE_I4I_METAL
	bool "i4i.metal"
	help
	  vCPUs: 128
	  Memory: 1024.0 GB
	  Network: 75 Gigabit
	  Price: pricing varies
	  Instance storage: 30000 GB

config TERRAFORM_AWS_INSTANCE_I4I_32XLARGE
	bool "i4i.32xlarge"
	help
	  vCPUs: 128
	  Memory: 1024.0 GB
	  Network: 75 Gigabit
	  Price: $7.488/hour
	  Instance storage: 30000 GB

endchoice

config TERRAFORM_AWS_I4I_SIZE
	string
	default "i4i.large" if TERRAFORM_AWS_INSTANCE_I4I_LARGE
	default "i4i.xlarge" if TERRAFORM_AWS_INSTANCE_I4I_XLARGE
	default "i4i.2xlarge" if TERRAFORM_AWS_INSTANCE_I4I_2XLARGE
	default "i4i.4xlarge" if TERRAFORM_AWS_INSTANCE_I4I_4XLARGE
	default "i4i.8xlarge" if TERRAFORM_AWS_INSTANCE_I4I_8XLARGE
	default "i4i.12xlarge" if TERRAFORM_AWS_INSTANCE_I4I_12XLARGE
	default "i4i.16xlarge" if TERRAFORM_AWS_INSTANCE_I4I_16XLARGE
	default "i4i.24xlarge" if TERRAFORM_AWS_INSTANCE_I4I_24XLARGE
	default "i4i.metal" if TERRAFORM_AWS_INSTANCE_I4I_METAL
	default "i4i.32xlarge" if TERRAFORM_AWS_INSTANCE_I4I_32XLARGE
	default "i4i.large"
```

## terraform/aws/kconfigs/instance-types/Kconfig.i7i.static
```kconfig
# AWS I7I instance sizes (dynamically generated)

choice
	prompt "Instance size for I7I family"
	default TERRAFORM_AWS_INSTANCE_I7I_LARGE
	help
	  Select the specific instance size within the I7I family.

config TERRAFORM_AWS_INSTANCE_I7I_LARGE
	bool "i7i.large"
	help
	  vCPUs: 2
	  Memory: 16.0 GB
	  Network: Up to 10 Gigabit
	  Price: pricing varies
	  Instance storage: 468 GB

config TERRAFORM_AWS_INSTANCE_I7I_XLARGE
	bool "i7i.xlarge"
	help
	  vCPUs: 4
	  Memory: 32.0 GB
	  Network: Up to 10 Gigabit
	  Price: pricing varies
	  Instance storage: 937 GB

config TERRAFORM_AWS_INSTANCE_I7I_2XLARGE
	bool "i7i.2xlarge"
	help
	  vCPUs: 8
	  Memory: 64.0 GB
	  Network: Up to 12 Gigabit
	  Price: pricing varies
	  Instance storage: 1875 GB

config TERRAFORM_AWS_INSTANCE_I7I_4XLARGE
	bool "i7i.4xlarge"
	help
	  vCPUs: 16
	  Memory: 128.0 GB
	  Network: Up to 25 Gigabit
	  Price: pricing varies
	  Instance storage: 3750 GB

config TERRAFORM_AWS_INSTANCE_I7I_8XLARGE
	bool "i7i.8xlarge"
	help
	  vCPUs: 32
	  Memory: 256.0 GB
	  Network: Up to 25 Gigabit
	  Price: pricing varies
	  Instance storage: 7500 GB

config TERRAFORM_AWS_INSTANCE_I7I_12XLARGE
	bool "i7i.12xlarge"
	help
	  vCPUs: 48
	  Memory: 384.0 GB
	  Network: Up to 28 Gigabit
	  Price: pricing varies
	  Instance storage: 11250 GB

config TERRAFORM_AWS_INSTANCE_I7I_16XLARGE
	bool "i7i.16xlarge"
	help
	  vCPUs: 64
	  Memory: 512.0 GB
	  Network: Up to 37.5 Gigabit
	  Price: pricing varies
	  Instance storage: 15000 GB

config TERRAFORM_AWS_INSTANCE_I7I_METAL_24XL
	bool "i7i.metal-24xl"
	help
	  vCPUs: 96
	  Memory: 768.0 GB
	  Network: Up to 56.25 Gigabit
	  Price: pricing varies
	  Instance storage: 22500 GB

config TERRAFORM_AWS_INSTANCE_I7I_24XLARGE
	bool "i7i.24xlarge"
	help
	  vCPUs: 96
	  Memory: 768.0 GB
	  Network: Up to 56.25 Gigabit
	  Price: pricing varies
	  Instance storage: 22500 GB

config TERRAFORM_AWS_INSTANCE_I7I_METAL_48XL
	bool "i7i.metal-48xl"
	help
	  vCPUs: 192
	  Memory: 1536.0 GB
	  Network: Up to 100 Gigabit
	  Price: pricing varies
	  Instance storage: 45000 GB

config TERRAFORM_AWS_INSTANCE_I7I_48XLARGE
	bool "i7i.48xlarge"
	help
	  vCPUs: 192
	  Memory: 1536.0 GB
	  Network: Up to 100 Gigabit
	  Price: pricing varies
	  Instance storage: 45000 GB

endchoice

config TERRAFORM_AWS_I7I_SIZE
	string
	default "i7i.large" if TERRAFORM_AWS_INSTANCE_I7I_LARGE
	default "i7i.xlarge" if TERRAFORM_AWS_INSTANCE_I7I_XLARGE
	default "i7i.2xlarge" if TERRAFORM_AWS_INSTANCE_I7I_2XLARGE
	default "i7i.4xlarge" if TERRAFORM_AWS_INSTANCE_I7I_4XLARGE
	default "i7i.8xlarge" if TERRAFORM_AWS_INSTANCE_I7I_8XLARGE
	default "i7i.12xlarge" if TERRAFORM_AWS_INSTANCE_I7I_12XLARGE
	default "i7i.16xlarge" if TERRAFORM_AWS_INSTANCE_I7I_16XLARGE
	default "i7i.metal-24xl" if TERRAFORM_AWS_INSTANCE_I7I_METAL_24XL
	default "i7i.24xlarge" if TERRAFORM_AWS_INSTANCE_I7I_24XLARGE
	default "i7i.metal-48xl" if TERRAFORM_AWS_INSTANCE_I7I_METAL_48XL
	default "i7i.48xlarge" if TERRAFORM_AWS_INSTANCE_I7I_48XLARGE
	default "i7i.large"
```

## terraform/aws/kconfigs/instance-types/Kconfig.i7ie.static
```kconfig
# AWS I7IE instance sizes (dynamically generated)

choice
	prompt "Instance size for I7IE family"
	default TERRAFORM_AWS_INSTANCE_I7IE_LARGE
	help
	  Select the specific instance size within the I7IE family.

config TERRAFORM_AWS_INSTANCE_I7IE_LARGE
	bool "i7ie.large"
	help
	  vCPUs: 2
	  Memory: 16.0 GB
	  Network: Up to 25 Gigabit
	  Price: pricing varies
	  Instance storage: 1250 GB

config TERRAFORM_AWS_INSTANCE_I7IE_XLARGE
	bool "i7ie.xlarge"
	help
	  vCPUs: 4
	  Memory: 32.0 GB
	  Network: Up to 25 Gigabit
	  Price: pricing varies
	  Instance storage: 2500 GB

config TERRAFORM_AWS_INSTANCE_I7IE_2XLARGE
	bool "i7ie.2xlarge"
	help
	  vCPUs: 8
	  Memory: 64.0 GB
	  Network: Up to 25 Gigabit
	  Price: pricing varies
	  Instance storage: 5000 GB

config TERRAFORM_AWS_INSTANCE_I7IE_3XLARGE
	bool "i7ie.3xlarge"
	help
	  vCPUs: 12
	  Memory: 96.0 GB
	  Network: Up to 25 Gigabit
	  Price: pricing varies
	  Instance storage: 7500 GB

config TERRAFORM_AWS_INSTANCE_I7IE_6XLARGE
	bool "i7ie.6xlarge"
	help
	  vCPUs: 24
	  Memory: 192.0 GB
	  Network: Up to 25 Gigabit
	  Price: pricing varies
	  Instance storage: 15000 GB

config TERRAFORM_AWS_INSTANCE_I7IE_12XLARGE
	bool "i7ie.12xlarge"
	help
	  vCPUs: 48
	  Memory: 384.0 GB
	  Network: Up to 50 Gigabit
	  Price: pricing varies
	  Instance storage: 30000 GB

config TERRAFORM_AWS_INSTANCE_I7IE_18XLARGE
	bool "i7ie.18xlarge"
	help
	  vCPUs: 72
	  Memory: 576.0 GB
	  Network: Up to 75 Gigabit
	  Price: pricing varies
	  Instance storage: 45000 GB

config TERRAFORM_AWS_INSTANCE_I7IE_24XLARGE
	bool "i7ie.24xlarge"
	help
	  vCPUs: 96
	  Memory: 768.0 GB
	  Network: Up to 100 Gigabit
	  Price: pricing varies
	  Instance storage: 60000 GB

config TERRAFORM_AWS_INSTANCE_I7IE_METAL_24XL
	bool "i7ie.metal-24xl"
	help
	  vCPUs: 96
	  Memory: 768.0 GB
	  Network: Up to 100 Gigabit
	  Price: pricing varies
	  Instance storage: 60000 GB

config TERRAFORM_AWS_INSTANCE_I7IE_METAL_48XL
	bool "i7ie.metal-48xl"
	help
	  vCPUs: 192
	  Memory: 1536.0 GB
	  Network: 100 Gigabit
	  Price: pricing varies
	  Instance storage: 120000 GB

config TERRAFORM_AWS_INSTANCE_I7IE_48XLARGE
	bool "i7ie.48xlarge"
	help
	  vCPUs: 192
	  Memory: 1536.0 GB
	  Network: 100 Gigabit
	  Price: pricing varies
	  Instance storage: 120000 GB

endchoice

config TERRAFORM_AWS_I7IE_SIZE
	string
	default "i7ie.large" if TERRAFORM_AWS_INSTANCE_I7IE_LARGE
	default "i7ie.xlarge" if TERRAFORM_AWS_INSTANCE_I7IE_XLARGE
	default "i7ie.2xlarge" if TERRAFORM_AWS_INSTANCE_I7IE_2XLARGE
	default "i7ie.3xlarge" if TERRAFORM_AWS_INSTANCE_I7IE_3XLARGE
	default "i7ie.6xlarge" if TERRAFORM_AWS_INSTANCE_I7IE_6XLARGE
	default "i7ie.12xlarge" if TERRAFORM_AWS_INSTANCE_I7IE_12XLARGE
	default "i7ie.18xlarge" if TERRAFORM_AWS_INSTANCE_I7IE_18XLARGE
	default "i7ie.24xlarge" if TERRAFORM_AWS_INSTANCE_I7IE_24XLARGE
	default "i7ie.metal-24xl" if TERRAFORM_AWS_INSTANCE_I7IE_METAL_24XL
	default "i7ie.metal-48xl" if TERRAFORM_AWS_INSTANCE_I7IE_METAL_48XL
	default "i7ie.48xlarge" if TERRAFORM_AWS_INSTANCE_I7IE_48XLARGE
	default "i7ie.large"
```

## terraform/aws/kconfigs/instance-types/Kconfig.i8g.static
```kconfig
# AWS I8G instance sizes (dynamically generated)

choice
	prompt "Instance size for I8G family"
	default TERRAFORM_AWS_INSTANCE_I8G_LARGE
	help
	  Select the specific instance size within the I8G family.

config TERRAFORM_AWS_INSTANCE_I8G_LARGE
	bool "i8g.large"
	help
	  vCPUs: 2
	  Memory: 16.0 GB
	  Network: Up to 10 Gigabit
	  Price: pricing varies
	  Instance storage: 468 GB

config TERRAFORM_AWS_INSTANCE_I8G_XLARGE
	bool "i8g.xlarge"
	help
	  vCPUs: 4
	  Memory: 32.0 GB
	  Network: Up to 10 Gigabit
	  Price: pricing varies
	  Instance storage: 937 GB

config TERRAFORM_AWS_INSTANCE_I8G_2XLARGE
	bool "i8g.2xlarge"
	help
	  vCPUs: 8
	  Memory: 64.0 GB
	  Network: Up to 12 Gigabit
	  Price: pricing varies
	  Instance storage: 1875 GB

config TERRAFORM_AWS_INSTANCE_I8G_4XLARGE
	bool "i8g.4xlarge"
	help
	  vCPUs: 16
	  Memory: 128.0 GB
	  Network: Up to 25 Gigabit
	  Price: pricing varies
	  Instance storage: 3750 GB

config TERRAFORM_AWS_INSTANCE_I8G_8XLARGE
	bool "i8g.8xlarge"
	help
	  vCPUs: 32
	  Memory: 256.0 GB
	  Network: Up to 25 Gigabit
	  Price: pricing varies
	  Instance storage: 7500 GB

config TERRAFORM_AWS_INSTANCE_I8G_12XLARGE
	bool "i8g.12xlarge"
	help
	  vCPUs: 48
	  Memory: 384.0 GB
	  Network: Up to 28.12 Gigabit
	  Price: pricing varies
	  Instance storage: 11250 GB

config TERRAFORM_AWS_INSTANCE_I8G_16XLARGE
	bool "i8g.16xlarge"
	help
	  vCPUs: 64
	  Memory: 512.0 GB
	  Network: Up to 37.5 Gigabit
	  Price: pricing varies
	  Instance storage: 15000 GB

config TERRAFORM_AWS_INSTANCE_I8G_24XLARGE
	bool "i8g.24xlarge"
	help
	  vCPUs: 96
	  Memory: 768.0 GB
	  Network: Up to 56.25 Gigabit
	  Price: pricing varies
	  Instance storage: 22500 GB

config TERRAFORM_AWS_INSTANCE_I8G_METAL_24XL
	bool "i8g.metal-24xl"
	help
	  vCPUs: 96
	  Memory: 768.0 GB
	  Network: Up to 56.25 Gigabit
	  Price: pricing varies
	  Instance storage: 22500 GB

config TERRAFORM_AWS_INSTANCE_I8G_48XLARGE
	bool "i8g.48xlarge"
	help
	  vCPUs: 192
	  Memory: 1536.0 GB
	  Network: Up to 100 Gigabit
	  Price: pricing varies
	  Instance storage: 45000 GB

endchoice

config TERRAFORM_AWS_I8G_SIZE
	string
	default "i8g.large" if TERRAFORM_AWS_INSTANCE_I8G_LARGE
	default "i8g.xlarge" if TERRAFORM_AWS_INSTANCE_I8G_XLARGE
	default "i8g.2xlarge" if TERRAFORM_AWS_INSTANCE_I8G_2XLARGE
	default "i8g.4xlarge" if TERRAFORM_AWS_INSTANCE_I8G_4XLARGE
	default "i8g.8xlarge" if TERRAFORM_AWS_INSTANCE_I8G_8XLARGE
	default "i8g.12xlarge" if TERRAFORM_AWS_INSTANCE_I8G_12XLARGE
	default "i8g.16xlarge" if TERRAFORM_AWS_INSTANCE_I8G_16XLARGE
	default "i8g.24xlarge" if TERRAFORM_AWS_INSTANCE_I8G_24XLARGE
	default "i8g.metal-24xl" if TERRAFORM_AWS_INSTANCE_I8G_METAL_24XL
	default "i8g.48xlarge" if TERRAFORM_AWS_INSTANCE_I8G_48XLARGE
	default "i8g.large"
```
