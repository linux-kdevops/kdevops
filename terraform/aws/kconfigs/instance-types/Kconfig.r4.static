## terraform/aws/kconfigs/instance-types/Kconfig.r5n.static
```kconfig
# AWS R5N instance sizes (dynamically generated)

choice
	prompt "Instance size for R5N family"
	default TERRAFORM_AWS_INSTANCE_R5N_LARGE
	help
	  Select the specific instance size within the R5N family.

config TERRAFORM_AWS_INSTANCE_R5N_LARGE
	bool "r5n.large"
	help
	  vCPUs: 2
	  Memory: 16.0 GB
	  Network: Up to 25 Gigabit
	  Price: pricing varies

config TERRAFORM_AWS_INSTANCE_R5N_XLARGE
	bool "r5n.xlarge"
	help
	  vCPUs: 4
	  Memory: 32.0 GB
	  Network: Up to 25 Gigabit
	  Price: pricing varies

config TERRAFORM_AWS_INSTANCE_R5N_2XLARGE
	bool "r5n.2xlarge"
	help
	  vCPUs: 8
	  Memory: 64.0 GB
	  Network: Up to 25 Gigabit
	  Price: pricing varies

config TERRAFORM_AWS_INSTANCE_R5N_4XLARGE
	bool "r5n.4xlarge"
	help
	  vCPUs: 16
	  Memory: 128.0 GB
	  Network: Up to 25 Gigabit
	  Price: pricing varies

config TERRAFORM_AWS_INSTANCE_R5N_8XLARGE
	bool "r5n.8xlarge"
	help
	  vCPUs: 32
	  Memory: 256.0 GB
	  Network: 25 Gigabit
	  Price: pricing varies

config TERRAFORM_AWS_INSTANCE_R5N_12XLARGE
	bool "r5n.12xlarge"
	help
	  vCPUs: 48
	  Memory: 384.0 GB
	  Network: 50 Gigabit
	  Price: pricing varies

config TERRAFORM_AWS_INSTANCE_R5N_16XLARGE
	bool "r5n.16xlarge"
	help
	  vCPUs: 64
	  Memory: 512.0 GB
	  Network: 75 Gigabit
	  Price: pricing varies

config TERRAFORM_AWS_INSTANCE_R5N_24XLARGE
	bool "r5n.24xlarge"
	help
	  vCPUs: 96
	  Memory: 768.0 GB
	  Network: 100 Gigabit
	  Price: pricing varies

config TERRAFORM_AWS_INSTANCE_R5N_METAL
	bool "r5n.metal"
	help
	  vCPUs: 96
	  Memory: 768.0 GB
	  Network: 100 Gigabit
	  Price: pricing varies

endchoice

config TERRAFORM_AWS_R5N_SIZE
	string
	default "r5n.large" if TERRAFORM_AWS_INSTANCE_R5N_LARGE
	default "r5n.xlarge" if TERRAFORM_AWS_INSTANCE_R5N_XLARGE
	default "r5n.2xlarge" if TERRAFORM_AWS_INSTANCE_R5N_2XLARGE
	default "r5n.4xlarge" if TERRAFORM_AWS_INSTANCE_R5N_4XLARGE
	default "r5n.8xlarge" if TERRAFORM_AWS_INSTANCE_R5N_8XLARGE
	default "r5n.12xlarge" if TERRAFORM_AWS_INSTANCE_R5N_12XLARGE
	default "r5n.16xlarge" if TERRAFORM_AWS_INSTANCE_R5N_16XLARGE
	default "r5n.24xlarge" if TERRAFORM_AWS_INSTANCE_R5N_24XLARGE
	default "r5n.metal" if TERRAFORM_AWS_INSTANCE_R5N_METAL
	default "r5n.large"
```

## terraform/aws/kconfigs/instance-types/Kconfig.r6a.static
```kconfig
# AWS R6A instance sizes (dynamically generated)

choice
	prompt "Instance size for R6A family"
	default TERRAFORM_AWS_INSTANCE_R6A_LARGE
	help
	  Select the specific instance size within the R6A family.

config TERRAFORM_AWS_INSTANCE_R6A_LARGE
	bool "r6a.large"
	help
	  vCPUs: 2
	  Memory: 16.0 GB
	  Network: Up to 12.5 Gigabit
	  Price: pricing varies

config TERRAFORM_AWS_INSTANCE_R6A_XLARGE
	bool "r6a.xlarge"
	help
	  vCPUs: 4
	  Memory: 32.0 GB
	  Network: Up to 12.5 Gigabit
	  Price: pricing varies

config TERRAFORM_AWS_INSTANCE_R6A_2XLARGE
	bool "r6a.2xlarge"
	help
	  vCPUs: 8
	  Memory: 64.0 GB
	  Network: Up to 12.5 Gigabit
	  Price: pricing varies

config TERRAFORM_AWS_INSTANCE_R6A_4XLARGE
	bool "r6a.4xlarge"
	help
	  vCPUs: 16
	  Memory: 128.0 GB
	  Network: Up to 12.5 Gigabit
	  Price: pricing varies

config TERRAFORM_AWS_INSTANCE_R6A_8XLARGE
	bool "r6a.8xlarge"
	help
	  vCPUs: 32
	  Memory: 256.0 GB
	  Network: 12.5 Gigabit
	  Price: pricing varies

config TERRAFORM_AWS_INSTANCE_R6A_12XLARGE
	bool "r6a.12xlarge"
	help
	  vCPUs: 48
	  Memory: 384.0 GB
	  Network: 18.75 Gigabit
	  Price: pricing varies

config TERRAFORM_AWS_INSTANCE_R6A_16XLARGE
	bool "r6a.16xlarge"
	help
	  vCPUs: 64
	  Memory: 512.0 GB
	  Network: 25 Gigabit
	  Price: pricing varies

config TERRAFORM_AWS_INSTANCE_R6A_24XLARGE
	bool "r6a.24xlarge"
	help
	  vCPUs: 96
	  Memory: 768.0 GB
	  Network: 37.5 Gigabit
	  Price: pricing varies

config TERRAFORM_AWS_INSTANCE_R6A_32XLARGE
	bool "r6a.32xlarge"
	help
	  vCPUs: 128
	  Memory: 1024.0 GB
	  Network: 50 Gigabit
	  Price: pricing varies

config TERRAFORM_AWS_INSTANCE_R6A_METAL
	bool "r6a.metal"
	help
	  vCPUs: 192
	  Memory: 1536.0 GB
	  Network: 50 Gigabit
	  Price: pricing varies

config TERRAFORM_AWS_INSTANCE_R6A_48XLARGE
	bool "r6a.48xlarge"
	help
	  vCPUs: 192
	  Memory: 1536.0 GB
	  Network: 50 Gigabit
	  Price: pricing varies

endchoice

config TERRAFORM_AWS_R6A_SIZE
	string
	default "r6a.large" if TERRAFORM_AWS_INSTANCE_R6A_LARGE
	default "r6a.xlarge" if TERRAFORM_AWS_INSTANCE_R6A_XLARGE
	default "r6a.2xlarge" if TERRAFORM_AWS_INSTANCE_R6A_2XLARGE
	default "r6a.4xlarge" if TERRAFORM_AWS_INSTANCE_R6A_4XLARGE
	default "r6a.8xlarge" if TERRAFORM_AWS_INSTANCE_R6A_8XLARGE
	default "r6a.12xlarge" if TERRAFORM_AWS_INSTANCE_R6A_12XLARGE
	default "r6a.16xlarge" if TERRAFORM_AWS_INSTANCE_R6A_16XLARGE
	default "r6a.24xlarge" if TERRAFORM_AWS_INSTANCE_R6A_24XLARGE
	default "r6a.32xlarge" if TERRAFORM_AWS_INSTANCE_R6A_32XLARGE
	default "r6a.metal" if TERRAFORM_AWS_INSTANCE_R6A_METAL
	default "r6a.48xlarge" if TERRAFORM_AWS_INSTANCE_R6A_48XLARGE
	default "r6a.large"
```

## terraform/aws/kconfigs/instance-types/Kconfig.r6g.static
```kconfig
# AWS R6G instance sizes (dynamically generated)

choice
	prompt "Instance size for R6G family"
	default TERRAFORM_AWS_INSTANCE_R6G_MEDIUM
	help
	  Select the specific instance size within the R6G family.

config TERRAFORM_AWS_INSTANCE_R6G_MEDIUM
	bool "r6g.medium"
	help
	  vCPUs: 1
	  Memory: 8.0 GB
	  Network: Up to 10 Gigabit
	  Price: pricing varies

config TERRAFORM_AWS_INSTANCE_R6G_LARGE
	bool "r6g.large"
	help
	  vCPUs: 2
	  Memory: 16.0 GB
	  Network: Up to 10 Gigabit
	  Price: pricing varies

config TERRAFORM_AWS_INSTANCE_R6G_XLARGE
	bool "r6g.xlarge"
	help
	  vCPUs: 4
	  Memory: 32.0 GB
	  Network: Up to 10 Gigabit
	  Price: pricing varies

config TERRAFORM_AWS_INSTANCE_R6G_2XLARGE
	bool "r6g.2xlarge"
	help
	  vCPUs: 8
	  Memory: 64.0 GB
	  Network: Up to 10 Gigabit
	  Price: pricing varies

config TERRAFORM_AWS_INSTANCE_R6G_4XLARGE
	bool "r6g.4xlarge"
	help
	  vCPUs: 16
	  Memory: 128.0 GB
	  Network: Up to 10 Gigabit
	  Price: pricing varies

config TERRAFORM_AWS_INSTANCE_R6G_8XLARGE
	bool "r6g.8xlarge"
	help
	  vCPUs: 32
	  Memory: 256.0 GB
	  Network: 12 Gigabit
	  Price: pricing varies

config TERRAFORM_AWS_INSTANCE_R6G_12XLARGE
	bool "r6g.12xlarge"
	help
	  vCPUs: 48
	  Memory: 384.0 GB
	  Network: 20 Gigabit
	  Price: pricing varies

config TERRAFORM_AWS_INSTANCE_R6G_16XLARGE
	bool "r6g.16xlarge"
	help
	  vCPUs: 64
	  Memory: 512.0 GB
	  Network: 25 Gigabit
	  Price: pricing varies

config TERRAFORM_AWS_INSTANCE_R6G_METAL
	bool "r6g.metal"
	help
	  vCPUs: 64
	  Memory: 512.0 GB
	  Network: 25 Gigabit
	  Price: pricing varies

endchoice

config TERRAFORM_AWS_R6G_SIZE
	string
	default "r6g.medium" if TERRAFORM_AWS_INSTANCE_R6G_MEDIUM
	default "r6g.large" if TERRAFORM_AWS_INSTANCE_R6G_LARGE
	default "r6g.xlarge" if TERRAFORM_AWS_INSTANCE_R6G_XLARGE
	default "r6g.2xlarge" if TERRAFORM_AWS_INSTANCE_R6G_2XLARGE
	default "r6g.4xlarge" if TERRAFORM_AWS_INSTANCE_R6G_4XLARGE
	default "r6g.8xlarge" if TERRAFORM_AWS_INSTANCE_R6G_8XLARGE
	default "r6g.12xlarge" if TERRAFORM_AWS_INSTANCE_R6G_12XLARGE
	default "r6g.16xlarge" if TERRAFORM_AWS_INSTANCE_R6G_16XLARGE
	default "r6g.metal" if TERRAFORM_AWS_INSTANCE_R6G_METAL
	default "r6g.medium"
```

## terraform/aws/kconfigs/instance-types/Kconfig.r6i.static
```kconfig
# AWS R6I instance sizes (dynamically generated)

choice
	prompt "Instance size for R6I family"
	default TERRAFORM_AWS_INSTANCE_R6I_LARGE
	help
	  Select the specific instance size within the R6I family.

config TERRAFORM_AWS_INSTANCE_R6I_LARGE
	bool "r6i.large"
	help
	  vCPUs: 2
	  Memory: 16.0 GB
	  Network: Up to 12.5 Gigabit
	  Price: pricing varies

config TERRAFORM_AWS_INSTANCE_R6I_XLARGE
	bool "r6i.xlarge"
	help
	  vCPUs: 4
	  Memory: 32.0 GB
	  Network: Up to 12.5 Gigabit
	  Price: pricing varies

config TERRAFORM_AWS_INSTANCE_R6I_2XLARGE
	bool "r6i.2xlarge"
	help
	  vCPUs: 8
	  Memory: 64.0 GB
	  Network: Up to 12.5 Gigabit
	  Price: pricing varies

config TERRAFORM_AWS_INSTANCE_R6I_4XLARGE
	bool "r6i.4xlarge"
	help
	  vCPUs: 16
	  Memory: 128.0 GB
	  Network: Up to 12.5 Gigabit
	  Price: pricing varies

config TERRAFORM_AWS_INSTANCE_R6I_8XLARGE
	bool "r6i.8xlarge"
	help
	  vCPUs: 32
	  Memory: 256.0 GB
	  Network: 12.5 Gigabit
	  Price: pricing varies

config TERRAFORM_AWS_INSTANCE_R6I_12XLARGE
	bool "r6i.12xlarge"
	help
	  vCPUs: 48
	  Memory: 384.0 GB
	  Network: 18.75 Gigabit
	  Price: pricing varies

config TERRAFORM_AWS_INSTANCE_R6I_16XLARGE
	bool "r6i.16xlarge"
	help
	  vCPUs: 64
	  Memory: 512.0 GB
	  Network: 25 Gigabit
	  Price: pricing varies

config TERRAFORM_AWS_INSTANCE_R6I_24XLARGE
	bool "r6i.24xlarge"
	help
	  vCPUs: 96
	  Memory: 768.0 GB
	  Network: 37.5 Gigabit
	  Price: pricing varies

config TERRAFORM_AWS_INSTANCE_R6I_METAL
	bool "r6i.metal"
	help
	  vCPUs: 128
	  Memory: 1024.0 GB
	  Network: 50 Gigabit
	  Price: pricing varies

config TERRAFORM_AWS_INSTANCE_R6I_32XLARGE
	bool "r6i.32xlarge"
	help
	  vCPUs: 128
	  Memory: 1024.0 GB
	  Network: 50 Gigabit
	  Price: pricing varies

endchoice

config TERRAFORM_AWS_R6I_SIZE
	string
	default "r6i.large" if TERRAFORM_AWS_INSTANCE_R6I_LARGE
	default "r6i.xlarge" if TERRAFORM_AWS_INSTANCE_R6I_XLARGE
	default "r6i.2xlarge" if TERRAFORM_AWS_INSTANCE_R6I_2XLARGE
	default "r6i.4xlarge" if TERRAFORM_AWS_INSTANCE_R6I_4XLARGE
	default "r6i.8xlarge" if TERRAFORM_AWS_INSTANCE_R6I_8XLARGE
	default "r6i.12xlarge" if TERRAFORM_AWS_INSTANCE_R6I_12XLARGE
	default "r6i.16xlarge" if TERRAFORM_AWS_INSTANCE_R6I_16XLARGE
	default "r6i.24xlarge" if TERRAFORM_AWS_INSTANCE_R6I_24XLARGE
	default "r6i.metal" if TERRAFORM_AWS_INSTANCE_R6I_METAL
	default "r6i.32xlarge" if TERRAFORM_AWS_INSTANCE_R6I_32XLARGE
	default "r6i.large"
```

## terraform/aws/kconfigs/instance-types/Kconfig.r6id.static
```kconfig
# AWS R6ID instance sizes (dynamically generated)

choice
	prompt "Instance size for R6ID family"
	default TERRAFORM_AWS_INSTANCE_R6ID_LARGE
	help
	  Select the specific instance size within the R6ID family.

config TERRAFORM_AWS_INSTANCE_R6ID_LARGE
	bool "r6id.large"
	help
	  vCPUs: 2
	  Memory: 16.0 GB
	  Network: Up to 12.5 Gigabit
	  Price: pricing varies
	  Instance storage: 118 GB

config TERRAFORM_AWS_INSTANCE_R6ID_XLARGE
	bool "r6id.xlarge"
	help
	  vCPUs: 4
	  Memory: 32.0 GB
	  Network: Up to 12.5 Gigabit
	  Price: pricing varies
	  Instance storage: 237 GB

config TERRAFORM_AWS_INSTANCE_R6ID_2XLARGE
	bool "r6id.2xlarge"
	help
	  vCPUs: 8
	  Memory: 64.0 GB
	  Network: Up to 12.5 Gigabit
	  Price: pricing varies
	  Instance storage: 474 GB

config TERRAFORM_AWS_INSTANCE_R6ID_4XLARGE
	bool "r6id.4xlarge"
	help
	  vCPUs: 16
	  Memory: 128.0 GB
	  Network: Up to 12.5 Gigabit
	  Price: pricing varies
	  Instance storage: 950 GB

config TERRAFORM_AWS_INSTANCE_R6ID_8XLARGE
	bool "r6id.8xlarge"
	help
	  vCPUs: 32
	  Memory: 256.0 GB
	  Network: 12.5 Gigabit
	  Price: pricing varies
	  Instance storage: 1900 GB

config TERRAFORM_AWS_INSTANCE_R6ID_12XLARGE
	bool "r6id.12xlarge"
	help
	  vCPUs: 48
	  Memory: 384.0 GB
	  Network: 18.75 Gigabit
	  Price: pricing varies
	  Instance storage: 2850 GB

config TERRAFORM_AWS_INSTANCE_R6ID_16XLARGE
	bool "r6id.16xlarge"
	help
	  vCPUs: 64
	  Memory: 512.0 GB
	  Network: 25 Gigabit
	  Price: pricing varies
	  Instance storage: 3800 GB

config TERRAFORM_AWS_INSTANCE_R6ID_24XLARGE
	bool "r6id.24xlarge"
	help
	  vCPUs: 96
	  Memory: 768.0 GB
	  Network: 37.5 Gigabit
	  Price: pricing varies
	  Instance storage: 5700 GB

config TERRAFORM_AWS_INSTANCE_R6ID_32XLARGE
	bool "r6id.32xlarge"
	help
	  vCPUs: 128
	  Memory: 1024.0 GB
	  Network: 50 Gigabit
	  Price: pricing varies
	  Instance storage: 7600 GB

config TERRAFORM_AWS_INSTANCE_R6ID_METAL
	bool "r6id.metal"
	help
	  vCPUs: 128
	  Memory: 1024.0 GB
	  Network: 50 Gigabit
	  Price: pricing varies
	  Instance storage: 7600 GB

endchoice

config TERRAFORM_AWS_R6ID_SIZE
	string
	default "r6id.large" if TERRAFORM_AWS_INSTANCE_R6ID_LARGE
	default "r6id.xlarge" if TERRAFORM_AWS_INSTANCE_R6ID_XLARGE
	default "r6id.2xlarge" if TERRAFORM_AWS_INSTANCE_R6ID_2XLARGE
	default "r6id.4xlarge" if TERRAFORM_AWS_INSTANCE_R6ID_4XLARGE
	default "r6id.8xlarge" if TERRAFORM_AWS_INSTANCE_R6ID_8XLARGE
	default "r6id.12xlarge" if TERRAFORM_AWS_INSTANCE_R6ID_12XLARGE
	default "r6id.16xlarge" if TERRAFORM_AWS_INSTANCE_R6ID_16XLARGE
	default "r6id.24xlarge" if TERRAFORM_AWS_INSTANCE_R6ID_24XLARGE
	default "r6id.32xlarge" if TERRAFORM_AWS_INSTANCE_R6ID_32XLARGE
	default "r6id.metal" if TERRAFORM_AWS_INSTANCE_R6ID_METAL
	default "r6id.large"
```

## terraform/aws/kconfigs/instance-types/Kconfig.r6idn.static
```kconfig
# AWS R6IDN instance sizes (dynamically generated)

choice
	prompt "Instance size for R6IDN family"
	default TERRAFORM_AWS_INSTANCE_R6IDN_LARGE
	help
	  Select the specific instance size within the R6IDN family.

config TERRAFORM_AWS_INSTANCE_R6IDN_LARGE
	bool "r6idn.large"
	help
	  vCPUs: 2
	  Memory: 16.0 GB
	  Network: Up to 25 Gigabit
	  Price: pricing varies
	  Instance storage: 118 GB

config TERRAFORM_AWS_INSTANCE_R6IDN_XLARGE
	bool "r6idn.xlarge"
	help
	  vCPUs: 4
	  Memory: 32.0 GB
	  Network: Up to 30 Gigabit
	  Price: pricing varies
	  Instance storage: 237 GB

config TERRAFORM_AWS_INSTANCE_R6IDN_2XLARGE
	bool "r6idn.2xlarge"
	help
	  vCPUs: 8
	  Memory: 64.0 GB
	  Network: Up to 40 Gigabit
	  Price: pricing varies
	  Instance storage: 474 GB

config TERRAFORM_AWS_INSTANCE_R6IDN_4XLARGE
	bool "r6idn.4xlarge"
	help
	  vCPUs: 16
	  Memory: 128.0 GB
	  Network: Up to 50 Gigabit
	  Price: pricing varies
	  Instance storage: 950 GB

config TERRAFORM_AWS_INSTANCE_R6IDN_8XLARGE
	bool "r6idn.8xlarge"
	help
	  vCPUs: 32
	  Memory: 256.0 GB
	  Network: 50 Gigabit
	  Price: pricing varies
	  Instance storage: 1900 GB

config TERRAFORM_AWS_INSTANCE_R6IDN_12XLARGE
	bool "r6idn.12xlarge"
	help
	  vCPUs: 48
	  Memory: 384.0 GB
	  Network: 75 Gigabit
	  Price: pricing varies
	  Instance storage: 2850 GB

config TERRAFORM_AWS_INSTANCE_R6IDN_16XLARGE
	bool "r6idn.16xlarge"
	help
	  vCPUs: 64
	  Memory: 512.0 GB
	  Network: 100 Gigabit
	  Price: pricing varies
	  Instance storage: 3800 GB

config TERRAFORM_AWS_INSTANCE_R6IDN_24XLARGE
	bool "r6idn.24xlarge"
	help
	  vCPUs: 96
	  Memory: 768.0 GB
	  Network: 150 Gigabit
	  Price: pricing varies
	  Instance storage: 5700 GB

config TERRAFORM_AWS_INSTANCE_R6IDN_METAL
	bool "r6idn.metal"
	help
	  vCPUs: 128
	  Memory: 1024.0 GB
	  Network: 200 Gigabit
	  Price: pricing varies
	  Instance storage: 7600 GB

config TERRAFORM_AWS_INSTANCE_R6IDN_32XLARGE
	bool "r6idn.32xlarge"
	help
	  vCPUs: 128
	  Memory: 1024.0 GB
	  Network: 200 Gigabit
	  Price: pricing varies
	  Instance storage: 7600 GB

endchoice

config TERRAFORM_AWS_R6IDN_SIZE
	string
	default "r6idn.large" if TERRAFORM_AWS_INSTANCE_R6IDN_LARGE
	default "r6idn.xlarge" if TERRAFORM_AWS_INSTANCE_R6IDN_XLARGE
	default "r6idn.2xlarge" if TERRAFORM_AWS_INSTANCE_R6IDN_2XLARGE
	default "r6idn.4xlarge" if TERRAFORM_AWS_INSTANCE_R6IDN_4XLARGE
	default "r6idn.8xlarge" if TERRAFORM_AWS_INSTANCE_R6IDN_8XLARGE
	default "r6idn.12xlarge" if TERRAFORM_AWS_INSTANCE_R6IDN_12XLARGE
	default "r6idn.16xlarge" if TERRAFORM_AWS_INSTANCE_R6IDN_16XLARGE
	default "r6idn.24xlarge" if TERRAFORM_AWS_INSTANCE_R6IDN_24XLARGE
	default "r6idn.metal" if TERRAFORM_AWS_INSTANCE_R6IDN_METAL
	default "r6idn.32xlarge" if TERRAFORM_AWS_INSTANCE_R6IDN_32XLARGE
	default "r6idn.large"
```
