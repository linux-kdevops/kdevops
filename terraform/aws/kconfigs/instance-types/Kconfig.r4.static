## terraform/aws/kconfigs/instance-types/Kconfig.r4.static
```kconfig
# AWS R4 instance sizes (dynamically generated)

choice
	prompt "Instance size for R4 family"
	default TERRAFORM_AWS_INSTANCE_R4_LARGE
	help
	  Select the specific instance size within the R4 family.

config TERRAFORM_AWS_INSTANCE_R4_LARGE
	bool "r4.large"
	help
	  vCPUs: 2
	  Memory: 15.2 GB
	  Network: Up to 10 Gigabit
	  Price: pricing varies

config TERRAFORM_AWS_INSTANCE_R4_XLARGE
	bool "r4.xlarge"
	help
	  vCPUs: 4
	  Memory: 30.5 GB
	  Network: Up to 10 Gigabit
	  Price: pricing varies

config TERRAFORM_AWS_INSTANCE_R4_2XLARGE
	bool "r4.2xlarge"
	help
	  vCPUs: 8
	  Memory: 61.0 GB
	  Network: Up to 10 Gigabit
	  Price: pricing varies

config TERRAFORM_AWS_INSTANCE_R4_4XLARGE
	bool "r4.4xlarge"
	help
	  vCPUs: 16
	  Memory: 122.0 GB
	  Network: Up to 10 Gigabit
	  Price: pricing varies

config TERRAFORM_AWS_INSTANCE_R4_8XLARGE
	bool "r4.8xlarge"
	help
	  vCPUs: 32
	  Memory: 244.0 GB
	  Network: 10 Gigabit
	  Price: pricing varies

config TERRAFORM_AWS_INSTANCE_R4_16XLARGE
	bool "r4.16xlarge"
	help
	  vCPUs: 64
	  Memory: 488.0 GB
	  Network: 25 Gigabit
	  Price: pricing varies

endchoice

config TERRAFORM_AWS_R4_SIZE
	string
	default "r4.large" if TERRAFORM_AWS_INSTANCE_R4_LARGE
	default "r4.xlarge" if TERRAFORM_AWS_INSTANCE_R4_XLARGE
	default "r4.2xlarge" if TERRAFORM_AWS_INSTANCE_R4_2XLARGE
	default "r4.4xlarge" if TERRAFORM_AWS_INSTANCE_R4_4XLARGE
	default "r4.8xlarge" if TERRAFORM_AWS_INSTANCE_R4_8XLARGE
	default "r4.16xlarge" if TERRAFORM_AWS_INSTANCE_R4_16XLARGE
	default "r4.large"
```

## terraform/aws/kconfigs/instance-types/Kconfig.r5.static
```kconfig
# AWS R5 instance sizes (dynamically generated)

choice
	prompt "Instance size for R5 family"
	default TERRAFORM_AWS_INSTANCE_R5_LARGE
	help
	  Select the specific instance size within the R5 family.

config TERRAFORM_AWS_INSTANCE_R5_LARGE
	bool "r5.large"
	help
	  vCPUs: 2
	  Memory: 16.0 GB
	  Network: Up to 10 Gigabit
	  Price: pricing varies

config TERRAFORM_AWS_INSTANCE_R5_XLARGE
	bool "r5.xlarge"
	help
	  vCPUs: 4
	  Memory: 32.0 GB
	  Network: Up to 10 Gigabit
	  Price: pricing varies

config TERRAFORM_AWS_INSTANCE_R5_2XLARGE
	bool "r5.2xlarge"
	help
	  vCPUs: 8
	  Memory: 64.0 GB
	  Network: Up to 10 Gigabit
	  Price: pricing varies

config TERRAFORM_AWS_INSTANCE_R5_4XLARGE
	bool "r5.4xlarge"
	help
	  vCPUs: 16
	  Memory: 128.0 GB
	  Network: Up to 10 Gigabit
	  Price: pricing varies

config TERRAFORM_AWS_INSTANCE_R5_8XLARGE
	bool "r5.8xlarge"
	help
	  vCPUs: 32
	  Memory: 256.0 GB
	  Network: 10 Gigabit
	  Price: pricing varies

config TERRAFORM_AWS_INSTANCE_R5_12XLARGE
	bool "r5.12xlarge"
	help
	  vCPUs: 48
	  Memory: 384.0 GB
	  Network: 12 Gigabit
	  Price: pricing varies

config TERRAFORM_AWS_INSTANCE_R5_16XLARGE
	bool "r5.16xlarge"
	help
	  vCPUs: 64
	  Memory: 512.0 GB
	  Network: 20 Gigabit
	  Price: pricing varies

config TERRAFORM_AWS_INSTANCE_R5_24XLARGE
	bool "r5.24xlarge"
	help
	  vCPUs: 96
	  Memory: 768.0 GB
	  Network: 25 Gigabit
	  Price: pricing varies

config TERRAFORM_AWS_INSTANCE_R5_METAL
	bool "r5.metal"
	help
	  vCPUs: 96
	  Memory: 768.0 GB
	  Network: 25 Gigabit
	  Price: pricing varies

endchoice

config TERRAFORM_AWS_R5_SIZE
	string
	default "r5.large" if TERRAFORM_AWS_INSTANCE_R5_LARGE
	default "r5.xlarge" if TERRAFORM_AWS_INSTANCE_R5_XLARGE
	default "r5.2xlarge" if TERRAFORM_AWS_INSTANCE_R5_2XLARGE
	default "r5.4xlarge" if TERRAFORM_AWS_INSTANCE_R5_4XLARGE
	default "r5.8xlarge" if TERRAFORM_AWS_INSTANCE_R5_8XLARGE
	default "r5.12xlarge" if TERRAFORM_AWS_INSTANCE_R5_12XLARGE
	default "r5.16xlarge" if TERRAFORM_AWS_INSTANCE_R5_16XLARGE
	default "r5.24xlarge" if TERRAFORM_AWS_INSTANCE_R5_24XLARGE
	default "r5.metal" if TERRAFORM_AWS_INSTANCE_R5_METAL
	default "r5.large"
```

## terraform/aws/kconfigs/instance-types/Kconfig.r5a.static
```kconfig
# AWS R5A instance sizes (dynamically generated)

choice
	prompt "Instance size for R5A family"
	default TERRAFORM_AWS_INSTANCE_R5A_LARGE
	help
	  Select the specific instance size within the R5A family.

config TERRAFORM_AWS_INSTANCE_R5A_LARGE
	bool "r5a.large"
	help
	  vCPUs: 2
	  Memory: 16.0 GB
	  Network: Up to 10 Gigabit
	  Price: pricing varies

config TERRAFORM_AWS_INSTANCE_R5A_XLARGE
	bool "r5a.xlarge"
	help
	  vCPUs: 4
	  Memory: 32.0 GB
	  Network: Up to 10 Gigabit
	  Price: pricing varies

config TERRAFORM_AWS_INSTANCE_R5A_2XLARGE
	bool "r5a.2xlarge"
	help
	  vCPUs: 8
	  Memory: 64.0 GB
	  Network: Up to 10 Gigabit
	  Price: pricing varies

config TERRAFORM_AWS_INSTANCE_R5A_4XLARGE
	bool "r5a.4xlarge"
	help
	  vCPUs: 16
	  Memory: 128.0 GB
	  Network: Up to 10 Gigabit
	  Price: pricing varies

config TERRAFORM_AWS_INSTANCE_R5A_8XLARGE
	bool "r5a.8xlarge"
	help
	  vCPUs: 32
	  Memory: 256.0 GB
	  Network: Up to 10 Gigabit
	  Price: pricing varies

config TERRAFORM_AWS_INSTANCE_R5A_12XLARGE
	bool "r5a.12xlarge"
	help
	  vCPUs: 48
	  Memory: 384.0 GB
	  Network: 10 Gigabit
	  Price: pricing varies

config TERRAFORM_AWS_INSTANCE_R5A_16XLARGE
	bool "r5a.16xlarge"
	help
	  vCPUs: 64
	  Memory: 512.0 GB
	  Network: 12 Gigabit
	  Price: pricing varies

config TERRAFORM_AWS_INSTANCE_R5A_24XLARGE
	bool "r5a.24xlarge"
	help
	  vCPUs: 96
	  Memory: 768.0 GB
	  Network: 20 Gigabit
	  Price: pricing varies

endchoice

config TERRAFORM_AWS_R5A_SIZE
	string
	default "r5a.large" if TERRAFORM_AWS_INSTANCE_R5A_LARGE
	default "r5a.xlarge" if TERRAFORM_AWS_INSTANCE_R5A_XLARGE
	default "r5a.2xlarge" if TERRAFORM_AWS_INSTANCE_R5A_2XLARGE
	default "r5a.4xlarge" if TERRAFORM_AWS_INSTANCE_R5A_4XLARGE
	default "r5a.8xlarge" if TERRAFORM_AWS_INSTANCE_R5A_8XLARGE
	default "r5a.12xlarge" if TERRAFORM_AWS_INSTANCE_R5A_12XLARGE
	default "r5a.16xlarge" if TERRAFORM_AWS_INSTANCE_R5A_16XLARGE
	default "r5a.24xlarge" if TERRAFORM_AWS_INSTANCE_R5A_24XLARGE
	default "r5a.large"
```

## terraform/aws/kconfigs/instance-types/Kconfig.r5ad.static
```kconfig
# AWS R5AD instance sizes (dynamically generated)

choice
	prompt "Instance size for R5AD family"
	default TERRAFORM_AWS_INSTANCE_R5AD_LARGE
	help
	  Select the specific instance size within the R5AD family.

config TERRAFORM_AWS_INSTANCE_R5AD_LARGE
	bool "r5ad.large"
	help
	  vCPUs: 2
	  Memory: 16.0 GB
	  Network: Up to 10 Gigabit
	  Price: pricing varies
	  Instance storage: 75 GB

config TERRAFORM_AWS_INSTANCE_R5AD_XLARGE
	bool "r5ad.xlarge"
	help
	  vCPUs: 4
	  Memory: 32.0 GB
	  Network: Up to 10 Gigabit
	  Price: pricing varies
	  Instance storage: 150 GB

config TERRAFORM_AWS_INSTANCE_R5AD_2XLARGE
	bool "r5ad.2xlarge"
	help
	  vCPUs: 8
	  Memory: 64.0 GB
	  Network: Up to 10 Gigabit
	  Price: pricing varies
	  Instance storage: 300 GB

config TERRAFORM_AWS_INSTANCE_R5AD_4XLARGE
	bool "r5ad.4xlarge"
	help
	  vCPUs: 16
	  Memory: 128.0 GB
	  Network: Up to 10 Gigabit
	  Price: pricing varies
	  Instance storage: 600 GB

config TERRAFORM_AWS_INSTANCE_R5AD_8XLARGE
	bool "r5ad.8xlarge"
	help
	  vCPUs: 32
	  Memory: 256.0 GB
	  Network: Up to 10 Gigabit
	  Price: pricing varies
	  Instance storage: 1200 GB

config TERRAFORM_AWS_INSTANCE_R5AD_12XLARGE
	bool "r5ad.12xlarge"
	help
	  vCPUs: 48
	  Memory: 384.0 GB
	  Network: 10 Gigabit
	  Price: pricing varies
	  Instance storage: 1800 GB

config TERRAFORM_AWS_INSTANCE_R5AD_16XLARGE
	bool "r5ad.16xlarge"
	help
	  vCPUs: 64
	  Memory: 512.0 GB
	  Network: 12 Gigabit
	  Price: pricing varies
	  Instance storage: 2400 GB

config TERRAFORM_AWS_INSTANCE_R5AD_24XLARGE
	bool "r5ad.24xlarge"
	help
	  vCPUs: 96
	  Memory: 768.0 GB
	  Network: 20 Gigabit
	  Price: pricing varies
	  Instance storage: 3600 GB

endchoice

config TERRAFORM_AWS_R5AD_SIZE
	string
	default "r5ad.large" if TERRAFORM_AWS_INSTANCE_R5AD_LARGE
	default "r5ad.xlarge" if TERRAFORM_AWS_INSTANCE_R5AD_XLARGE
	default "r5ad.2xlarge" if TERRAFORM_AWS_INSTANCE_R5AD_2XLARGE
	default "r5ad.4xlarge" if TERRAFORM_AWS_INSTANCE_R5AD_4XLARGE
	default "r5ad.8xlarge" if TERRAFORM_AWS_INSTANCE_R5AD_8XLARGE
	default "r5ad.12xlarge" if TERRAFORM_AWS_INSTANCE_R5AD_12XLARGE
	default "r5ad.16xlarge" if TERRAFORM_AWS_INSTANCE_R5AD_16XLARGE
	default "r5ad.24xlarge" if TERRAFORM_AWS_INSTANCE_R5AD_24XLARGE
	default "r5ad.large"
```

## terraform/aws/kconfigs/instance-types/Kconfig.r5b.static
```kconfig
# AWS R5B instance sizes (dynamically generated)

choice
	prompt "Instance size for R5B family"
	default TERRAFORM_AWS_INSTANCE_R5B_LARGE
	help
	  Select the specific instance size within the R5B family.

config TERRAFORM_AWS_INSTANCE_R5B_LARGE
	bool "r5b.large"
	help
	  vCPUs: 2
	  Memory: 16.0 GB
	  Network: Up to 10 Gigabit
	  Price: pricing varies

config TERRAFORM_AWS_INSTANCE_R5B_XLARGE
	bool "r5b.xlarge"
	help
	  vCPUs: 4
	  Memory: 32.0 GB
	  Network: Up to 10 Gigabit
	  Price: pricing varies

config TERRAFORM_AWS_INSTANCE_R5B_2XLARGE
	bool "r5b.2xlarge"
	help
	  vCPUs: 8
	  Memory: 64.0 GB
	  Network: Up to 10 Gigabit
	  Price: pricing varies

config TERRAFORM_AWS_INSTANCE_R5B_4XLARGE
	bool "r5b.4xlarge"
	help
	  vCPUs: 16
	  Memory: 128.0 GB
	  Network: Up to 10 Gigabit
	  Price: pricing varies

config TERRAFORM_AWS_INSTANCE_R5B_8XLARGE
	bool "r5b.8xlarge"
	help
	  vCPUs: 32
	  Memory: 256.0 GB
	  Network: 10 Gigabit
	  Price: pricing varies

config TERRAFORM_AWS_INSTANCE_R5B_12XLARGE
	bool "r5b.12xlarge"
	help
	  vCPUs: 48
	  Memory: 384.0 GB
	  Network: 12 Gigabit
	  Price: pricing varies

config TERRAFORM_AWS_INSTANCE_R5B_16XLARGE
	bool "r5b.16xlarge"
	help
	  vCPUs: 64
	  Memory: 512.0 GB
	  Network: 20 Gigabit
	  Price: pricing varies

config TERRAFORM_AWS_INSTANCE_R5B_METAL
	bool "r5b.metal"
	help
	  vCPUs: 96
	  Memory: 768.0 GB
	  Network: 25 Gigabit
	  Price: pricing varies

config TERRAFORM_AWS_INSTANCE_R5B_24XLARGE
	bool "r5b.24xlarge"
	help
	  vCPUs: 96
	  Memory: 768.0 GB
	  Network: 25 Gigabit
	  Price: pricing varies

endchoice

config TERRAFORM_AWS_R5B_SIZE
	string
	default "r5b.large" if TERRAFORM_AWS_INSTANCE_R5B_LARGE
	default "r5b.xlarge" if TERRAFORM_AWS_INSTANCE_R5B_XLARGE
	default "r5b.2xlarge" if TERRAFORM_AWS_INSTANCE_R5B_2XLARGE
	default "r5b.4xlarge" if TERRAFORM_AWS_INSTANCE_R5B_4XLARGE
	default "r5b.8xlarge" if TERRAFORM_AWS_INSTANCE_R5B_8XLARGE
	default "r5b.12xlarge" if TERRAFORM_AWS_INSTANCE_R5B_12XLARGE
	default "r5b.16xlarge" if TERRAFORM_AWS_INSTANCE_R5B_16XLARGE
	default "r5b.metal" if TERRAFORM_AWS_INSTANCE_R5B_METAL
	default "r5b.24xlarge" if TERRAFORM_AWS_INSTANCE_R5B_24XLARGE
	default "r5b.large"
```

## terraform/aws/kconfigs/instance-types/Kconfig.r5d.static
```kconfig
# AWS R5D instance sizes (dynamically generated)

choice
	prompt "Instance size for R5D family"
	default TERRAFORM_AWS_INSTANCE_R5D_LARGE
	help
	  Select the specific instance size within the R5D family.

config TERRAFORM_AWS_INSTANCE_R5D_LARGE
	bool "r5d.large"
	help
	  vCPUs: 2
	  Memory: 16.0 GB
	  Network: Up to 10 Gigabit
	  Price: pricing varies
	  Instance storage: 75 GB

config TERRAFORM_AWS_INSTANCE_R5D_XLARGE
	bool "r5d.xlarge"
	help
	  vCPUs: 4
	  Memory: 32.0 GB
	  Network: Up to 10 Gigabit
	  Price: pricing varies
	  Instance storage: 150 GB

config TERRAFORM_AWS_INSTANCE_R5D_2XLARGE
	bool "r5d.2xlarge"
	help
	  vCPUs: 8
	  Memory: 64.0 GB
	  Network: Up to 10 Gigabit
	  Price: pricing varies
	  Instance storage: 300 GB

config TERRAFORM_AWS_INSTANCE_R5D_4XLARGE
	bool "r5d.4xlarge"
	help
	  vCPUs: 16
	  Memory: 128.0 GB
	  Network: Up to 10 Gigabit
	  Price: pricing varies
	  Instance storage: 600 GB

config TERRAFORM_AWS_INSTANCE_R5D_8XLARGE
	bool "r5d.8xlarge"
	help
	  vCPUs: 32
	  Memory: 256.0 GB
	  Network: 10 Gigabit
	  Price: pricing varies
	  Instance storage: 1200 GB

config TERRAFORM_AWS_INSTANCE_R5D_12XLARGE
	bool "r5d.12xlarge"
	help
	  vCPUs: 48
	  Memory: 384.0 GB
	  Network: 12 Gigabit
	  Price: pricing varies
	  Instance storage: 1800 GB

config TERRAFORM_AWS_INSTANCE_R5D_16XLARGE
	bool "r5d.16xlarge"
	help
	  vCPUs: 64
	  Memory: 512.0 GB
	  Network: 20 Gigabit
	  Price: pricing varies
	  Instance storage: 2400 GB

config TERRAFORM_AWS_INSTANCE_R5D_24XLARGE
	bool "r5d.24xlarge"
	help
	  vCPUs: 96
	  Memory: 768.0 GB
	  Network: 25 Gigabit
	  Price: pricing varies
	  Instance storage: 3600 GB

config TERRAFORM_AWS_INSTANCE_R5D_METAL
	bool "r5d.metal"
	help
	  vCPUs: 96
	  Memory: 768.0 GB
	  Network: 25 Gigabit
	  Price: pricing varies
	  Instance storage: 3600 GB

endchoice

config TERRAFORM_AWS_R5D_SIZE
	string
	default "r5d.large" if TERRAFORM_AWS_INSTANCE_R5D_LARGE
	default "r5d.xlarge" if TERRAFORM_AWS_INSTANCE_R5D_XLARGE
	default "r5d.2xlarge" if TERRAFORM_AWS_INSTANCE_R5D_2XLARGE
	default "r5d.4xlarge" if TERRAFORM_AWS_INSTANCE_R5D_4XLARGE
	default "r5d.8xlarge" if TERRAFORM_AWS_INSTANCE_R5D_8XLARGE
	default "r5d.12xlarge" if TERRAFORM_AWS_INSTANCE_R5D_12XLARGE
	default "r5d.16xlarge" if TERRAFORM_AWS_INSTANCE_R5D_16XLARGE
	default "r5d.24xlarge" if TERRAFORM_AWS_INSTANCE_R5D_24XLARGE
	default "r5d.metal" if TERRAFORM_AWS_INSTANCE_R5D_METAL
	default "r5d.large"
```

## terraform/aws/kconfigs/instance-types/Kconfig.r5dn.static
```kconfig
# AWS R5DN instance sizes (dynamically generated)

choice
	prompt "Instance size for R5DN family"
	default TERRAFORM_AWS_INSTANCE_R5DN_LARGE
	help
	  Select the specific instance size within the R5DN family.

config TERRAFORM_AWS_INSTANCE_R5DN_LARGE
	bool "r5dn.large"
	help
	  vCPUs: 2
	  Memory: 16.0 GB
	  Network: Up to 25 Gigabit
	  Price: pricing varies
	  Instance storage: 75 GB

config TERRAFORM_AWS_INSTANCE_R5DN_XLARGE
	bool "r5dn.xlarge"
	help
	  vCPUs: 4
	  Memory: 32.0 GB
	  Network: Up to 25 Gigabit
	  Price: pricing varies
	  Instance storage: 150 GB

config TERRAFORM_AWS_INSTANCE_R5DN_2XLARGE
	bool "r5dn.2xlarge"
	help
	  vCPUs: 8
	  Memory: 64.0 GB
	  Network: Up to 25 Gigabit
	  Price: pricing varies
	  Instance storage: 300 GB

config TERRAFORM_AWS_INSTANCE_R5DN_4XLARGE
	bool "r5dn.4xlarge"
	help
	  vCPUs: 16
	  Memory: 128.0 GB
	  Network: Up to 25 Gigabit
	  Price: pricing varies
	  Instance storage: 600 GB

config TERRAFORM_AWS_INSTANCE_R5DN_8XLARGE
	bool "r5dn.8xlarge"
	help
	  vCPUs: 32
	  Memory: 256.0 GB
	  Network: 25 Gigabit
	  Price: pricing varies
	  Instance storage: 1200 GB

config TERRAFORM_AWS_INSTANCE_R5DN_12XLARGE
	bool "r5dn.12xlarge"
	help
	  vCPUs: 48
	  Memory: 384.0 GB
	  Network: 50 Gigabit
	  Price: pricing varies
	  Instance storage: 1800 GB

config TERRAFORM_AWS_INSTANCE_R5DN_16XLARGE
	bool "r5dn.16xlarge"
	help
	  vCPUs: 64
	  Memory: 512.0 GB
	  Network: 75 Gigabit
	  Price: pricing varies
	  Instance storage: 2400 GB

config TERRAFORM_AWS_INSTANCE_R5DN_METAL
	bool "r5dn.metal"
	help
	  vCPUs: 96
	  Memory: 768.0 GB
	  Network: 100 Gigabit
	  Price: pricing varies
	  Instance storage: 3600 GB

config TERRAFORM_AWS_INSTANCE_R5DN_24XLARGE
	bool "r5dn.24xlarge"
	help
	  vCPUs: 96
	  Memory: 768.0 GB
	  Network: 100 Gigabit
	  Price: pricing varies
	  Instance storage: 3600 GB

endchoice

config TERRAFORM_AWS_R5DN_SIZE
	string
	default "r5dn.large" if TERRAFORM_AWS_INSTANCE_R5DN_LARGE
	default "r5dn.xlarge" if TERRAFORM_AWS_INSTANCE_R5DN_XLARGE
	default "r5dn.2xlarge" if TERRAFORM_AWS_INSTANCE_R5DN_2XLARGE
	default "r5dn.4xlarge" if TERRAFORM_AWS_INSTANCE_R5DN_4XLARGE
	default "r5dn.8xlarge" if TERRAFORM_AWS_INSTANCE_R5DN_8XLARGE
	default "r5dn.12xlarge" if TERRAFORM_AWS_INSTANCE_R5DN_12XLARGE
	default "r5dn.16xlarge" if TERRAFORM_AWS_INSTANCE_R5DN_16XLARGE
	default "r5dn.metal" if TERRAFORM_AWS_INSTANCE_R5DN_METAL
	default "r5dn.24xlarge" if TERRAFORM_AWS_INSTANCE_R5DN_24XLARGE
	default "r5dn.large"
```
