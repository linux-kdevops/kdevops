## terraform/aws/kconfigs/instance-types/Kconfig.r8gd.static
```kconfig
# AWS R8GD instance sizes (dynamically generated)

choice
	prompt "Instance size for R8GD family"
	default TERRAFORM_AWS_INSTANCE_R8GD_MEDIUM
	help
	  Select the specific instance size within the R8GD family.

config TERRAFORM_AWS_INSTANCE_R8GD_MEDIUM
	bool "r8gd.medium"
	help
	  vCPUs: 1
	  Memory: 8.0 GB
	  Network: Up to 12.5 Gigabit
	  Price: pricing varies
	  Instance storage: 59 GB

config TERRAFORM_AWS_INSTANCE_R8GD_LARGE
	bool "r8gd.large"
	help
	  vCPUs: 2
	  Memory: 16.0 GB
	  Network: Up to 12.5 Gigabit
	  Price: pricing varies
	  Instance storage: 118 GB

config TERRAFORM_AWS_INSTANCE_R8GD_XLARGE
	bool "r8gd.xlarge"
	help
	  vCPUs: 4
	  Memory: 32.0 GB
	  Network: Up to 12.5 Gigabit
	  Price: pricing varies
	  Instance storage: 237 GB

config TERRAFORM_AWS_INSTANCE_R8GD_2XLARGE
	bool "r8gd.2xlarge"
	help
	  vCPUs: 8
	  Memory: 64.0 GB
	  Network: Up to 15 Gigabit
	  Price: pricing varies
	  Instance storage: 474 GB

config TERRAFORM_AWS_INSTANCE_R8GD_4XLARGE
	bool "r8gd.4xlarge"
	help
	  vCPUs: 16
	  Memory: 128.0 GB
	  Network: Up to 15 Gigabit
	  Price: pricing varies
	  Instance storage: 950 GB

config TERRAFORM_AWS_INSTANCE_R8GD_8XLARGE
	bool "r8gd.8xlarge"
	help
	  vCPUs: 32
	  Memory: 256.0 GB
	  Network: 15 Gigabit
	  Price: pricing varies
	  Instance storage: 1900 GB

config TERRAFORM_AWS_INSTANCE_R8GD_12XLARGE
	bool "r8gd.12xlarge"
	help
	  vCPUs: 48
	  Memory: 384.0 GB
	  Network: 22.5 Gigabit
	  Price: pricing varies
	  Instance storage: 2850 GB

config TERRAFORM_AWS_INSTANCE_R8GD_16XLARGE
	bool "r8gd.16xlarge"
	help
	  vCPUs: 64
	  Memory: 512.0 GB
	  Network: 30 Gigabit
	  Price: pricing varies
	  Instance storage: 3800 GB

config TERRAFORM_AWS_INSTANCE_R8GD_24XLARGE
	bool "r8gd.24xlarge"
	help
	  vCPUs: 96
	  Memory: 768.0 GB
	  Network: 40 Gigabit
	  Price: pricing varies
	  Instance storage: 5700 GB

config TERRAFORM_AWS_INSTANCE_R8GD_METAL_24XL
	bool "r8gd.metal-24xl"
	help
	  vCPUs: 96
	  Memory: 768.0 GB
	  Network: 40 Gigabit
	  Price: pricing varies
	  Instance storage: 5700 GB

config TERRAFORM_AWS_INSTANCE_R8GD_METAL_48XL
	bool "r8gd.metal-48xl"
	help
	  vCPUs: 192
	  Memory: 1536.0 GB
	  Network: 50 Gigabit
	  Price: pricing varies
	  Instance storage: 11400 GB

config TERRAFORM_AWS_INSTANCE_R8GD_48XLARGE
	bool "r8gd.48xlarge"
	help
	  vCPUs: 192
	  Memory: 1536.0 GB
	  Network: 50 Gigabit
	  Price: pricing varies
	  Instance storage: 11400 GB

endchoice

config TERRAFORM_AWS_R8GD_SIZE
	string
	default "r8gd.medium" if TERRAFORM_AWS_INSTANCE_R8GD_MEDIUM
	default "r8gd.large" if TERRAFORM_AWS_INSTANCE_R8GD_LARGE
	default "r8gd.xlarge" if TERRAFORM_AWS_INSTANCE_R8GD_XLARGE
	default "r8gd.2xlarge" if TERRAFORM_AWS_INSTANCE_R8GD_2XLARGE
	default "r8gd.4xlarge" if TERRAFORM_AWS_INSTANCE_R8GD_4XLARGE
	default "r8gd.8xlarge" if TERRAFORM_AWS_INSTANCE_R8GD_8XLARGE
	default "r8gd.12xlarge" if TERRAFORM_AWS_INSTANCE_R8GD_12XLARGE
	default "r8gd.16xlarge" if TERRAFORM_AWS_INSTANCE_R8GD_16XLARGE
	default "r8gd.24xlarge" if TERRAFORM_AWS_INSTANCE_R8GD_24XLARGE
	default "r8gd.metal-24xl" if TERRAFORM_AWS_INSTANCE_R8GD_METAL_24XL
	default "r8gd.metal-48xl" if TERRAFORM_AWS_INSTANCE_R8GD_METAL_48XL
	default "r8gd.48xlarge" if TERRAFORM_AWS_INSTANCE_R8GD_48XLARGE
	default "r8gd.medium"
```

## terraform/aws/kconfigs/instance-types/Kconfig.r8i-flex.static
```kconfig
# AWS R8I-FLEX instance sizes (dynamically generated)

choice
	prompt "Instance size for R8I-FLEX family"
	default TERRAFORM_AWS_INSTANCE_R8I_FLEX_LARGE
	help
	  Select the specific instance size within the R8I-FLEX family.

config TERRAFORM_AWS_INSTANCE_R8I_FLEX_LARGE
	bool "r8i-flex.large"
	help
	  vCPUs: 2
	  Memory: 16.0 GB
	  Network: Up to 12.5 Gigabit
	  Price: pricing varies

config TERRAFORM_AWS_INSTANCE_R8I_FLEX_XLARGE
	bool "r8i-flex.xlarge"
	help
	  vCPUs: 4
	  Memory: 32.0 GB
	  Network: Up to 12.5 Gigabit
	  Price: pricing varies

config TERRAFORM_AWS_INSTANCE_R8I_FLEX_2XLARGE
	bool "r8i-flex.2xlarge"
	help
	  vCPUs: 8
	  Memory: 64.0 GB
	  Network: Up to 15 Gigabit
	  Price: pricing varies

config TERRAFORM_AWS_INSTANCE_R8I_FLEX_4XLARGE
	bool "r8i-flex.4xlarge"
	help
	  vCPUs: 16
	  Memory: 128.0 GB
	  Network: Up to 15 Gigabit
	  Price: pricing varies

config TERRAFORM_AWS_INSTANCE_R8I_FLEX_8XLARGE
	bool "r8i-flex.8xlarge"
	help
	  vCPUs: 32
	  Memory: 256.0 GB
	  Network: Up to 15 Gigabit
	  Price: pricing varies

config TERRAFORM_AWS_INSTANCE_R8I_FLEX_12XLARGE
	bool "r8i-flex.12xlarge"
	help
	  vCPUs: 48
	  Memory: 384.0 GB
	  Network: Up to 22.5 Gigabit
	  Price: pricing varies

config TERRAFORM_AWS_INSTANCE_R8I_FLEX_16XLARGE
	bool "r8i-flex.16xlarge"
	help
	  vCPUs: 64
	  Memory: 512.0 GB
	  Network: Up to 30 Gigabit
	  Price: pricing varies

endchoice

config TERRAFORM_AWS_R8I_FLEX_SIZE
	string
	default "r8i-flex.large" if TERRAFORM_AWS_INSTANCE_R8I_FLEX_LARGE
	default "r8i-flex.xlarge" if TERRAFORM_AWS_INSTANCE_R8I_FLEX_XLARGE
	default "r8i-flex.2xlarge" if TERRAFORM_AWS_INSTANCE_R8I_FLEX_2XLARGE
	default "r8i-flex.4xlarge" if TERRAFORM_AWS_INSTANCE_R8I_FLEX_4XLARGE
	default "r8i-flex.8xlarge" if TERRAFORM_AWS_INSTANCE_R8I_FLEX_8XLARGE
	default "r8i-flex.12xlarge" if TERRAFORM_AWS_INSTANCE_R8I_FLEX_12XLARGE
	default "r8i-flex.16xlarge" if TERRAFORM_AWS_INSTANCE_R8I_FLEX_16XLARGE
	default "r8i-flex.large"
```

## terraform/aws/kconfigs/instance-types/Kconfig.r8i.static
```kconfig
# AWS R8I instance sizes (dynamically generated)

choice
	prompt "Instance size for R8I family"
	default TERRAFORM_AWS_INSTANCE_R8I_LARGE
	help
	  Select the specific instance size within the R8I family.

config TERRAFORM_AWS_INSTANCE_R8I_LARGE
	bool "r8i.large"
	help
	  vCPUs: 2
	  Memory: 16.0 GB
	  Network: Up to 12.5 Gigabit
	  Price: pricing varies

config TERRAFORM_AWS_INSTANCE_R8I_XLARGE
	bool "r8i.xlarge"
	help
	  vCPUs: 4
	  Memory: 32.0 GB
	  Network: Up to 12.5 Gigabit
	  Price: pricing varies

config TERRAFORM_AWS_INSTANCE_R8I_2XLARGE
	bool "r8i.2xlarge"
	help
	  vCPUs: 8
	  Memory: 64.0 GB
	  Network: Up to 15 Gigabit
	  Price: pricing varies

config TERRAFORM_AWS_INSTANCE_R8I_4XLARGE
	bool "r8i.4xlarge"
	help
	  vCPUs: 16
	  Memory: 128.0 GB
	  Network: Up to 15 Gigabit
	  Price: pricing varies

config TERRAFORM_AWS_INSTANCE_R8I_8XLARGE
	bool "r8i.8xlarge"
	help
	  vCPUs: 32
	  Memory: 256.0 GB
	  Network: 15 Gigabit
	  Price: pricing varies

config TERRAFORM_AWS_INSTANCE_R8I_12XLARGE
	bool "r8i.12xlarge"
	help
	  vCPUs: 48
	  Memory: 384.0 GB
	  Network: 22.5 Gigabit
	  Price: pricing varies

config TERRAFORM_AWS_INSTANCE_R8I_16XLARGE
	bool "r8i.16xlarge"
	help
	  vCPUs: 64
	  Memory: 512.0 GB
	  Network: 30 Gigabit
	  Price: pricing varies

config TERRAFORM_AWS_INSTANCE_R8I_24XLARGE
	bool "r8i.24xlarge"
	help
	  vCPUs: 96
	  Memory: 768.0 GB
	  Network: 40 Gigabit
	  Price: pricing varies

config TERRAFORM_AWS_INSTANCE_R8I_32XLARGE
	bool "r8i.32xlarge"
	help
	  vCPUs: 128
	  Memory: 1024.0 GB
	  Network: 50 Gigabit
	  Price: pricing varies

config TERRAFORM_AWS_INSTANCE_R8I_48XLARGE
	bool "r8i.48xlarge"
	help
	  vCPUs: 192
	  Memory: 1536.0 GB
	  Network: 75 Gigabit
	  Price: pricing varies

config TERRAFORM_AWS_INSTANCE_R8I_METAL_48XL
	bool "r8i.metal-48xl"
	help
	  vCPUs: 192
	  Memory: 1536.0 GB
	  Network: 75 Gigabit
	  Price: pricing varies

config TERRAFORM_AWS_INSTANCE_R8I_96XLARGE
	bool "r8i.96xlarge"
	help
	  vCPUs: 384
	  Memory: 3072.0 GB
	  Network: 100 Gigabit
	  Price: pricing varies

config TERRAFORM_AWS_INSTANCE_R8I_METAL_96XL
	bool "r8i.metal-96xl"
	help
	  vCPUs: 384
	  Memory: 3072.0 GB
	  Network: 100 Gigabit
	  Price: pricing varies

endchoice

config TERRAFORM_AWS_R8I_SIZE
	string
	default "r8i.large" if TERRAFORM_AWS_INSTANCE_R8I_LARGE
	default "r8i.xlarge" if TERRAFORM_AWS_INSTANCE_R8I_XLARGE
	default "r8i.2xlarge" if TERRAFORM_AWS_INSTANCE_R8I_2XLARGE
	default "r8i.4xlarge" if TERRAFORM_AWS_INSTANCE_R8I_4XLARGE
	default "r8i.8xlarge" if TERRAFORM_AWS_INSTANCE_R8I_8XLARGE
	default "r8i.12xlarge" if TERRAFORM_AWS_INSTANCE_R8I_12XLARGE
	default "r8i.16xlarge" if TERRAFORM_AWS_INSTANCE_R8I_16XLARGE
	default "r8i.24xlarge" if TERRAFORM_AWS_INSTANCE_R8I_24XLARGE
	default "r8i.32xlarge" if TERRAFORM_AWS_INSTANCE_R8I_32XLARGE
	default "r8i.48xlarge" if TERRAFORM_AWS_INSTANCE_R8I_48XLARGE
	default "r8i.metal-48xl" if TERRAFORM_AWS_INSTANCE_R8I_METAL_48XL
	default "r8i.96xlarge" if TERRAFORM_AWS_INSTANCE_R8I_96XLARGE
	default "r8i.metal-96xl" if TERRAFORM_AWS_INSTANCE_R8I_METAL_96XL
	default "r8i.large"
```

## terraform/aws/kconfigs/instance-types/Kconfig.t1.static
```kconfig
# AWS T1 instance sizes (dynamically generated)

choice
	prompt "Instance size for T1 family"
	default TERRAFORM_AWS_INSTANCE_T1_MICRO
	help
	  Select the specific instance size within the T1 family.

config TERRAFORM_AWS_INSTANCE_T1_MICRO
	bool "t1.micro"
	help
	  vCPUs: 1
	  Memory: 0.6 GB
	  Network: Very Low
	  Price: pricing varies

endchoice

config TERRAFORM_AWS_T1_SIZE
	string
	default "t1.micro" if TERRAFORM_AWS_INSTANCE_T1_MICRO
	default "t1.micro"
```

## terraform/aws/kconfigs/instance-types/Kconfig.t2.static
```kconfig
# AWS T2 instance sizes (dynamically generated)

choice
	prompt "Instance size for T2 family"
	default TERRAFORM_AWS_INSTANCE_T2_NANO
	help
	  Select the specific instance size within the T2 family.

config TERRAFORM_AWS_INSTANCE_T2_NANO
	bool "t2.nano"
	help
	  vCPUs: 1
	  Memory: 0.5 GB
	  Network: Low to Moderate
	  Price: pricing varies

config TERRAFORM_AWS_INSTANCE_T2_MICRO
	bool "t2.micro"
	help
	  vCPUs: 1
	  Memory: 1.0 GB
	  Network: Low to Moderate
	  Price: pricing varies

config TERRAFORM_AWS_INSTANCE_T2_SMALL
	bool "t2.small"
	help
	  vCPUs: 1
	  Memory: 2.0 GB
	  Network: Low to Moderate
	  Price: pricing varies

config TERRAFORM_AWS_INSTANCE_T2_MEDIUM
	bool "t2.medium"
	help
	  vCPUs: 2
	  Memory: 4.0 GB
	  Network: Low to Moderate
	  Price: pricing varies

config TERRAFORM_AWS_INSTANCE_T2_LARGE
	bool "t2.large"
	help
	  vCPUs: 2
	  Memory: 8.0 GB
	  Network: Low to Moderate
	  Price: pricing varies

config TERRAFORM_AWS_INSTANCE_T2_XLARGE
	bool "t2.xlarge"
	help
	  vCPUs: 4
	  Memory: 16.0 GB
	  Network: Moderate
	  Price: pricing varies

config TERRAFORM_AWS_INSTANCE_T2_2XLARGE
	bool "t2.2xlarge"
	help
	  vCPUs: 8
	  Memory: 32.0 GB
	  Network: Moderate
	  Price: pricing varies

endchoice

config TERRAFORM_AWS_T2_SIZE
	string
	default "t2.nano" if TERRAFORM_AWS_INSTANCE_T2_NANO
	default "t2.micro" if TERRAFORM_AWS_INSTANCE_T2_MICRO
	default "t2.small" if TERRAFORM_AWS_INSTANCE_T2_SMALL
	default "t2.medium" if TERRAFORM_AWS_INSTANCE_T2_MEDIUM
	default "t2.large" if TERRAFORM_AWS_INSTANCE_T2_LARGE
	default "t2.xlarge" if TERRAFORM_AWS_INSTANCE_T2_XLARGE
	default "t2.2xlarge" if TERRAFORM_AWS_INSTANCE_T2_2XLARGE
	default "t2.nano"
```

## terraform/aws/kconfigs/instance-types/Kconfig.t3.static
```kconfig
# AWS T3 instance sizes (dynamically generated)

choice
	prompt "Instance size for T3 family"
	default TERRAFORM_AWS_INSTANCE_T3_NANO
	help
	  Select the specific instance size within the T3 family.

config TERRAFORM_AWS_INSTANCE_T3_NANO
	bool "t3.nano"
	help
	  vCPUs: 2
	  Memory: 0.5 GB
	  Network: Up to 5 Gigabit
	  Price: $0.005/hour

config TERRAFORM_AWS_INSTANCE_T3_MICRO
	bool "t3.micro"
	help
	  vCPUs: 2
	  Memory: 1.0 GB
	  Network: Up to 5 Gigabit
	  Price: $0.010/hour

config TERRAFORM_AWS_INSTANCE_T3_SMALL
	bool "t3.small"
	help
	  vCPUs: 2
	  Memory: 2.0 GB
	  Network: Up to 5 Gigabit
	  Price: $0.021/hour

config TERRAFORM_AWS_INSTANCE_T3_MEDIUM
	bool "t3.medium"
	help
	  vCPUs: 2
	  Memory: 4.0 GB
	  Network: Up to 5 Gigabit
	  Price: $0.042/hour

config TERRAFORM_AWS_INSTANCE_T3_LARGE
	bool "t3.large"
	help
	  vCPUs: 2
	  Memory: 8.0 GB
	  Network: Up to 5 Gigabit
	  Price: $0.083/hour

config TERRAFORM_AWS_INSTANCE_T3_XLARGE
	bool "t3.xlarge"
	help
	  vCPUs: 4
	  Memory: 16.0 GB
	  Network: Up to 5 Gigabit
	  Price: $0.166/hour

config TERRAFORM_AWS_INSTANCE_T3_2XLARGE
	bool "t3.2xlarge"
	help
	  vCPUs: 8
	  Memory: 32.0 GB
	  Network: Up to 5 Gigabit
	  Price: $0.333/hour

endchoice

config TERRAFORM_AWS_T3_SIZE
	string
	default "t3.nano" if TERRAFORM_AWS_INSTANCE_T3_NANO
	default "t3.micro" if TERRAFORM_AWS_INSTANCE_T3_MICRO
	default "t3.small" if TERRAFORM_AWS_INSTANCE_T3_SMALL
	default "t3.medium" if TERRAFORM_AWS_INSTANCE_T3_MEDIUM
	default "t3.large" if TERRAFORM_AWS_INSTANCE_T3_LARGE
	default "t3.xlarge" if TERRAFORM_AWS_INSTANCE_T3_XLARGE
	default "t3.2xlarge" if TERRAFORM_AWS_INSTANCE_T3_2XLARGE
	default "t3.nano"
```
