## terraform/aws/kconfigs/instance-types/Kconfig.r6in.static
```kconfig
# AWS R6IN instance sizes (dynamically generated)

choice
	prompt "Instance size for R6IN family"
	default TERRAFORM_AWS_INSTANCE_R6IN_LARGE
	help
	  Select the specific instance size within the R6IN family.

config TERRAFORM_AWS_INSTANCE_R6IN_LARGE
	bool "r6in.large"
	help
	  vCPUs: 2
	  Memory: 16.0 GB
	  Network: Up to 25 Gigabit
	  Price: pricing varies

config TERRAFORM_AWS_INSTANCE_R6IN_XLARGE
	bool "r6in.xlarge"
	help
	  vCPUs: 4
	  Memory: 32.0 GB
	  Network: Up to 30 Gigabit
	  Price: pricing varies

config TERRAFORM_AWS_INSTANCE_R6IN_2XLARGE
	bool "r6in.2xlarge"
	help
	  vCPUs: 8
	  Memory: 64.0 GB
	  Network: Up to 40 Gigabit
	  Price: pricing varies

config TERRAFORM_AWS_INSTANCE_R6IN_4XLARGE
	bool "r6in.4xlarge"
	help
	  vCPUs: 16
	  Memory: 128.0 GB
	  Network: Up to 50 Gigabit
	  Price: pricing varies

config TERRAFORM_AWS_INSTANCE_R6IN_8XLARGE
	bool "r6in.8xlarge"
	help
	  vCPUs: 32
	  Memory: 256.0 GB
	  Network: 50 Gigabit
	  Price: pricing varies

config TERRAFORM_AWS_INSTANCE_R6IN_12XLARGE
	bool "r6in.12xlarge"
	help
	  vCPUs: 48
	  Memory: 384.0 GB
	  Network: 75 Gigabit
	  Price: pricing varies

config TERRAFORM_AWS_INSTANCE_R6IN_16XLARGE
	bool "r6in.16xlarge"
	help
	  vCPUs: 64
	  Memory: 512.0 GB
	  Network: 100 Gigabit
	  Price: pricing varies

config TERRAFORM_AWS_INSTANCE_R6IN_24XLARGE
	bool "r6in.24xlarge"
	help
	  vCPUs: 96
	  Memory: 768.0 GB
	  Network: 150 Gigabit
	  Price: pricing varies

config TERRAFORM_AWS_INSTANCE_R6IN_METAL
	bool "r6in.metal"
	help
	  vCPUs: 128
	  Memory: 1024.0 GB
	  Network: 200 Gigabit
	  Price: pricing varies

config TERRAFORM_AWS_INSTANCE_R6IN_32XLARGE
	bool "r6in.32xlarge"
	help
	  vCPUs: 128
	  Memory: 1024.0 GB
	  Network: 200 Gigabit
	  Price: pricing varies

endchoice

config TERRAFORM_AWS_R6IN_SIZE
	string
	default "r6in.large" if TERRAFORM_AWS_INSTANCE_R6IN_LARGE
	default "r6in.xlarge" if TERRAFORM_AWS_INSTANCE_R6IN_XLARGE
	default "r6in.2xlarge" if TERRAFORM_AWS_INSTANCE_R6IN_2XLARGE
	default "r6in.4xlarge" if TERRAFORM_AWS_INSTANCE_R6IN_4XLARGE
	default "r6in.8xlarge" if TERRAFORM_AWS_INSTANCE_R6IN_8XLARGE
	default "r6in.12xlarge" if TERRAFORM_AWS_INSTANCE_R6IN_12XLARGE
	default "r6in.16xlarge" if TERRAFORM_AWS_INSTANCE_R6IN_16XLARGE
	default "r6in.24xlarge" if TERRAFORM_AWS_INSTANCE_R6IN_24XLARGE
	default "r6in.metal" if TERRAFORM_AWS_INSTANCE_R6IN_METAL
	default "r6in.32xlarge" if TERRAFORM_AWS_INSTANCE_R6IN_32XLARGE
	default "r6in.large"
```

## terraform/aws/kconfigs/instance-types/Kconfig.r7a.static
```kconfig
# AWS R7A instance sizes (dynamically generated)

choice
	prompt "Instance size for R7A family"
	default TERRAFORM_AWS_INSTANCE_R7A_MEDIUM
	help
	  Select the specific instance size within the R7A family.

config TERRAFORM_AWS_INSTANCE_R7A_MEDIUM
	bool "r7a.medium"
	help
	  vCPUs: 1
	  Memory: 8.0 GB
	  Network: Up to 12.5 Gigabit
	  Price: pricing varies

config TERRAFORM_AWS_INSTANCE_R7A_LARGE
	bool "r7a.large"
	help
	  vCPUs: 2
	  Memory: 16.0 GB
	  Network: Up to 12.5 Gigabit
	  Price: pricing varies

config TERRAFORM_AWS_INSTANCE_R7A_XLARGE
	bool "r7a.xlarge"
	help
	  vCPUs: 4
	  Memory: 32.0 GB
	  Network: Up to 12.5 Gigabit
	  Price: pricing varies

config TERRAFORM_AWS_INSTANCE_R7A_2XLARGE
	bool "r7a.2xlarge"
	help
	  vCPUs: 8
	  Memory: 64.0 GB
	  Network: Up to 12.5 Gigabit
	  Price: pricing varies

config TERRAFORM_AWS_INSTANCE_R7A_4XLARGE
	bool "r7a.4xlarge"
	help
	  vCPUs: 16
	  Memory: 128.0 GB
	  Network: Up to 12.5 Gigabit
	  Price: pricing varies

config TERRAFORM_AWS_INSTANCE_R7A_8XLARGE
	bool "r7a.8xlarge"
	help
	  vCPUs: 32
	  Memory: 256.0 GB
	  Network: 12.5 Gigabit
	  Price: pricing varies

config TERRAFORM_AWS_INSTANCE_R7A_12XLARGE
	bool "r7a.12xlarge"
	help
	  vCPUs: 48
	  Memory: 384.0 GB
	  Network: 18.75 Gigabit
	  Price: pricing varies

config TERRAFORM_AWS_INSTANCE_R7A_16XLARGE
	bool "r7a.16xlarge"
	help
	  vCPUs: 64
	  Memory: 512.0 GB
	  Network: 25 Gigabit
	  Price: pricing varies

config TERRAFORM_AWS_INSTANCE_R7A_24XLARGE
	bool "r7a.24xlarge"
	help
	  vCPUs: 96
	  Memory: 768.0 GB
	  Network: 37.5 Gigabit
	  Price: pricing varies

config TERRAFORM_AWS_INSTANCE_R7A_32XLARGE
	bool "r7a.32xlarge"
	help
	  vCPUs: 128
	  Memory: 1024.0 GB
	  Network: 50 Gigabit
	  Price: pricing varies

config TERRAFORM_AWS_INSTANCE_R7A_METAL_48XL
	bool "r7a.metal-48xl"
	help
	  vCPUs: 192
	  Memory: 1536.0 GB
	  Network: 50 Gigabit
	  Price: pricing varies

config TERRAFORM_AWS_INSTANCE_R7A_48XLARGE
	bool "r7a.48xlarge"
	help
	  vCPUs: 192
	  Memory: 1536.0 GB
	  Network: 50 Gigabit
	  Price: pricing varies

endchoice

config TERRAFORM_AWS_R7A_SIZE
	string
	default "r7a.medium" if TERRAFORM_AWS_INSTANCE_R7A_MEDIUM
	default "r7a.large" if TERRAFORM_AWS_INSTANCE_R7A_LARGE
	default "r7a.xlarge" if TERRAFORM_AWS_INSTANCE_R7A_XLARGE
	default "r7a.2xlarge" if TERRAFORM_AWS_INSTANCE_R7A_2XLARGE
	default "r7a.4xlarge" if TERRAFORM_AWS_INSTANCE_R7A_4XLARGE
	default "r7a.8xlarge" if TERRAFORM_AWS_INSTANCE_R7A_8XLARGE
	default "r7a.12xlarge" if TERRAFORM_AWS_INSTANCE_R7A_12XLARGE
	default "r7a.16xlarge" if TERRAFORM_AWS_INSTANCE_R7A_16XLARGE
	default "r7a.24xlarge" if TERRAFORM_AWS_INSTANCE_R7A_24XLARGE
	default "r7a.32xlarge" if TERRAFORM_AWS_INSTANCE_R7A_32XLARGE
	default "r7a.metal-48xl" if TERRAFORM_AWS_INSTANCE_R7A_METAL_48XL
	default "r7a.48xlarge" if TERRAFORM_AWS_INSTANCE_R7A_48XLARGE
	default "r7a.medium"
```

## terraform/aws/kconfigs/instance-types/Kconfig.r7g.static
```kconfig
# AWS R7G instance sizes (dynamically generated)

choice
	prompt "Instance size for R7G family"
	default TERRAFORM_AWS_INSTANCE_R7G_MEDIUM
	help
	  Select the specific instance size within the R7G family.

config TERRAFORM_AWS_INSTANCE_R7G_MEDIUM
	bool "r7g.medium"
	help
	  vCPUs: 1
	  Memory: 8.0 GB
	  Network: Up to 12.5 Gigabit
	  Price: pricing varies

config TERRAFORM_AWS_INSTANCE_R7G_LARGE
	bool "r7g.large"
	help
	  vCPUs: 2
	  Memory: 16.0 GB
	  Network: Up to 12.5 Gigabit
	  Price: pricing varies

config TERRAFORM_AWS_INSTANCE_R7G_XLARGE
	bool "r7g.xlarge"
	help
	  vCPUs: 4
	  Memory: 32.0 GB
	  Network: Up to 12.5 Gigabit
	  Price: pricing varies

config TERRAFORM_AWS_INSTANCE_R7G_2XLARGE
	bool "r7g.2xlarge"
	help
	  vCPUs: 8
	  Memory: 64.0 GB
	  Network: Up to 15 Gigabit
	  Price: pricing varies

config TERRAFORM_AWS_INSTANCE_R7G_4XLARGE
	bool "r7g.4xlarge"
	help
	  vCPUs: 16
	  Memory: 128.0 GB
	  Network: Up to 15 Gigabit
	  Price: pricing varies

config TERRAFORM_AWS_INSTANCE_R7G_8XLARGE
	bool "r7g.8xlarge"
	help
	  vCPUs: 32
	  Memory: 256.0 GB
	  Network: 15 Gigabit
	  Price: pricing varies

config TERRAFORM_AWS_INSTANCE_R7G_12XLARGE
	bool "r7g.12xlarge"
	help
	  vCPUs: 48
	  Memory: 384.0 GB
	  Network: 22.5 Gigabit
	  Price: pricing varies

config TERRAFORM_AWS_INSTANCE_R7G_METAL
	bool "r7g.metal"
	help
	  vCPUs: 64
	  Memory: 512.0 GB
	  Network: 30 Gigabit
	  Price: pricing varies

config TERRAFORM_AWS_INSTANCE_R7G_16XLARGE
	bool "r7g.16xlarge"
	help
	  vCPUs: 64
	  Memory: 512.0 GB
	  Network: 30 Gigabit
	  Price: pricing varies

endchoice

config TERRAFORM_AWS_R7G_SIZE
	string
	default "r7g.medium" if TERRAFORM_AWS_INSTANCE_R7G_MEDIUM
	default "r7g.large" if TERRAFORM_AWS_INSTANCE_R7G_LARGE
	default "r7g.xlarge" if TERRAFORM_AWS_INSTANCE_R7G_XLARGE
	default "r7g.2xlarge" if TERRAFORM_AWS_INSTANCE_R7G_2XLARGE
	default "r7g.4xlarge" if TERRAFORM_AWS_INSTANCE_R7G_4XLARGE
	default "r7g.8xlarge" if TERRAFORM_AWS_INSTANCE_R7G_8XLARGE
	default "r7g.12xlarge" if TERRAFORM_AWS_INSTANCE_R7G_12XLARGE
	default "r7g.metal" if TERRAFORM_AWS_INSTANCE_R7G_METAL
	default "r7g.16xlarge" if TERRAFORM_AWS_INSTANCE_R7G_16XLARGE
	default "r7g.medium"
```

## terraform/aws/kconfigs/instance-types/Kconfig.r7gd.static
```kconfig
# AWS R7GD instance sizes (dynamically generated)

choice
	prompt "Instance size for R7GD family"
	default TERRAFORM_AWS_INSTANCE_R7GD_MEDIUM
	help
	  Select the specific instance size within the R7GD family.

config TERRAFORM_AWS_INSTANCE_R7GD_MEDIUM
	bool "r7gd.medium"
	help
	  vCPUs: 1
	  Memory: 8.0 GB
	  Network: Up to 12.5 Gigabit
	  Price: pricing varies
	  Instance storage: 59 GB

config TERRAFORM_AWS_INSTANCE_R7GD_LARGE
	bool "r7gd.large"
	help
	  vCPUs: 2
	  Memory: 16.0 GB
	  Network: Up to 12.5 Gigabit
	  Price: pricing varies
	  Instance storage: 118 GB

config TERRAFORM_AWS_INSTANCE_R7GD_XLARGE
	bool "r7gd.xlarge"
	help
	  vCPUs: 4
	  Memory: 32.0 GB
	  Network: Up to 12.5 Gigabit
	  Price: pricing varies
	  Instance storage: 237 GB

config TERRAFORM_AWS_INSTANCE_R7GD_2XLARGE
	bool "r7gd.2xlarge"
	help
	  vCPUs: 8
	  Memory: 64.0 GB
	  Network: Up to 15 Gigabit
	  Price: pricing varies
	  Instance storage: 474 GB

config TERRAFORM_AWS_INSTANCE_R7GD_4XLARGE
	bool "r7gd.4xlarge"
	help
	  vCPUs: 16
	  Memory: 128.0 GB
	  Network: Up to 15 Gigabit
	  Price: pricing varies
	  Instance storage: 950 GB

config TERRAFORM_AWS_INSTANCE_R7GD_8XLARGE
	bool "r7gd.8xlarge"
	help
	  vCPUs: 32
	  Memory: 256.0 GB
	  Network: 15 Gigabit
	  Price: pricing varies
	  Instance storage: 1900 GB

config TERRAFORM_AWS_INSTANCE_R7GD_12XLARGE
	bool "r7gd.12xlarge"
	help
	  vCPUs: 48
	  Memory: 384.0 GB
	  Network: 22.5 Gigabit
	  Price: pricing varies
	  Instance storage: 2850 GB

config TERRAFORM_AWS_INSTANCE_R7GD_16XLARGE
	bool "r7gd.16xlarge"
	help
	  vCPUs: 64
	  Memory: 512.0 GB
	  Network: 30 Gigabit
	  Price: pricing varies
	  Instance storage: 3800 GB

config TERRAFORM_AWS_INSTANCE_R7GD_METAL
	bool "r7gd.metal"
	help
	  vCPUs: 64
	  Memory: 512.0 GB
	  Network: 30 Gigabit
	  Price: pricing varies
	  Instance storage: 3800 GB

endchoice

config TERRAFORM_AWS_R7GD_SIZE
	string
	default "r7gd.medium" if TERRAFORM_AWS_INSTANCE_R7GD_MEDIUM
	default "r7gd.large" if TERRAFORM_AWS_INSTANCE_R7GD_LARGE
	default "r7gd.xlarge" if TERRAFORM_AWS_INSTANCE_R7GD_XLARGE
	default "r7gd.2xlarge" if TERRAFORM_AWS_INSTANCE_R7GD_2XLARGE
	default "r7gd.4xlarge" if TERRAFORM_AWS_INSTANCE_R7GD_4XLARGE
	default "r7gd.8xlarge" if TERRAFORM_AWS_INSTANCE_R7GD_8XLARGE
	default "r7gd.12xlarge" if TERRAFORM_AWS_INSTANCE_R7GD_12XLARGE
	default "r7gd.16xlarge" if TERRAFORM_AWS_INSTANCE_R7GD_16XLARGE
	default "r7gd.metal" if TERRAFORM_AWS_INSTANCE_R7GD_METAL
	default "r7gd.medium"
```

## terraform/aws/kconfigs/instance-types/Kconfig.r7i.static
```kconfig
# AWS R7I instance sizes (dynamically generated)

choice
	prompt "Instance size for R7I family"
	default TERRAFORM_AWS_INSTANCE_R7I_LARGE
	help
	  Select the specific instance size within the R7I family.

config TERRAFORM_AWS_INSTANCE_R7I_LARGE
	bool "r7i.large"
	help
	  vCPUs: 2
	  Memory: 16.0 GB
	  Network: Up to 12.5 Gigabit
	  Price: pricing varies

config TERRAFORM_AWS_INSTANCE_R7I_XLARGE
	bool "r7i.xlarge"
	help
	  vCPUs: 4
	  Memory: 32.0 GB
	  Network: Up to 12.5 Gigabit
	  Price: pricing varies

config TERRAFORM_AWS_INSTANCE_R7I_2XLARGE
	bool "r7i.2xlarge"
	help
	  vCPUs: 8
	  Memory: 64.0 GB
	  Network: Up to 12.5 Gigabit
	  Price: pricing varies

config TERRAFORM_AWS_INSTANCE_R7I_4XLARGE
	bool "r7i.4xlarge"
	help
	  vCPUs: 16
	  Memory: 128.0 GB
	  Network: Up to 12.5 Gigabit
	  Price: pricing varies

config TERRAFORM_AWS_INSTANCE_R7I_8XLARGE
	bool "r7i.8xlarge"
	help
	  vCPUs: 32
	  Memory: 256.0 GB
	  Network: 12.5 Gigabit
	  Price: pricing varies

config TERRAFORM_AWS_INSTANCE_R7I_12XLARGE
	bool "r7i.12xlarge"
	help
	  vCPUs: 48
	  Memory: 384.0 GB
	  Network: 18.75 Gigabit
	  Price: pricing varies

config TERRAFORM_AWS_INSTANCE_R7I_16XLARGE
	bool "r7i.16xlarge"
	help
	  vCPUs: 64
	  Memory: 512.0 GB
	  Network: 25 Gigabit
	  Price: pricing varies

config TERRAFORM_AWS_INSTANCE_R7I_METAL_24XL
	bool "r7i.metal-24xl"
	help
	  vCPUs: 96
	  Memory: 768.0 GB
	  Network: 37.5 Gigabit
	  Price: pricing varies

config TERRAFORM_AWS_INSTANCE_R7I_24XLARGE
	bool "r7i.24xlarge"
	help
	  vCPUs: 96
	  Memory: 768.0 GB
	  Network: 37.5 Gigabit
	  Price: pricing varies

config TERRAFORM_AWS_INSTANCE_R7I_METAL_48XL
	bool "r7i.metal-48xl"
	help
	  vCPUs: 192
	  Memory: 1536.0 GB
	  Network: 50 Gigabit
	  Price: pricing varies

config TERRAFORM_AWS_INSTANCE_R7I_48XLARGE
	bool "r7i.48xlarge"
	help
	  vCPUs: 192
	  Memory: 1536.0 GB
	  Network: 50 Gigabit
	  Price: pricing varies

endchoice

config TERRAFORM_AWS_R7I_SIZE
	string
	default "r7i.large" if TERRAFORM_AWS_INSTANCE_R7I_LARGE
	default "r7i.xlarge" if TERRAFORM_AWS_INSTANCE_R7I_XLARGE
	default "r7i.2xlarge" if TERRAFORM_AWS_INSTANCE_R7I_2XLARGE
	default "r7i.4xlarge" if TERRAFORM_AWS_INSTANCE_R7I_4XLARGE
	default "r7i.8xlarge" if TERRAFORM_AWS_INSTANCE_R7I_8XLARGE
	default "r7i.12xlarge" if TERRAFORM_AWS_INSTANCE_R7I_12XLARGE
	default "r7i.16xlarge" if TERRAFORM_AWS_INSTANCE_R7I_16XLARGE
	default "r7i.metal-24xl" if TERRAFORM_AWS_INSTANCE_R7I_METAL_24XL
	default "r7i.24xlarge" if TERRAFORM_AWS_INSTANCE_R7I_24XLARGE
	default "r7i.metal-48xl" if TERRAFORM_AWS_INSTANCE_R7I_METAL_48XL
	default "r7i.48xlarge" if TERRAFORM_AWS_INSTANCE_R7I_48XLARGE
	default "r7i.large"
```

## terraform/aws/kconfigs/instance-types/Kconfig.r7iz.static
```kconfig
# AWS R7IZ instance sizes (dynamically generated)

choice
	prompt "Instance size for R7IZ family"
	default TERRAFORM_AWS_INSTANCE_R7IZ_LARGE
	help
	  Select the specific instance size within the R7IZ family.

config TERRAFORM_AWS_INSTANCE_R7IZ_LARGE
	bool "r7iz.large"
	help
	  vCPUs: 2
	  Memory: 16.0 GB
	  Network: Up to 12.5 Gigabit
	  Price: pricing varies

config TERRAFORM_AWS_INSTANCE_R7IZ_XLARGE
	bool "r7iz.xlarge"
	help
	  vCPUs: 4
	  Memory: 32.0 GB
	  Network: Up to 12.5 Gigabit
	  Price: pricing varies

config TERRAFORM_AWS_INSTANCE_R7IZ_2XLARGE
	bool "r7iz.2xlarge"
	help
	  vCPUs: 8
	  Memory: 64.0 GB
	  Network: Up to 12.5 Gigabit
	  Price: pricing varies

config TERRAFORM_AWS_INSTANCE_R7IZ_4XLARGE
	bool "r7iz.4xlarge"
	help
	  vCPUs: 16
	  Memory: 128.0 GB
	  Network: Up to 12.5 Gigabit
	  Price: pricing varies

config TERRAFORM_AWS_INSTANCE_R7IZ_8XLARGE
	bool "r7iz.8xlarge"
	help
	  vCPUs: 32
	  Memory: 256.0 GB
	  Network: 12.5 Gigabit
	  Price: pricing varies

config TERRAFORM_AWS_INSTANCE_R7IZ_12XLARGE
	bool "r7iz.12xlarge"
	help
	  vCPUs: 48
	  Memory: 384.0 GB
	  Network: 25 Gigabit
	  Price: pricing varies

config TERRAFORM_AWS_INSTANCE_R7IZ_16XLARGE
	bool "r7iz.16xlarge"
	help
	  vCPUs: 64
	  Memory: 512.0 GB
	  Network: 25 Gigabit
	  Price: pricing varies

config TERRAFORM_AWS_INSTANCE_R7IZ_METAL_16XL
	bool "r7iz.metal-16xl"
	help
	  vCPUs: 64
	  Memory: 512.0 GB
	  Network: 25 Gigabit
	  Price: pricing varies

config TERRAFORM_AWS_INSTANCE_R7IZ_32XLARGE
	bool "r7iz.32xlarge"
	help
	  vCPUs: 128
	  Memory: 1024.0 GB
	  Network: 50 Gigabit
	  Price: pricing varies

config TERRAFORM_AWS_INSTANCE_R7IZ_METAL_32XL
	bool "r7iz.metal-32xl"
	help
	  vCPUs: 128
	  Memory: 1024.0 GB
	  Network: 50 Gigabit
	  Price: pricing varies

endchoice

config TERRAFORM_AWS_R7IZ_SIZE
	string
	default "r7iz.large" if TERRAFORM_AWS_INSTANCE_R7IZ_LARGE
	default "r7iz.xlarge" if TERRAFORM_AWS_INSTANCE_R7IZ_XLARGE
	default "r7iz.2xlarge" if TERRAFORM_AWS_INSTANCE_R7IZ_2XLARGE
	default "r7iz.4xlarge" if TERRAFORM_AWS_INSTANCE_R7IZ_4XLARGE
	default "r7iz.8xlarge" if TERRAFORM_AWS_INSTANCE_R7IZ_8XLARGE
	default "r7iz.12xlarge" if TERRAFORM_AWS_INSTANCE_R7IZ_12XLARGE
	default "r7iz.16xlarge" if TERRAFORM_AWS_INSTANCE_R7IZ_16XLARGE
	default "r7iz.metal-16xl" if TERRAFORM_AWS_INSTANCE_R7IZ_METAL_16XL
	default "r7iz.32xlarge" if TERRAFORM_AWS_INSTANCE_R7IZ_32XLARGE
	default "r7iz.metal-32xl" if TERRAFORM_AWS_INSTANCE_R7IZ_METAL_32XL
	default "r7iz.large"
```
