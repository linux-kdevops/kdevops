## terraform/aws/kconfigs/instance-types/Kconfig.i8ge.static
```kconfig
# AWS I8GE instance sizes (dynamically generated)

choice
	prompt "Instance size for I8GE family"
	default TERRAFORM_AWS_INSTANCE_I8GE_LARGE
	help
	  Select the specific instance size within the I8GE family.

config TERRAFORM_AWS_INSTANCE_I8GE_LARGE
	bool "i8ge.large"
	help
	  vCPUs: 2
	  Memory: 16.0 GB
	  Network: Up to 25 Gigabit
	  Price: pricing varies
	  Instance storage: 1250 GB

config TERRAFORM_AWS_INSTANCE_I8GE_XLARGE
	bool "i8ge.xlarge"
	help
	  vCPUs: 4
	  Memory: 32.0 GB
	  Network: Up to 25 Gigabit
	  Price: pricing varies
	  Instance storage: 2500 GB

config TERRAFORM_AWS_INSTANCE_I8GE_2XLARGE
	bool "i8ge.2xlarge"
	help
	  vCPUs: 8
	  Memory: 64.0 GB
	  Network: Up to 25 Gigabit
	  Price: pricing varies
	  Instance storage: 5000 GB

config TERRAFORM_AWS_INSTANCE_I8GE_3XLARGE
	bool "i8ge.3xlarge"
	help
	  vCPUs: 12
	  Memory: 96.0 GB
	  Network: Up to 25 Gigabit
	  Price: pricing varies
	  Instance storage: 7500 GB

config TERRAFORM_AWS_INSTANCE_I8GE_6XLARGE
	bool "i8ge.6xlarge"
	help
	  vCPUs: 24
	  Memory: 192.0 GB
	  Network: 37.5 Gigabit
	  Price: pricing varies
	  Instance storage: 15000 GB

config TERRAFORM_AWS_INSTANCE_I8GE_12XLARGE
	bool "i8ge.12xlarge"
	help
	  vCPUs: 48
	  Memory: 384.0 GB
	  Network: 75 Gigabit
	  Price: pricing varies
	  Instance storage: 30000 GB

config TERRAFORM_AWS_INSTANCE_I8GE_18XLARGE
	bool "i8ge.18xlarge"
	help
	  vCPUs: 72
	  Memory: 576.0 GB
	  Network: 112.5 Gigabit
	  Price: pricing varies
	  Instance storage: 45000 GB

config TERRAFORM_AWS_INSTANCE_I8GE_24XLARGE
	bool "i8ge.24xlarge"
	help
	  vCPUs: 96
	  Memory: 768.0 GB
	  Network: 150 Gigabit
	  Price: pricing varies
	  Instance storage: 60000 GB

config TERRAFORM_AWS_INSTANCE_I8GE_METAL_24XL
	bool "i8ge.metal-24xl"
	help
	  vCPUs: 96
	  Memory: 768.0 GB
	  Network: 150 Gigabit
	  Price: pricing varies
	  Instance storage: 60000 GB

config TERRAFORM_AWS_INSTANCE_I8GE_48XLARGE
	bool "i8ge.48xlarge"
	help
	  vCPUs: 192
	  Memory: 1536.0 GB
	  Network: 300 Gigabit
	  Price: pricing varies
	  Instance storage: 120000 GB

config TERRAFORM_AWS_INSTANCE_I8GE_METAL_48XL
	bool "i8ge.metal-48xl"
	help
	  vCPUs: 192
	  Memory: 1536.0 GB
	  Network: 300 Gigabit
	  Price: pricing varies
	  Instance storage: 120000 GB

endchoice

config TERRAFORM_AWS_I8GE_SIZE
	string
	default "i8ge.large" if TERRAFORM_AWS_INSTANCE_I8GE_LARGE
	default "i8ge.xlarge" if TERRAFORM_AWS_INSTANCE_I8GE_XLARGE
	default "i8ge.2xlarge" if TERRAFORM_AWS_INSTANCE_I8GE_2XLARGE
	default "i8ge.3xlarge" if TERRAFORM_AWS_INSTANCE_I8GE_3XLARGE
	default "i8ge.6xlarge" if TERRAFORM_AWS_INSTANCE_I8GE_6XLARGE
	default "i8ge.12xlarge" if TERRAFORM_AWS_INSTANCE_I8GE_12XLARGE
	default "i8ge.18xlarge" if TERRAFORM_AWS_INSTANCE_I8GE_18XLARGE
	default "i8ge.24xlarge" if TERRAFORM_AWS_INSTANCE_I8GE_24XLARGE
	default "i8ge.metal-24xl" if TERRAFORM_AWS_INSTANCE_I8GE_METAL_24XL
	default "i8ge.48xlarge" if TERRAFORM_AWS_INSTANCE_I8GE_48XLARGE
	default "i8ge.metal-48xl" if TERRAFORM_AWS_INSTANCE_I8GE_METAL_48XL
	default "i8ge.large"
```

## terraform/aws/kconfigs/instance-types/Kconfig.im4gn
```kconfig
if TERRAFORM_AWS_INSTANCE_TYPE_IM4GN

choice
	prompt "AWS instance size"
	default TERRAFORM_AWS_INSTANCE_SIZE_IM4GN_LARGE

config TERRAFORM_AWS_INSTANCE_SIZE_IM4GN_LARGE
	bool "im4gn.large"
	help
	  8 GiB RAM, 2vCPUs, 1 x 937 GiB NVMe SSD, 25 Gbps Net, 9.5 Gbps EBS.

config TERRAFORM_AWS_INSTANCE_SIZE_IM4GN_4XLARGE
	bool "im4gn.4xlarge"
	help
	  64 GiB RAM, 16 vcpus, 1 x 7500 NVMe SSD, 25 Gbps Net, 9.5 Gbps EBS.

endchoice

config TERRAFORM_AWS_INSTANCE_TYPE
	string
	output yaml
	default "im4gn.large" if TERRAFORM_AWS_INSTANCE_SIZE_IM4GN_LARGE
	default "im4gn.4xlarge" if TERRAFORM_AWS_INSTANCE_SIZE_IM4GN_4XLARGE

endif # TERRAFORM_AWS_INSTANCE_TYPE_IM4GN
```

## terraform/aws/kconfigs/instance-types/Kconfig.im4gn.static
```kconfig
# AWS IM4GN instance sizes (dynamically generated)

choice
	prompt "Instance size for IM4GN family"
	default TERRAFORM_AWS_INSTANCE_IM4GN_LARGE
	help
	  Select the specific instance size within the IM4GN family.

config TERRAFORM_AWS_INSTANCE_IM4GN_LARGE
	bool "im4gn.large"
	help
	  vCPUs: 2
	  Memory: 8.0 GB
	  Network: Up to 25 Gigabit
	  Price: pricing varies
	  Instance storage: 937 GB

config TERRAFORM_AWS_INSTANCE_IM4GN_XLARGE
	bool "im4gn.xlarge"
	help
	  vCPUs: 4
	  Memory: 16.0 GB
	  Network: Up to 25 Gigabit
	  Price: pricing varies
	  Instance storage: 1875 GB

config TERRAFORM_AWS_INSTANCE_IM4GN_2XLARGE
	bool "im4gn.2xlarge"
	help
	  vCPUs: 8
	  Memory: 32.0 GB
	  Network: Up to 25 Gigabit
	  Price: pricing varies
	  Instance storage: 3750 GB

config TERRAFORM_AWS_INSTANCE_IM4GN_4XLARGE
	bool "im4gn.4xlarge"
	help
	  vCPUs: 16
	  Memory: 64.0 GB
	  Network: 25 Gigabit
	  Price: pricing varies
	  Instance storage: 7500 GB

config TERRAFORM_AWS_INSTANCE_IM4GN_8XLARGE
	bool "im4gn.8xlarge"
	help
	  vCPUs: 32
	  Memory: 128.0 GB
	  Network: 50 Gigabit
	  Price: pricing varies
	  Instance storage: 15000 GB

config TERRAFORM_AWS_INSTANCE_IM4GN_16XLARGE
	bool "im4gn.16xlarge"
	help
	  vCPUs: 64
	  Memory: 256.0 GB
	  Network: 100 Gigabit
	  Price: pricing varies
	  Instance storage: 30000 GB

endchoice

config TERRAFORM_AWS_IM4GN_SIZE
	string
	default "im4gn.large" if TERRAFORM_AWS_INSTANCE_IM4GN_LARGE
	default "im4gn.xlarge" if TERRAFORM_AWS_INSTANCE_IM4GN_XLARGE
	default "im4gn.2xlarge" if TERRAFORM_AWS_INSTANCE_IM4GN_2XLARGE
	default "im4gn.4xlarge" if TERRAFORM_AWS_INSTANCE_IM4GN_4XLARGE
	default "im4gn.8xlarge" if TERRAFORM_AWS_INSTANCE_IM4GN_8XLARGE
	default "im4gn.16xlarge" if TERRAFORM_AWS_INSTANCE_IM4GN_16XLARGE
	default "im4gn.large"
```

## terraform/aws/kconfigs/instance-types/Kconfig.inf1.static
```kconfig
# AWS INF1 instance sizes (dynamically generated)

choice
	prompt "Instance size for INF1 family"
	default TERRAFORM_AWS_INSTANCE_INF1_XLARGE
	help
	  Select the specific instance size within the INF1 family.

config TERRAFORM_AWS_INSTANCE_INF1_XLARGE
	bool "inf1.xlarge"
	help
	  vCPUs: 4
	  Memory: 8.0 GB
	  Network: Up to 25 Gigabit
	  Price: pricing varies

config TERRAFORM_AWS_INSTANCE_INF1_2XLARGE
	bool "inf1.2xlarge"
	help
	  vCPUs: 8
	  Memory: 16.0 GB
	  Network: Up to 25 Gigabit
	  Price: pricing varies

config TERRAFORM_AWS_INSTANCE_INF1_6XLARGE
	bool "inf1.6xlarge"
	help
	  vCPUs: 24
	  Memory: 48.0 GB
	  Network: 25 Gigabit
	  Price: pricing varies

config TERRAFORM_AWS_INSTANCE_INF1_24XLARGE
	bool "inf1.24xlarge"
	help
	  vCPUs: 96
	  Memory: 192.0 GB
	  Network: 100 Gigabit
	  Price: pricing varies

endchoice

config TERRAFORM_AWS_INF1_SIZE
	string
	default "inf1.xlarge" if TERRAFORM_AWS_INSTANCE_INF1_XLARGE
	default "inf1.2xlarge" if TERRAFORM_AWS_INSTANCE_INF1_2XLARGE
	default "inf1.6xlarge" if TERRAFORM_AWS_INSTANCE_INF1_6XLARGE
	default "inf1.24xlarge" if TERRAFORM_AWS_INSTANCE_INF1_24XLARGE
	default "inf1.xlarge"
```

## terraform/aws/kconfigs/instance-types/Kconfig.inf2.static
```kconfig
# AWS INF2 instance sizes (dynamically generated)

choice
	prompt "Instance size for INF2 family"
	default TERRAFORM_AWS_INSTANCE_INF2_XLARGE
	help
	  Select the specific instance size within the INF2 family.

config TERRAFORM_AWS_INSTANCE_INF2_XLARGE
	bool "inf2.xlarge"
	help
	  vCPUs: 4
	  Memory: 16.0 GB
	  Network: Up to 15 Gigabit
	  Price: pricing varies

config TERRAFORM_AWS_INSTANCE_INF2_8XLARGE
	bool "inf2.8xlarge"
	help
	  vCPUs: 32
	  Memory: 128.0 GB
	  Network: Up to 25 Gigabit
	  Price: pricing varies

config TERRAFORM_AWS_INSTANCE_INF2_24XLARGE
	bool "inf2.24xlarge"
	help
	  vCPUs: 96
	  Memory: 384.0 GB
	  Network: 50 Gigabit
	  Price: pricing varies

config TERRAFORM_AWS_INSTANCE_INF2_48XLARGE
	bool "inf2.48xlarge"
	help
	  vCPUs: 192
	  Memory: 768.0 GB
	  Network: 100 Gigabit
	  Price: pricing varies

endchoice

config TERRAFORM_AWS_INF2_SIZE
	string
	default "inf2.xlarge" if TERRAFORM_AWS_INSTANCE_INF2_XLARGE
	default "inf2.8xlarge" if TERRAFORM_AWS_INSTANCE_INF2_8XLARGE
	default "inf2.24xlarge" if TERRAFORM_AWS_INSTANCE_INF2_24XLARGE
	default "inf2.48xlarge" if TERRAFORM_AWS_INSTANCE_INF2_48XLARGE
	default "inf2.xlarge"
```

## terraform/aws/kconfigs/instance-types/Kconfig.is4gen
```kconfig
if TERRAFORM_AWS_INSTANCE_TYPE_IS4GEN

choice
	prompt "AWS instance size"
	default TERRAFORM_AWS_INSTANCE_SIZE_IS4GEN_MEDIUM

config TERRAFORM_AWS_INSTANCE_SIZE_IS4GEN_MEDIUM
	bool "is4gen.medium"
	help
	  6 GiB RAM, 1vCPU, 1 x 937 GiB NVMe SSD, 25 Gbps Net, 9.6 Gbps EBS.

config TERRAFORM_AWS_INSTANCE_SIZE_IS4GEN_8XLARGE
	bool "is4gen.8xlarge"
	help
	  192 GiB RAM, 32 vCPUs, 4 x 7500 NVMe SSD, 50 Gbps Net, 19 Gbps EBS.

endchoice

config TERRAFORM_AWS_INSTANCE_TYPE
	string
	output yaml
	default "is4gen.medium" if TERRAFORM_AWS_INSTANCE_SIZE_IS4GEN_MEDIUM
	default "is4gen.8xlarge" if TERRAFORM_AWS_INSTANCE_SIZE_IS4GEN_8XLARGE

endif # TERRAFORM_AWS_INSTANCE_TYPE_IS4GEN
```

## terraform/aws/kconfigs/instance-types/Kconfig.is4gen.static
```kconfig
# AWS IS4GEN instance sizes (dynamically generated)

choice
	prompt "Instance size for IS4GEN family"
	default TERRAFORM_AWS_INSTANCE_IS4GEN_MEDIUM
	help
	  Select the specific instance size within the IS4GEN family.

config TERRAFORM_AWS_INSTANCE_IS4GEN_MEDIUM
	bool "is4gen.medium"
	help
	  vCPUs: 1
	  Memory: 6.0 GB
	  Network: Up to 25 Gigabit
	  Price: pricing varies
	  Instance storage: 937 GB

config TERRAFORM_AWS_INSTANCE_IS4GEN_LARGE
	bool "is4gen.large"
	help
	  vCPUs: 2
	  Memory: 12.0 GB
	  Network: Up to 25 Gigabit
	  Price: pricing varies
	  Instance storage: 1875 GB

config TERRAFORM_AWS_INSTANCE_IS4GEN_XLARGE
	bool "is4gen.xlarge"
	help
	  vCPUs: 4
	  Memory: 24.0 GB
	  Network: Up to 25 Gigabit
	  Price: pricing varies
	  Instance storage: 3750 GB

config TERRAFORM_AWS_INSTANCE_IS4GEN_2XLARGE
	bool "is4gen.2xlarge"
	help
	  vCPUs: 8
	  Memory: 48.0 GB
	  Network: Up to 25 Gigabit
	  Price: pricing varies
	  Instance storage: 7500 GB

config TERRAFORM_AWS_INSTANCE_IS4GEN_4XLARGE
	bool "is4gen.4xlarge"
	help
	  vCPUs: 16
	  Memory: 96.0 GB
	  Network: 25 Gigabit
	  Price: pricing varies
	  Instance storage: 15000 GB

config TERRAFORM_AWS_INSTANCE_IS4GEN_8XLARGE
	bool "is4gen.8xlarge"
	help
	  vCPUs: 32
	  Memory: 192.0 GB
	  Network: 50 Gigabit
	  Price: pricing varies
	  Instance storage: 30000 GB

endchoice

config TERRAFORM_AWS_IS4GEN_SIZE
	string
	default "is4gen.medium" if TERRAFORM_AWS_INSTANCE_IS4GEN_MEDIUM
	default "is4gen.large" if TERRAFORM_AWS_INSTANCE_IS4GEN_LARGE
	default "is4gen.xlarge" if TERRAFORM_AWS_INSTANCE_IS4GEN_XLARGE
	default "is4gen.2xlarge" if TERRAFORM_AWS_INSTANCE_IS4GEN_2XLARGE
	default "is4gen.4xlarge" if TERRAFORM_AWS_INSTANCE_IS4GEN_4XLARGE
	default "is4gen.8xlarge" if TERRAFORM_AWS_INSTANCE_IS4GEN_8XLARGE
	default "is4gen.medium"
```

## terraform/aws/kconfigs/instance-types/Kconfig.m1.static
```kconfig
# AWS M1 instance sizes (dynamically generated)

choice
	prompt "Instance size for M1 family"
	default TERRAFORM_AWS_INSTANCE_M1_SMALL
	help
	  Select the specific instance size within the M1 family.

config TERRAFORM_AWS_INSTANCE_M1_SMALL
	bool "m1.small"
	help
	  vCPUs: 1
	  Memory: 1.7 GB
	  Network: Low
	  Price: pricing varies
	  Instance storage: 160 GB

config TERRAFORM_AWS_INSTANCE_M1_MEDIUM
	bool "m1.medium"
	help
	  vCPUs: 1
	  Memory: 3.7 GB
	  Network: Moderate
	  Price: pricing varies
	  Instance storage: 410 GB

config TERRAFORM_AWS_INSTANCE_M1_LARGE
	bool "m1.large"
	help
	  vCPUs: 2
	  Memory: 7.5 GB
	  Network: Moderate
	  Price: pricing varies
	  Instance storage: 840 GB

config TERRAFORM_AWS_INSTANCE_M1_XLARGE
	bool "m1.xlarge"
	help
	  vCPUs: 4
	  Memory: 15.0 GB
	  Network: High
	  Price: pricing varies
	  Instance storage: 1680 GB

endchoice

config TERRAFORM_AWS_M1_SIZE
	string
	default "m1.small" if TERRAFORM_AWS_INSTANCE_M1_SMALL
	default "m1.medium" if TERRAFORM_AWS_INSTANCE_M1_MEDIUM
	default "m1.large" if TERRAFORM_AWS_INSTANCE_M1_LARGE
	default "m1.xlarge" if TERRAFORM_AWS_INSTANCE_M1_XLARGE
	default "m1.small"
```

## terraform/aws/kconfigs/instance-types/Kconfig.m2.static
```kconfig
# AWS M2 instance sizes (dynamically generated)

choice
	prompt "Instance size for M2 family"
	default TERRAFORM_AWS_INSTANCE_M2_XLARGE
	help
	  Select the specific instance size within the M2 family.

config TERRAFORM_AWS_INSTANCE_M2_XLARGE
	bool "m2.xlarge"
	help
	  vCPUs: 2
	  Memory: 17.1 GB
	  Network: Moderate
	  Price: pricing varies
	  Instance storage: 420 GB

config TERRAFORM_AWS_INSTANCE_M2_2XLARGE
	bool "m2.2xlarge"
	help
	  vCPUs: 4
	  Memory: 34.2 GB
	  Network: Moderate
	  Price: pricing varies
	  Instance storage: 850 GB

config TERRAFORM_AWS_INSTANCE_M2_4XLARGE
	bool "m2.4xlarge"
	help
	  vCPUs: 8
	  Memory: 68.4 GB
	  Network: High
	  Price: pricing varies
	  Instance storage: 1680 GB

endchoice

config TERRAFORM_AWS_M2_SIZE
	string
	default "m2.xlarge" if TERRAFORM_AWS_INSTANCE_M2_XLARGE
	default "m2.2xlarge" if TERRAFORM_AWS_INSTANCE_M2_2XLARGE
	default "m2.4xlarge" if TERRAFORM_AWS_INSTANCE_M2_4XLARGE
	default "m2.xlarge"
```

## terraform/aws/kconfigs/instance-types/Kconfig.m3.static
```kconfig
# AWS M3 instance sizes (dynamically generated)

choice
	prompt "Instance size for M3 family"
	default TERRAFORM_AWS_INSTANCE_M3_MEDIUM
	help
	  Select the specific instance size within the M3 family.

config TERRAFORM_AWS_INSTANCE_M3_MEDIUM
	bool "m3.medium"
	help
	  vCPUs: 1
	  Memory: 3.8 GB
	  Network: Moderate
	  Price: pricing varies
	  Instance storage: 4 GB

config TERRAFORM_AWS_INSTANCE_M3_LARGE
	bool "m3.large"
	help
	  vCPUs: 2
	  Memory: 7.5 GB
	  Network: Moderate
	  Price: pricing varies
	  Instance storage: 32 GB

config TERRAFORM_AWS_INSTANCE_M3_XLARGE
	bool "m3.xlarge"
	help
	  vCPUs: 4
	  Memory: 15.0 GB
	  Network: High
	  Price: pricing varies
	  Instance storage: 80 GB

config TERRAFORM_AWS_INSTANCE_M3_2XLARGE
	bool "m3.2xlarge"
	help
	  vCPUs: 8
	  Memory: 30.0 GB
	  Network: High
	  Price: pricing varies
	  Instance storage: 160 GB

endchoice

config TERRAFORM_AWS_M3_SIZE
	string
	default "m3.medium" if TERRAFORM_AWS_INSTANCE_M3_MEDIUM
	default "m3.large" if TERRAFORM_AWS_INSTANCE_M3_LARGE
	default "m3.xlarge" if TERRAFORM_AWS_INSTANCE_M3_XLARGE
	default "m3.2xlarge" if TERRAFORM_AWS_INSTANCE_M3_2XLARGE
	default "m3.medium"
```

## terraform/aws/kconfigs/instance-types/Kconfig.m4.static
```kconfig
# AWS M4 instance sizes (dynamically generated)

choice
	prompt "Instance size for M4 family"
	default TERRAFORM_AWS_INSTANCE_M4_LARGE
	help
	  Select the specific instance size within the M4 family.

config TERRAFORM_AWS_INSTANCE_M4_LARGE
	bool "m4.large"
	help
	  vCPUs: 2
	  Memory: 8.0 GB
	  Network: Moderate
	  Price: pricing varies

config TERRAFORM_AWS_INSTANCE_M4_XLARGE
	bool "m4.xlarge"
	help
	  vCPUs: 4
	  Memory: 16.0 GB
	  Network: High
	  Price: pricing varies

config TERRAFORM_AWS_INSTANCE_M4_2XLARGE
	bool "m4.2xlarge"
	help
	  vCPUs: 8
	  Memory: 32.0 GB
	  Network: High
	  Price: pricing varies

config TERRAFORM_AWS_INSTANCE_M4_4XLARGE
	bool "m4.4xlarge"
	help
	  vCPUs: 16
	  Memory: 64.0 GB
	  Network: High
	  Price: pricing varies

config TERRAFORM_AWS_INSTANCE_M4_10XLARGE
	bool "m4.10xlarge"
	help
	  vCPUs: 40
	  Memory: 160.0 GB
	  Network: 10 Gigabit
	  Price: pricing varies

config TERRAFORM_AWS_INSTANCE_M4_16XLARGE
	bool "m4.16xlarge"
	help
	  vCPUs: 64
	  Memory: 256.0 GB
	  Network: 25 Gigabit
	  Price: pricing varies

endchoice

config TERRAFORM_AWS_M4_SIZE
	string
	default "m4.large" if TERRAFORM_AWS_INSTANCE_M4_LARGE
	default "m4.xlarge" if TERRAFORM_AWS_INSTANCE_M4_XLARGE
	default "m4.2xlarge" if TERRAFORM_AWS_INSTANCE_M4_2XLARGE
	default "m4.4xlarge" if TERRAFORM_AWS_INSTANCE_M4_4XLARGE
	default "m4.10xlarge" if TERRAFORM_AWS_INSTANCE_M4_10XLARGE
	default "m4.16xlarge" if TERRAFORM_AWS_INSTANCE_M4_16XLARGE
	default "m4.large"
```
