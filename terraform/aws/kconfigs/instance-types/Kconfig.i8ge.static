## terraform/aws/kconfigs/instance-types/Kconfig.m5zn.static
```kconfig
# AWS M5ZN instance sizes (dynamically generated)

choice
	prompt "Instance size for M5ZN family"
	default TERRAFORM_AWS_INSTANCE_M5ZN_LARGE
	help
	  Select the specific instance size within the M5ZN family.

config TERRAFORM_AWS_INSTANCE_M5ZN_LARGE
	bool "m5zn.large"
	help
	  vCPUs: 2
	  Memory: 8.0 GB
	  Network: Up to 25 Gigabit
	  Price: pricing varies

config TERRAFORM_AWS_INSTANCE_M5ZN_XLARGE
	bool "m5zn.xlarge"
	help
	  vCPUs: 4
	  Memory: 16.0 GB
	  Network: Up to 25 Gigabit
	  Price: pricing varies

config TERRAFORM_AWS_INSTANCE_M5ZN_2XLARGE
	bool "m5zn.2xlarge"
	help
	  vCPUs: 8
	  Memory: 32.0 GB
	  Network: Up to 25 Gigabit
	  Price: pricing varies

config TERRAFORM_AWS_INSTANCE_M5ZN_3XLARGE
	bool "m5zn.3xlarge"
	help
	  vCPUs: 12
	  Memory: 48.0 GB
	  Network: Up to 25 Gigabit
	  Price: pricing varies

config TERRAFORM_AWS_INSTANCE_M5ZN_6XLARGE
	bool "m5zn.6xlarge"
	help
	  vCPUs: 24
	  Memory: 96.0 GB
	  Network: 50 Gigabit
	  Price: pricing varies

config TERRAFORM_AWS_INSTANCE_M5ZN_12XLARGE
	bool "m5zn.12xlarge"
	help
	  vCPUs: 48
	  Memory: 192.0 GB
	  Network: 100 Gigabit
	  Price: pricing varies

config TERRAFORM_AWS_INSTANCE_M5ZN_METAL
	bool "m5zn.metal"
	help
	  vCPUs: 48
	  Memory: 192.0 GB
	  Network: 100 Gigabit
	  Price: pricing varies

endchoice

config TERRAFORM_AWS_M5ZN_SIZE
	string
	default "m5zn.large" if TERRAFORM_AWS_INSTANCE_M5ZN_LARGE
	default "m5zn.xlarge" if TERRAFORM_AWS_INSTANCE_M5ZN_XLARGE
	default "m5zn.2xlarge" if TERRAFORM_AWS_INSTANCE_M5ZN_2XLARGE
	default "m5zn.3xlarge" if TERRAFORM_AWS_INSTANCE_M5ZN_3XLARGE
	default "m5zn.6xlarge" if TERRAFORM_AWS_INSTANCE_M5ZN_6XLARGE
	default "m5zn.12xlarge" if TERRAFORM_AWS_INSTANCE_M5ZN_12XLARGE
	default "m5zn.metal" if TERRAFORM_AWS_INSTANCE_M5ZN_METAL
	default "m5zn.large"
```

## terraform/aws/kconfigs/instance-types/Kconfig.m6a.static
```kconfig
# AWS M6A instance sizes (dynamically generated)

choice
	prompt "Instance size for M6A family"
	default TERRAFORM_AWS_INSTANCE_M6A_LARGE
	help
	  Select the specific instance size within the M6A family.

config TERRAFORM_AWS_INSTANCE_M6A_LARGE
	bool "m6a.large"
	help
	  vCPUs: 2
	  Memory: 8.0 GB
	  Network: Up to 12.5 Gigabit
	  Price: pricing varies

config TERRAFORM_AWS_INSTANCE_M6A_XLARGE
	bool "m6a.xlarge"
	help
	  vCPUs: 4
	  Memory: 16.0 GB
	  Network: Up to 12.5 Gigabit
	  Price: pricing varies

config TERRAFORM_AWS_INSTANCE_M6A_2XLARGE
	bool "m6a.2xlarge"
	help
	  vCPUs: 8
	  Memory: 32.0 GB
	  Network: Up to 12.5 Gigabit
	  Price: pricing varies

config TERRAFORM_AWS_INSTANCE_M6A_4XLARGE
	bool "m6a.4xlarge"
	help
	  vCPUs: 16
	  Memory: 64.0 GB
	  Network: Up to 12.5 Gigabit
	  Price: pricing varies

config TERRAFORM_AWS_INSTANCE_M6A_8XLARGE
	bool "m6a.8xlarge"
	help
	  vCPUs: 32
	  Memory: 128.0 GB
	  Network: 12.5 Gigabit
	  Price: pricing varies

config TERRAFORM_AWS_INSTANCE_M6A_12XLARGE
	bool "m6a.12xlarge"
	help
	  vCPUs: 48
	  Memory: 192.0 GB
	  Network: 18.75 Gigabit
	  Price: pricing varies

config TERRAFORM_AWS_INSTANCE_M6A_16XLARGE
	bool "m6a.16xlarge"
	help
	  vCPUs: 64
	  Memory: 256.0 GB
	  Network: 25 Gigabit
	  Price: pricing varies

config TERRAFORM_AWS_INSTANCE_M6A_24XLARGE
	bool "m6a.24xlarge"
	help
	  vCPUs: 96
	  Memory: 384.0 GB
	  Network: 37.5 Gigabit
	  Price: pricing varies

config TERRAFORM_AWS_INSTANCE_M6A_32XLARGE
	bool "m6a.32xlarge"
	help
	  vCPUs: 128
	  Memory: 512.0 GB
	  Network: 50 Gigabit
	  Price: pricing varies

config TERRAFORM_AWS_INSTANCE_M6A_METAL
	bool "m6a.metal"
	help
	  vCPUs: 192
	  Memory: 768.0 GB
	  Network: 50 Gigabit
	  Price: pricing varies

config TERRAFORM_AWS_INSTANCE_M6A_48XLARGE
	bool "m6a.48xlarge"
	help
	  vCPUs: 192
	  Memory: 768.0 GB
	  Network: 50 Gigabit
	  Price: pricing varies

endchoice

config TERRAFORM_AWS_M6A_SIZE
	string
	default "m6a.large" if TERRAFORM_AWS_INSTANCE_M6A_LARGE
	default "m6a.xlarge" if TERRAFORM_AWS_INSTANCE_M6A_XLARGE
	default "m6a.2xlarge" if TERRAFORM_AWS_INSTANCE_M6A_2XLARGE
	default "m6a.4xlarge" if TERRAFORM_AWS_INSTANCE_M6A_4XLARGE
	default "m6a.8xlarge" if TERRAFORM_AWS_INSTANCE_M6A_8XLARGE
	default "m6a.12xlarge" if TERRAFORM_AWS_INSTANCE_M6A_12XLARGE
	default "m6a.16xlarge" if TERRAFORM_AWS_INSTANCE_M6A_16XLARGE
	default "m6a.24xlarge" if TERRAFORM_AWS_INSTANCE_M6A_24XLARGE
	default "m6a.32xlarge" if TERRAFORM_AWS_INSTANCE_M6A_32XLARGE
	default "m6a.metal" if TERRAFORM_AWS_INSTANCE_M6A_METAL
	default "m6a.48xlarge" if TERRAFORM_AWS_INSTANCE_M6A_48XLARGE
	default "m6a.large"
```

## terraform/aws/kconfigs/instance-types/Kconfig.m6g.static
```kconfig
# AWS M6G instance sizes (dynamically generated)

choice
	prompt "Instance size for M6G family"
	default TERRAFORM_AWS_INSTANCE_M6G_MEDIUM
	help
	  Select the specific instance size within the M6G family.

config TERRAFORM_AWS_INSTANCE_M6G_MEDIUM
	bool "m6g.medium"
	help
	  vCPUs: 1
	  Memory: 4.0 GB
	  Network: Up to 10 Gigabit
	  Price: pricing varies

config TERRAFORM_AWS_INSTANCE_M6G_LARGE
	bool "m6g.large"
	help
	  vCPUs: 2
	  Memory: 8.0 GB
	  Network: Up to 10 Gigabit
	  Price: pricing varies

config TERRAFORM_AWS_INSTANCE_M6G_XLARGE
	bool "m6g.xlarge"
	help
	  vCPUs: 4
	  Memory: 16.0 GB
	  Network: Up to 10 Gigabit
	  Price: pricing varies

config TERRAFORM_AWS_INSTANCE_M6G_2XLARGE
	bool "m6g.2xlarge"
	help
	  vCPUs: 8
	  Memory: 32.0 GB
	  Network: Up to 10 Gigabit
	  Price: pricing varies

config TERRAFORM_AWS_INSTANCE_M6G_4XLARGE
	bool "m6g.4xlarge"
	help
	  vCPUs: 16
	  Memory: 64.0 GB
	  Network: Up to 10 Gigabit
	  Price: pricing varies

config TERRAFORM_AWS_INSTANCE_M6G_8XLARGE
	bool "m6g.8xlarge"
	help
	  vCPUs: 32
	  Memory: 128.0 GB
	  Network: 12 Gigabit
	  Price: pricing varies

config TERRAFORM_AWS_INSTANCE_M6G_12XLARGE
	bool "m6g.12xlarge"
	help
	  vCPUs: 48
	  Memory: 192.0 GB
	  Network: 20 Gigabit
	  Price: pricing varies

config TERRAFORM_AWS_INSTANCE_M6G_METAL
	bool "m6g.metal"
	help
	  vCPUs: 64
	  Memory: 256.0 GB
	  Network: 25 Gigabit
	  Price: pricing varies

config TERRAFORM_AWS_INSTANCE_M6G_16XLARGE
	bool "m6g.16xlarge"
	help
	  vCPUs: 64
	  Memory: 256.0 GB
	  Network: 25 Gigabit
	  Price: pricing varies

endchoice

config TERRAFORM_AWS_M6G_SIZE
	string
	default "m6g.medium" if TERRAFORM_AWS_INSTANCE_M6G_MEDIUM
	default "m6g.large" if TERRAFORM_AWS_INSTANCE_M6G_LARGE
	default "m6g.xlarge" if TERRAFORM_AWS_INSTANCE_M6G_XLARGE
	default "m6g.2xlarge" if TERRAFORM_AWS_INSTANCE_M6G_2XLARGE
	default "m6g.4xlarge" if TERRAFORM_AWS_INSTANCE_M6G_4XLARGE
	default "m6g.8xlarge" if TERRAFORM_AWS_INSTANCE_M6G_8XLARGE
	default "m6g.12xlarge" if TERRAFORM_AWS_INSTANCE_M6G_12XLARGE
	default "m6g.metal" if TERRAFORM_AWS_INSTANCE_M6G_METAL
	default "m6g.16xlarge" if TERRAFORM_AWS_INSTANCE_M6G_16XLARGE
	default "m6g.medium"
```

## terraform/aws/kconfigs/instance-types/Kconfig.m6gd.static
```kconfig
# AWS M6GD instance sizes (dynamically generated)

choice
	prompt "Instance size for M6GD family"
	default TERRAFORM_AWS_INSTANCE_M6GD_MEDIUM
	help
	  Select the specific instance size within the M6GD family.

config TERRAFORM_AWS_INSTANCE_M6GD_MEDIUM
	bool "m6gd.medium"
	help
	  vCPUs: 1
	  Memory: 4.0 GB
	  Network: Up to 10 Gigabit
	  Price: pricing varies
	  Instance storage: 59 GB

config TERRAFORM_AWS_INSTANCE_M6GD_LARGE
	bool "m6gd.large"
	help
	  vCPUs: 2
	  Memory: 8.0 GB
	  Network: Up to 10 Gigabit
	  Price: pricing varies
	  Instance storage: 118 GB

config TERRAFORM_AWS_INSTANCE_M6GD_XLARGE
	bool "m6gd.xlarge"
	help
	  vCPUs: 4
	  Memory: 16.0 GB
	  Network: Up to 10 Gigabit
	  Price: pricing varies
	  Instance storage: 237 GB

config TERRAFORM_AWS_INSTANCE_M6GD_2XLARGE
	bool "m6gd.2xlarge"
	help
	  vCPUs: 8
	  Memory: 32.0 GB
	  Network: Up to 10 Gigabit
	  Price: pricing varies
	  Instance storage: 474 GB

config TERRAFORM_AWS_INSTANCE_M6GD_4XLARGE
	bool "m6gd.4xlarge"
	help
	  vCPUs: 16
	  Memory: 64.0 GB
	  Network: Up to 10 Gigabit
	  Price: pricing varies
	  Instance storage: 950 GB

config TERRAFORM_AWS_INSTANCE_M6GD_8XLARGE
	bool "m6gd.8xlarge"
	help
	  vCPUs: 32
	  Memory: 128.0 GB
	  Network: 12 Gigabit
	  Price: pricing varies
	  Instance storage: 1900 GB

config TERRAFORM_AWS_INSTANCE_M6GD_12XLARGE
	bool "m6gd.12xlarge"
	help
	  vCPUs: 48
	  Memory: 192.0 GB
	  Network: 20 Gigabit
	  Price: pricing varies
	  Instance storage: 2850 GB

config TERRAFORM_AWS_INSTANCE_M6GD_METAL
	bool "m6gd.metal"
	help
	  vCPUs: 64
	  Memory: 256.0 GB
	  Network: 25 Gigabit
	  Price: pricing varies
	  Instance storage: 3800 GB

config TERRAFORM_AWS_INSTANCE_M6GD_16XLARGE
	bool "m6gd.16xlarge"
	help
	  vCPUs: 64
	  Memory: 256.0 GB
	  Network: 25 Gigabit
	  Price: pricing varies
	  Instance storage: 3800 GB

endchoice

config TERRAFORM_AWS_M6GD_SIZE
	string
	default "m6gd.medium" if TERRAFORM_AWS_INSTANCE_M6GD_MEDIUM
	default "m6gd.large" if TERRAFORM_AWS_INSTANCE_M6GD_LARGE
	default "m6gd.xlarge" if TERRAFORM_AWS_INSTANCE_M6GD_XLARGE
	default "m6gd.2xlarge" if TERRAFORM_AWS_INSTANCE_M6GD_2XLARGE
	default "m6gd.4xlarge" if TERRAFORM_AWS_INSTANCE_M6GD_4XLARGE
	default "m6gd.8xlarge" if TERRAFORM_AWS_INSTANCE_M6GD_8XLARGE
	default "m6gd.12xlarge" if TERRAFORM_AWS_INSTANCE_M6GD_12XLARGE
	default "m6gd.metal" if TERRAFORM_AWS_INSTANCE_M6GD_METAL
	default "m6gd.16xlarge" if TERRAFORM_AWS_INSTANCE_M6GD_16XLARGE
	default "m6gd.medium"
```

## terraform/aws/kconfigs/instance-types/Kconfig.m6i.static
```kconfig
# AWS M6I instance sizes (dynamically generated)

choice
	prompt "Instance size for M6I family"
	default TERRAFORM_AWS_INSTANCE_M6I_LARGE
	help
	  Select the specific instance size within the M6I family.

config TERRAFORM_AWS_INSTANCE_M6I_LARGE
	bool "m6i.large"
	help
	  vCPUs: 2
	  Memory: 8.0 GB
	  Network: Up to 12.5 Gigabit
	  Price: pricing varies

config TERRAFORM_AWS_INSTANCE_M6I_XLARGE
	bool "m6i.xlarge"
	help
	  vCPUs: 4
	  Memory: 16.0 GB
	  Network: Up to 12.5 Gigabit
	  Price: pricing varies

config TERRAFORM_AWS_INSTANCE_M6I_2XLARGE
	bool "m6i.2xlarge"
	help
	  vCPUs: 8
	  Memory: 32.0 GB
	  Network: Up to 12.5 Gigabit
	  Price: pricing varies

config TERRAFORM_AWS_INSTANCE_M6I_4XLARGE
	bool "m6i.4xlarge"
	help
	  vCPUs: 16
	  Memory: 64.0 GB
	  Network: Up to 12.5 Gigabit
	  Price: pricing varies

config TERRAFORM_AWS_INSTANCE_M6I_8XLARGE
	bool "m6i.8xlarge"
	help
	  vCPUs: 32
	  Memory: 128.0 GB
	  Network: 12.5 Gigabit
	  Price: pricing varies

config TERRAFORM_AWS_INSTANCE_M6I_12XLARGE
	bool "m6i.12xlarge"
	help
	  vCPUs: 48
	  Memory: 192.0 GB
	  Network: 18.75 Gigabit
	  Price: pricing varies

config TERRAFORM_AWS_INSTANCE_M6I_16XLARGE
	bool "m6i.16xlarge"
	help
	  vCPUs: 64
	  Memory: 256.0 GB
	  Network: 25 Gigabit
	  Price: pricing varies

config TERRAFORM_AWS_INSTANCE_M6I_24XLARGE
	bool "m6i.24xlarge"
	help
	  vCPUs: 96
	  Memory: 384.0 GB
	  Network: 37.5 Gigabit
	  Price: pricing varies

config TERRAFORM_AWS_INSTANCE_M6I_METAL
	bool "m6i.metal"
	help
	  vCPUs: 128
	  Memory: 512.0 GB
	  Network: 50 Gigabit
	  Price: pricing varies

config TERRAFORM_AWS_INSTANCE_M6I_32XLARGE
	bool "m6i.32xlarge"
	help
	  vCPUs: 128
	  Memory: 512.0 GB
	  Network: 50 Gigabit
	  Price: pricing varies

endchoice

config TERRAFORM_AWS_M6I_SIZE
	string
	default "m6i.large" if TERRAFORM_AWS_INSTANCE_M6I_LARGE
	default "m6i.xlarge" if TERRAFORM_AWS_INSTANCE_M6I_XLARGE
	default "m6i.2xlarge" if TERRAFORM_AWS_INSTANCE_M6I_2XLARGE
	default "m6i.4xlarge" if TERRAFORM_AWS_INSTANCE_M6I_4XLARGE
	default "m6i.8xlarge" if TERRAFORM_AWS_INSTANCE_M6I_8XLARGE
	default "m6i.12xlarge" if TERRAFORM_AWS_INSTANCE_M6I_12XLARGE
	default "m6i.16xlarge" if TERRAFORM_AWS_INSTANCE_M6I_16XLARGE
	default "m6i.24xlarge" if TERRAFORM_AWS_INSTANCE_M6I_24XLARGE
	default "m6i.metal" if TERRAFORM_AWS_INSTANCE_M6I_METAL
	default "m6i.32xlarge" if TERRAFORM_AWS_INSTANCE_M6I_32XLARGE
	default "m6i.large"
```

## terraform/aws/kconfigs/instance-types/Kconfig.m6id.static
```kconfig
# AWS M6ID instance sizes (dynamically generated)

choice
	prompt "Instance size for M6ID family"
	default TERRAFORM_AWS_INSTANCE_M6ID_LARGE
	help
	  Select the specific instance size within the M6ID family.

config TERRAFORM_AWS_INSTANCE_M6ID_LARGE
	bool "m6id.large"
	help
	  vCPUs: 2
	  Memory: 8.0 GB
	  Network: Up to 12.5 Gigabit
	  Price: pricing varies
	  Instance storage: 118 GB

config TERRAFORM_AWS_INSTANCE_M6ID_XLARGE
	bool "m6id.xlarge"
	help
	  vCPUs: 4
	  Memory: 16.0 GB
	  Network: Up to 12.5 Gigabit
	  Price: pricing varies
	  Instance storage: 237 GB

config TERRAFORM_AWS_INSTANCE_M6ID_2XLARGE
	bool "m6id.2xlarge"
	help
	  vCPUs: 8
	  Memory: 32.0 GB
	  Network: Up to 12.5 Gigabit
	  Price: pricing varies
	  Instance storage: 474 GB

config TERRAFORM_AWS_INSTANCE_M6ID_4XLARGE
	bool "m6id.4xlarge"
	help
	  vCPUs: 16
	  Memory: 64.0 GB
	  Network: Up to 12.5 Gigabit
	  Price: pricing varies
	  Instance storage: 950 GB

config TERRAFORM_AWS_INSTANCE_M6ID_8XLARGE
	bool "m6id.8xlarge"
	help
	  vCPUs: 32
	  Memory: 128.0 GB
	  Network: 12.5 Gigabit
	  Price: pricing varies
	  Instance storage: 1900 GB

config TERRAFORM_AWS_INSTANCE_M6ID_12XLARGE
	bool "m6id.12xlarge"
	help
	  vCPUs: 48
	  Memory: 192.0 GB
	  Network: 18.75 Gigabit
	  Price: pricing varies
	  Instance storage: 2850 GB

config TERRAFORM_AWS_INSTANCE_M6ID_16XLARGE
	bool "m6id.16xlarge"
	help
	  vCPUs: 64
	  Memory: 256.0 GB
	  Network: 25 Gigabit
	  Price: pricing varies
	  Instance storage: 3800 GB

config TERRAFORM_AWS_INSTANCE_M6ID_24XLARGE
	bool "m6id.24xlarge"
	help
	  vCPUs: 96
	  Memory: 384.0 GB
	  Network: 37.5 Gigabit
	  Price: pricing varies
	  Instance storage: 5700 GB

config TERRAFORM_AWS_INSTANCE_M6ID_32XLARGE
	bool "m6id.32xlarge"
	help
	  vCPUs: 128
	  Memory: 512.0 GB
	  Network: 50 Gigabit
	  Price: pricing varies
	  Instance storage: 7600 GB

config TERRAFORM_AWS_INSTANCE_M6ID_METAL
	bool "m6id.metal"
	help
	  vCPUs: 128
	  Memory: 512.0 GB
	  Network: 50 Gigabit
	  Price: pricing varies
	  Instance storage: 7600 GB

endchoice

config TERRAFORM_AWS_M6ID_SIZE
	string
	default "m6id.large" if TERRAFORM_AWS_INSTANCE_M6ID_LARGE
	default "m6id.xlarge" if TERRAFORM_AWS_INSTANCE_M6ID_XLARGE
	default "m6id.2xlarge" if TERRAFORM_AWS_INSTANCE_M6ID_2XLARGE
	default "m6id.4xlarge" if TERRAFORM_AWS_INSTANCE_M6ID_4XLARGE
	default "m6id.8xlarge" if TERRAFORM_AWS_INSTANCE_M6ID_8XLARGE
	default "m6id.12xlarge" if TERRAFORM_AWS_INSTANCE_M6ID_12XLARGE
	default "m6id.16xlarge" if TERRAFORM_AWS_INSTANCE_M6ID_16XLARGE
	default "m6id.24xlarge" if TERRAFORM_AWS_INSTANCE_M6ID_24XLARGE
	default "m6id.32xlarge" if TERRAFORM_AWS_INSTANCE_M6ID_32XLARGE
	default "m6id.metal" if TERRAFORM_AWS_INSTANCE_M6ID_METAL
	default "m6id.large"
```
