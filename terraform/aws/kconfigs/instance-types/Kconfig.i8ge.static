## terraform/aws/kconfigs/instance-types/Kconfig.m5
```kconfig
if TERRAFORM_AWS_INSTANCE_TYPE_M5

choice
	prompt "AWS instance type"
	default TERRAFORM_AWS_INSTANCE_SIZE_M5AD_4XLARGE
	help
	  Add storage by selecting the TERRAFORM_AWS_ENABLE_EBS_VOLUMES
	  option and adjusting the size and number of additional devices.

config TERRAFORM_AWS_INSTANCE_SIZE_M5AD_LARGE
	bool "m5ad.large"
	depends on TARGET_ARCH_X86_64
	help
	  8 GiB RAM, 2 AMD vcpus, 1 10 GiB main drive, up to 10 Gbps
	  network speed, and one 75 GiB NVMe drive.

config TERRAFORM_AWS_INSTANCE_SIZE_M5AD_XLARGE
	bool "m5ad.xlarge"
	depends on TARGET_ARCH_X86_64
	help
	  16 GiB RAM, 4 AMD vcpus, 1 10 GiB main drive, up to 10 Gbps
	  network speed, and one 150 GiB NVMe drive.

config TERRAFORM_AWS_INSTANCE_SIZE_M5AD_2XLARGE
	bool "m5ad.2xlarge"
	depends on TARGET_ARCH_X86_64
	help
	  32 GiB RAM, 8 AMD vcpus, 1 10 GiB main drive, up to 10 Gbps
	  network speed, and one 300 GiB NVMe drive.

config TERRAFORM_AWS_INSTANCE_SIZE_M5AD_4XLARGE
	bool "m5ad.4xlarge"
	depends on TARGET_ARCH_X86_64
	help
	  64 GiB RAM, 16 AMD vcpus, 1 10 GiB main drive, up to 10 Gbps
	  and two 300 GiB NVMe drives.

endchoice

config TERRAFORM_AWS_INSTANCE_TYPE
	string
	output yaml
	default "m5ad.large" if TERRAFORM_AWS_INSTANCE_SIZE_M5AD_LARGE
	default "m5ad.xlarge" if TERRAFORM_AWS_INSTANCE_SIZE_M5AD_XLARGE
	default "m5ad.2xlarge" if TERRAFORM_AWS_INSTANCE_SIZE_M5AD_2XLARGE
	default "m5ad.4xlarge" if TERRAFORM_AWS_INSTANCE_SIZE_M5AD_4XLARGE

endif # TERRAFORM_AWS_INSTANCE_TYPE_M5
```

## terraform/aws/kconfigs/instance-types/Kconfig.m5.static
```kconfig
# AWS M5 instance sizes (dynamically generated)

choice
	prompt "Instance size for M5 family"
	default TERRAFORM_AWS_INSTANCE_M5_LARGE
	help
	  Select the specific instance size within the M5 family.

config TERRAFORM_AWS_INSTANCE_M5_LARGE
	bool "m5.large"
	help
	  vCPUs: 2
	  Memory: 8.0 GB
	  Network: Up to 10 Gigabit
	  Price: $0.096/hour

config TERRAFORM_AWS_INSTANCE_M5_XLARGE
	bool "m5.xlarge"
	help
	  vCPUs: 4
	  Memory: 16.0 GB
	  Network: Up to 10 Gigabit
	  Price: $0.192/hour

config TERRAFORM_AWS_INSTANCE_M5_2XLARGE
	bool "m5.2xlarge"
	help
	  vCPUs: 8
	  Memory: 32.0 GB
	  Network: Up to 10 Gigabit
	  Price: $0.384/hour

config TERRAFORM_AWS_INSTANCE_M5_4XLARGE
	bool "m5.4xlarge"
	help
	  vCPUs: 16
	  Memory: 64.0 GB
	  Network: Up to 10 Gigabit
	  Price: $0.768/hour

config TERRAFORM_AWS_INSTANCE_M5_8XLARGE
	bool "m5.8xlarge"
	help
	  vCPUs: 32
	  Memory: 128.0 GB
	  Network: 10 Gigabit
	  Price: $1.536/hour

config TERRAFORM_AWS_INSTANCE_M5_12XLARGE
	bool "m5.12xlarge"
	help
	  vCPUs: 48
	  Memory: 192.0 GB
	  Network: 12 Gigabit
	  Price: $2.304/hour

config TERRAFORM_AWS_INSTANCE_M5_16XLARGE
	bool "m5.16xlarge"
	help
	  vCPUs: 64
	  Memory: 256.0 GB
	  Network: 20 Gigabit
	  Price: $3.072/hour

config TERRAFORM_AWS_INSTANCE_M5_METAL
	bool "m5.metal"
	help
	  vCPUs: 96
	  Memory: 384.0 GB
	  Network: 25 Gigabit
	  Price: pricing varies

config TERRAFORM_AWS_INSTANCE_M5_24XLARGE
	bool "m5.24xlarge"
	help
	  vCPUs: 96
	  Memory: 384.0 GB
	  Network: 25 Gigabit
	  Price: $4.608/hour

endchoice

config TERRAFORM_AWS_M5_SIZE
	string
	default "m5.large" if TERRAFORM_AWS_INSTANCE_M5_LARGE
	default "m5.xlarge" if TERRAFORM_AWS_INSTANCE_M5_XLARGE
	default "m5.2xlarge" if TERRAFORM_AWS_INSTANCE_M5_2XLARGE
	default "m5.4xlarge" if TERRAFORM_AWS_INSTANCE_M5_4XLARGE
	default "m5.8xlarge" if TERRAFORM_AWS_INSTANCE_M5_8XLARGE
	default "m5.12xlarge" if TERRAFORM_AWS_INSTANCE_M5_12XLARGE
	default "m5.16xlarge" if TERRAFORM_AWS_INSTANCE_M5_16XLARGE
	default "m5.metal" if TERRAFORM_AWS_INSTANCE_M5_METAL
	default "m5.24xlarge" if TERRAFORM_AWS_INSTANCE_M5_24XLARGE
	default "m5.large"
```

## terraform/aws/kconfigs/instance-types/Kconfig.m5a.static
```kconfig
# AWS M5A instance sizes (dynamically generated)

choice
	prompt "Instance size for M5A family"
	default TERRAFORM_AWS_INSTANCE_M5A_LARGE
	help
	  Select the specific instance size within the M5A family.

config TERRAFORM_AWS_INSTANCE_M5A_LARGE
	bool "m5a.large"
	help
	  vCPUs: 2
	  Memory: 8.0 GB
	  Network: Up to 10 Gigabit
	  Price: pricing varies

config TERRAFORM_AWS_INSTANCE_M5A_XLARGE
	bool "m5a.xlarge"
	help
	  vCPUs: 4
	  Memory: 16.0 GB
	  Network: Up to 10 Gigabit
	  Price: pricing varies

config TERRAFORM_AWS_INSTANCE_M5A_2XLARGE
	bool "m5a.2xlarge"
	help
	  vCPUs: 8
	  Memory: 32.0 GB
	  Network: Up to 10 Gigabit
	  Price: pricing varies

config TERRAFORM_AWS_INSTANCE_M5A_4XLARGE
	bool "m5a.4xlarge"
	help
	  vCPUs: 16
	  Memory: 64.0 GB
	  Network: Up to 10 Gigabit
	  Price: pricing varies

config TERRAFORM_AWS_INSTANCE_M5A_8XLARGE
	bool "m5a.8xlarge"
	help
	  vCPUs: 32
	  Memory: 128.0 GB
	  Network: Up to 10 Gigabit
	  Price: pricing varies

config TERRAFORM_AWS_INSTANCE_M5A_12XLARGE
	bool "m5a.12xlarge"
	help
	  vCPUs: 48
	  Memory: 192.0 GB
	  Network: 10 Gigabit
	  Price: pricing varies

config TERRAFORM_AWS_INSTANCE_M5A_16XLARGE
	bool "m5a.16xlarge"
	help
	  vCPUs: 64
	  Memory: 256.0 GB
	  Network: 12 Gigabit
	  Price: pricing varies

config TERRAFORM_AWS_INSTANCE_M5A_24XLARGE
	bool "m5a.24xlarge"
	help
	  vCPUs: 96
	  Memory: 384.0 GB
	  Network: 20 Gigabit
	  Price: pricing varies

endchoice

config TERRAFORM_AWS_M5A_SIZE
	string
	default "m5a.large" if TERRAFORM_AWS_INSTANCE_M5A_LARGE
	default "m5a.xlarge" if TERRAFORM_AWS_INSTANCE_M5A_XLARGE
	default "m5a.2xlarge" if TERRAFORM_AWS_INSTANCE_M5A_2XLARGE
	default "m5a.4xlarge" if TERRAFORM_AWS_INSTANCE_M5A_4XLARGE
	default "m5a.8xlarge" if TERRAFORM_AWS_INSTANCE_M5A_8XLARGE
	default "m5a.12xlarge" if TERRAFORM_AWS_INSTANCE_M5A_12XLARGE
	default "m5a.16xlarge" if TERRAFORM_AWS_INSTANCE_M5A_16XLARGE
	default "m5a.24xlarge" if TERRAFORM_AWS_INSTANCE_M5A_24XLARGE
	default "m5a.large"
```

## terraform/aws/kconfigs/instance-types/Kconfig.m5ad.static
```kconfig
# AWS M5AD instance sizes (dynamically generated)

choice
	prompt "Instance size for M5AD family"
	default TERRAFORM_AWS_INSTANCE_M5AD_LARGE
	help
	  Select the specific instance size within the M5AD family.

config TERRAFORM_AWS_INSTANCE_M5AD_LARGE
	bool "m5ad.large"
	help
	  vCPUs: 2
	  Memory: 8.0 GB
	  Network: Up to 10 Gigabit
	  Price: pricing varies
	  Instance storage: 75 GB

config TERRAFORM_AWS_INSTANCE_M5AD_XLARGE
	bool "m5ad.xlarge"
	help
	  vCPUs: 4
	  Memory: 16.0 GB
	  Network: Up to 10 Gigabit
	  Price: pricing varies
	  Instance storage: 150 GB

config TERRAFORM_AWS_INSTANCE_M5AD_2XLARGE
	bool "m5ad.2xlarge"
	help
	  vCPUs: 8
	  Memory: 32.0 GB
	  Network: Up to 10 Gigabit
	  Price: pricing varies
	  Instance storage: 300 GB

config TERRAFORM_AWS_INSTANCE_M5AD_4XLARGE
	bool "m5ad.4xlarge"
	help
	  vCPUs: 16
	  Memory: 64.0 GB
	  Network: Up to 10 Gigabit
	  Price: pricing varies
	  Instance storage: 600 GB

config TERRAFORM_AWS_INSTANCE_M5AD_8XLARGE
	bool "m5ad.8xlarge"
	help
	  vCPUs: 32
	  Memory: 128.0 GB
	  Network: Up to 10 Gigabit
	  Price: pricing varies
	  Instance storage: 1200 GB

config TERRAFORM_AWS_INSTANCE_M5AD_12XLARGE
	bool "m5ad.12xlarge"
	help
	  vCPUs: 48
	  Memory: 192.0 GB
	  Network: 10 Gigabit
	  Price: pricing varies
	  Instance storage: 1800 GB

config TERRAFORM_AWS_INSTANCE_M5AD_16XLARGE
	bool "m5ad.16xlarge"
	help
	  vCPUs: 64
	  Memory: 256.0 GB
	  Network: 12 Gigabit
	  Price: pricing varies
	  Instance storage: 2400 GB

config TERRAFORM_AWS_INSTANCE_M5AD_24XLARGE
	bool "m5ad.24xlarge"
	help
	  vCPUs: 96
	  Memory: 384.0 GB
	  Network: 20 Gigabit
	  Price: pricing varies
	  Instance storage: 3600 GB

endchoice

config TERRAFORM_AWS_M5AD_SIZE
	string
	default "m5ad.large" if TERRAFORM_AWS_INSTANCE_M5AD_LARGE
	default "m5ad.xlarge" if TERRAFORM_AWS_INSTANCE_M5AD_XLARGE
	default "m5ad.2xlarge" if TERRAFORM_AWS_INSTANCE_M5AD_2XLARGE
	default "m5ad.4xlarge" if TERRAFORM_AWS_INSTANCE_M5AD_4XLARGE
	default "m5ad.8xlarge" if TERRAFORM_AWS_INSTANCE_M5AD_8XLARGE
	default "m5ad.12xlarge" if TERRAFORM_AWS_INSTANCE_M5AD_12XLARGE
	default "m5ad.16xlarge" if TERRAFORM_AWS_INSTANCE_M5AD_16XLARGE
	default "m5ad.24xlarge" if TERRAFORM_AWS_INSTANCE_M5AD_24XLARGE
	default "m5ad.large"
```

## terraform/aws/kconfigs/instance-types/Kconfig.m5d.static
```kconfig
# AWS M5D instance sizes (dynamically generated)

choice
	prompt "Instance size for M5D family"
	default TERRAFORM_AWS_INSTANCE_M5D_LARGE
	help
	  Select the specific instance size within the M5D family.

config TERRAFORM_AWS_INSTANCE_M5D_LARGE
	bool "m5d.large"
	help
	  vCPUs: 2
	  Memory: 8.0 GB
	  Network: Up to 10 Gigabit
	  Price: pricing varies
	  Instance storage: 75 GB

config TERRAFORM_AWS_INSTANCE_M5D_XLARGE
	bool "m5d.xlarge"
	help
	  vCPUs: 4
	  Memory: 16.0 GB
	  Network: Up to 10 Gigabit
	  Price: pricing varies
	  Instance storage: 150 GB

config TERRAFORM_AWS_INSTANCE_M5D_2XLARGE
	bool "m5d.2xlarge"
	help
	  vCPUs: 8
	  Memory: 32.0 GB
	  Network: Up to 10 Gigabit
	  Price: pricing varies
	  Instance storage: 300 GB

config TERRAFORM_AWS_INSTANCE_M5D_4XLARGE
	bool "m5d.4xlarge"
	help
	  vCPUs: 16
	  Memory: 64.0 GB
	  Network: Up to 10 Gigabit
	  Price: pricing varies
	  Instance storage: 600 GB

config TERRAFORM_AWS_INSTANCE_M5D_8XLARGE
	bool "m5d.8xlarge"
	help
	  vCPUs: 32
	  Memory: 128.0 GB
	  Network: 10 Gigabit
	  Price: pricing varies
	  Instance storage: 1200 GB

config TERRAFORM_AWS_INSTANCE_M5D_12XLARGE
	bool "m5d.12xlarge"
	help
	  vCPUs: 48
	  Memory: 192.0 GB
	  Network: 12 Gigabit
	  Price: pricing varies
	  Instance storage: 1800 GB

config TERRAFORM_AWS_INSTANCE_M5D_16XLARGE
	bool "m5d.16xlarge"
	help
	  vCPUs: 64
	  Memory: 256.0 GB
	  Network: 20 Gigabit
	  Price: pricing varies
	  Instance storage: 2400 GB

config TERRAFORM_AWS_INSTANCE_M5D_METAL
	bool "m5d.metal"
	help
	  vCPUs: 96
	  Memory: 384.0 GB
	  Network: 25 Gigabit
	  Price: pricing varies
	  Instance storage: 3600 GB

config TERRAFORM_AWS_INSTANCE_M5D_24XLARGE
	bool "m5d.24xlarge"
	help
	  vCPUs: 96
	  Memory: 384.0 GB
	  Network: 25 Gigabit
	  Price: pricing varies
	  Instance storage: 3600 GB

endchoice

config TERRAFORM_AWS_M5D_SIZE
	string
	default "m5d.large" if TERRAFORM_AWS_INSTANCE_M5D_LARGE
	default "m5d.xlarge" if TERRAFORM_AWS_INSTANCE_M5D_XLARGE
	default "m5d.2xlarge" if TERRAFORM_AWS_INSTANCE_M5D_2XLARGE
	default "m5d.4xlarge" if TERRAFORM_AWS_INSTANCE_M5D_4XLARGE
	default "m5d.8xlarge" if TERRAFORM_AWS_INSTANCE_M5D_8XLARGE
	default "m5d.12xlarge" if TERRAFORM_AWS_INSTANCE_M5D_12XLARGE
	default "m5d.16xlarge" if TERRAFORM_AWS_INSTANCE_M5D_16XLARGE
	default "m5d.metal" if TERRAFORM_AWS_INSTANCE_M5D_METAL
	default "m5d.24xlarge" if TERRAFORM_AWS_INSTANCE_M5D_24XLARGE
	default "m5d.large"
```

## terraform/aws/kconfigs/instance-types/Kconfig.m5dn.static
```kconfig
# AWS M5DN instance sizes (dynamically generated)

choice
	prompt "Instance size for M5DN family"
	default TERRAFORM_AWS_INSTANCE_M5DN_LARGE
	help
	  Select the specific instance size within the M5DN family.

config TERRAFORM_AWS_INSTANCE_M5DN_LARGE
	bool "m5dn.large"
	help
	  vCPUs: 2
	  Memory: 8.0 GB
	  Network: Up to 25 Gigabit
	  Price: pricing varies
	  Instance storage: 75 GB

config TERRAFORM_AWS_INSTANCE_M5DN_XLARGE
	bool "m5dn.xlarge"
	help
	  vCPUs: 4
	  Memory: 16.0 GB
	  Network: Up to 25 Gigabit
	  Price: pricing varies
	  Instance storage: 150 GB

config TERRAFORM_AWS_INSTANCE_M5DN_2XLARGE
	bool "m5dn.2xlarge"
	help
	  vCPUs: 8
	  Memory: 32.0 GB
	  Network: Up to 25 Gigabit
	  Price: pricing varies
	  Instance storage: 300 GB

config TERRAFORM_AWS_INSTANCE_M5DN_4XLARGE
	bool "m5dn.4xlarge"
	help
	  vCPUs: 16
	  Memory: 64.0 GB
	  Network: Up to 25 Gigabit
	  Price: pricing varies
	  Instance storage: 600 GB

config TERRAFORM_AWS_INSTANCE_M5DN_8XLARGE
	bool "m5dn.8xlarge"
	help
	  vCPUs: 32
	  Memory: 128.0 GB
	  Network: 25 Gigabit
	  Price: pricing varies
	  Instance storage: 1200 GB

config TERRAFORM_AWS_INSTANCE_M5DN_12XLARGE
	bool "m5dn.12xlarge"
	help
	  vCPUs: 48
	  Memory: 192.0 GB
	  Network: 50 Gigabit
	  Price: pricing varies
	  Instance storage: 1800 GB

config TERRAFORM_AWS_INSTANCE_M5DN_16XLARGE
	bool "m5dn.16xlarge"
	help
	  vCPUs: 64
	  Memory: 256.0 GB
	  Network: 75 Gigabit
	  Price: pricing varies
	  Instance storage: 2400 GB

config TERRAFORM_AWS_INSTANCE_M5DN_METAL
	bool "m5dn.metal"
	help
	  vCPUs: 96
	  Memory: 384.0 GB
	  Network: 100 Gigabit
	  Price: pricing varies
	  Instance storage: 3600 GB

config TERRAFORM_AWS_INSTANCE_M5DN_24XLARGE
	bool "m5dn.24xlarge"
	help
	  vCPUs: 96
	  Memory: 384.0 GB
	  Network: 100 Gigabit
	  Price: pricing varies
	  Instance storage: 3600 GB

endchoice

config TERRAFORM_AWS_M5DN_SIZE
	string
	default "m5dn.large" if TERRAFORM_AWS_INSTANCE_M5DN_LARGE
	default "m5dn.xlarge" if TERRAFORM_AWS_INSTANCE_M5DN_XLARGE
	default "m5dn.2xlarge" if TERRAFORM_AWS_INSTANCE_M5DN_2XLARGE
	default "m5dn.4xlarge" if TERRAFORM_AWS_INSTANCE_M5DN_4XLARGE
	default "m5dn.8xlarge" if TERRAFORM_AWS_INSTANCE_M5DN_8XLARGE
	default "m5dn.12xlarge" if TERRAFORM_AWS_INSTANCE_M5DN_12XLARGE
	default "m5dn.16xlarge" if TERRAFORM_AWS_INSTANCE_M5DN_16XLARGE
	default "m5dn.metal" if TERRAFORM_AWS_INSTANCE_M5DN_METAL
	default "m5dn.24xlarge" if TERRAFORM_AWS_INSTANCE_M5DN_24XLARGE
	default "m5dn.large"
```

## terraform/aws/kconfigs/instance-types/Kconfig.m5n.static
```kconfig
# AWS M5N instance sizes (dynamically generated)

choice
	prompt "Instance size for M5N family"
	default TERRAFORM_AWS_INSTANCE_M5N_LARGE
	help
	  Select the specific instance size within the M5N family.

config TERRAFORM_AWS_INSTANCE_M5N_LARGE
	bool "m5n.large"
	help
	  vCPUs: 2
	  Memory: 8.0 GB
	  Network: Up to 25 Gigabit
	  Price: pricing varies

config TERRAFORM_AWS_INSTANCE_M5N_XLARGE
	bool "m5n.xlarge"
	help
	  vCPUs: 4
	  Memory: 16.0 GB
	  Network: Up to 25 Gigabit
	  Price: pricing varies

config TERRAFORM_AWS_INSTANCE_M5N_2XLARGE
	bool "m5n.2xlarge"
	help
	  vCPUs: 8
	  Memory: 32.0 GB
	  Network: Up to 25 Gigabit
	  Price: pricing varies

config TERRAFORM_AWS_INSTANCE_M5N_4XLARGE
	bool "m5n.4xlarge"
	help
	  vCPUs: 16
	  Memory: 64.0 GB
	  Network: Up to 25 Gigabit
	  Price: pricing varies

config TERRAFORM_AWS_INSTANCE_M5N_8XLARGE
	bool "m5n.8xlarge"
	help
	  vCPUs: 32
	  Memory: 128.0 GB
	  Network: 25 Gigabit
	  Price: pricing varies

config TERRAFORM_AWS_INSTANCE_M5N_12XLARGE
	bool "m5n.12xlarge"
	help
	  vCPUs: 48
	  Memory: 192.0 GB
	  Network: 50 Gigabit
	  Price: pricing varies

config TERRAFORM_AWS_INSTANCE_M5N_16XLARGE
	bool "m5n.16xlarge"
	help
	  vCPUs: 64
	  Memory: 256.0 GB
	  Network: 75 Gigabit
	  Price: pricing varies

config TERRAFORM_AWS_INSTANCE_M5N_METAL
	bool "m5n.metal"
	help
	  vCPUs: 96
	  Memory: 384.0 GB
	  Network: 100 Gigabit
	  Price: pricing varies

config TERRAFORM_AWS_INSTANCE_M5N_24XLARGE
	bool "m5n.24xlarge"
	help
	  vCPUs: 96
	  Memory: 384.0 GB
	  Network: 100 Gigabit
	  Price: pricing varies

endchoice

config TERRAFORM_AWS_M5N_SIZE
	string
	default "m5n.large" if TERRAFORM_AWS_INSTANCE_M5N_LARGE
	default "m5n.xlarge" if TERRAFORM_AWS_INSTANCE_M5N_XLARGE
	default "m5n.2xlarge" if TERRAFORM_AWS_INSTANCE_M5N_2XLARGE
	default "m5n.4xlarge" if TERRAFORM_AWS_INSTANCE_M5N_4XLARGE
	default "m5n.8xlarge" if TERRAFORM_AWS_INSTANCE_M5N_8XLARGE
	default "m5n.12xlarge" if TERRAFORM_AWS_INSTANCE_M5N_12XLARGE
	default "m5n.16xlarge" if TERRAFORM_AWS_INSTANCE_M5N_16XLARGE
	default "m5n.metal" if TERRAFORM_AWS_INSTANCE_M5N_METAL
	default "m5n.24xlarge" if TERRAFORM_AWS_INSTANCE_M5N_24XLARGE
	default "m5n.large"
```
