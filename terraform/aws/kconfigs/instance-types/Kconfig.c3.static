## terraform/aws/kconfigs/instance-types/Kconfig.c3.static
```kconfig
# AWS C3 instance sizes (dynamically generated)

choice
	prompt "Instance size for C3 family"
	default TERRAFORM_AWS_INSTANCE_C3_LARGE
	help
	  Select the specific instance size within the C3 family.

config TERRAFORM_AWS_INSTANCE_C3_LARGE
	bool "c3.large"
	help
	  vCPUs: 2
	  Memory: 3.8 GB
	  Network: Moderate
	  Price: pricing varies
	  Instance storage: 32 GB

config TERRAFORM_AWS_INSTANCE_C3_XLARGE
	bool "c3.xlarge"
	help
	  vCPUs: 4
	  Memory: 7.5 GB
	  Network: Moderate
	  Price: pricing varies
	  Instance storage: 80 GB

config TERRAFORM_AWS_INSTANCE_C3_2XLARGE
	bool "c3.2xlarge"
	help
	  vCPUs: 8
	  Memory: 15.0 GB
	  Network: High
	  Price: pricing varies
	  Instance storage: 160 GB

config TERRAFORM_AWS_INSTANCE_C3_4XLARGE
	bool "c3.4xlarge"
	help
	  vCPUs: 16
	  Memory: 30.0 GB
	  Network: High
	  Price: pricing varies
	  Instance storage: 320 GB

config TERRAFORM_AWS_INSTANCE_C3_8XLARGE
	bool "c3.8xlarge"
	help
	  vCPUs: 32
	  Memory: 60.0 GB
	  Network: 10 Gigabit
	  Price: pricing varies
	  Instance storage: 640 GB

endchoice

config TERRAFORM_AWS_C3_SIZE
	string
	default "c3.large" if TERRAFORM_AWS_INSTANCE_C3_LARGE
	default "c3.xlarge" if TERRAFORM_AWS_INSTANCE_C3_XLARGE
	default "c3.2xlarge" if TERRAFORM_AWS_INSTANCE_C3_2XLARGE
	default "c3.4xlarge" if TERRAFORM_AWS_INSTANCE_C3_4XLARGE
	default "c3.8xlarge" if TERRAFORM_AWS_INSTANCE_C3_8XLARGE
	default "c3.large"
```

## terraform/aws/kconfigs/instance-types/Kconfig.c4.static
```kconfig
# AWS C4 instance sizes (dynamically generated)

choice
	prompt "Instance size for C4 family"
	default TERRAFORM_AWS_INSTANCE_C4_LARGE
	help
	  Select the specific instance size within the C4 family.

config TERRAFORM_AWS_INSTANCE_C4_LARGE
	bool "c4.large"
	help
	  vCPUs: 2
	  Memory: 3.8 GB
	  Network: Moderate
	  Price: pricing varies

config TERRAFORM_AWS_INSTANCE_C4_XLARGE
	bool "c4.xlarge"
	help
	  vCPUs: 4
	  Memory: 7.5 GB
	  Network: High
	  Price: pricing varies

config TERRAFORM_AWS_INSTANCE_C4_2XLARGE
	bool "c4.2xlarge"
	help
	  vCPUs: 8
	  Memory: 15.0 GB
	  Network: High
	  Price: pricing varies

config TERRAFORM_AWS_INSTANCE_C4_4XLARGE
	bool "c4.4xlarge"
	help
	  vCPUs: 16
	  Memory: 30.0 GB
	  Network: High
	  Price: pricing varies

config TERRAFORM_AWS_INSTANCE_C4_8XLARGE
	bool "c4.8xlarge"
	help
	  vCPUs: 36
	  Memory: 60.0 GB
	  Network: 10 Gigabit
	  Price: pricing varies

endchoice

config TERRAFORM_AWS_C4_SIZE
	string
	default "c4.large" if TERRAFORM_AWS_INSTANCE_C4_LARGE
	default "c4.xlarge" if TERRAFORM_AWS_INSTANCE_C4_XLARGE
	default "c4.2xlarge" if TERRAFORM_AWS_INSTANCE_C4_2XLARGE
	default "c4.4xlarge" if TERRAFORM_AWS_INSTANCE_C4_4XLARGE
	default "c4.8xlarge" if TERRAFORM_AWS_INSTANCE_C4_8XLARGE
	default "c4.large"
```

## terraform/aws/kconfigs/instance-types/Kconfig.c5.static
```kconfig
# AWS C5 instance sizes (dynamically generated)

choice
	prompt "Instance size for C5 family"
	default TERRAFORM_AWS_INSTANCE_C5_LARGE
	help
	  Select the specific instance size within the C5 family.

config TERRAFORM_AWS_INSTANCE_C5_LARGE
	bool "c5.large"
	help
	  vCPUs: 2
	  Memory: 4.0 GB
	  Network: Up to 10 Gigabit
	  Price: $0.085/hour

config TERRAFORM_AWS_INSTANCE_C5_XLARGE
	bool "c5.xlarge"
	help
	  vCPUs: 4
	  Memory: 8.0 GB
	  Network: Up to 10 Gigabit
	  Price: $0.170/hour

config TERRAFORM_AWS_INSTANCE_C5_2XLARGE
	bool "c5.2xlarge"
	help
	  vCPUs: 8
	  Memory: 16.0 GB
	  Network: Up to 10 Gigabit
	  Price: $0.340/hour

config TERRAFORM_AWS_INSTANCE_C5_4XLARGE
	bool "c5.4xlarge"
	help
	  vCPUs: 16
	  Memory: 32.0 GB
	  Network: Up to 10 Gigabit
	  Price: $0.680/hour

config TERRAFORM_AWS_INSTANCE_C5_9XLARGE
	bool "c5.9xlarge"
	help
	  vCPUs: 36
	  Memory: 72.0 GB
	  Network: 12 Gigabit
	  Price: $1.530/hour

config TERRAFORM_AWS_INSTANCE_C5_12XLARGE
	bool "c5.12xlarge"
	help
	  vCPUs: 48
	  Memory: 96.0 GB
	  Network: 12 Gigabit
	  Price: $2.040/hour

config TERRAFORM_AWS_INSTANCE_C5_18XLARGE
	bool "c5.18xlarge"
	help
	  vCPUs: 72
	  Memory: 144.0 GB
	  Network: 25 Gigabit
	  Price: $3.060/hour

config TERRAFORM_AWS_INSTANCE_C5_24XLARGE
	bool "c5.24xlarge"
	help
	  vCPUs: 96
	  Memory: 192.0 GB
	  Network: 25 Gigabit
	  Price: $4.080/hour

config TERRAFORM_AWS_INSTANCE_C5_METAL
	bool "c5.metal"
	help
	  vCPUs: 96
	  Memory: 192.0 GB
	  Network: 25 Gigabit
	  Price: pricing varies

endchoice

config TERRAFORM_AWS_C5_SIZE
	string
	default "c5.large" if TERRAFORM_AWS_INSTANCE_C5_LARGE
	default "c5.xlarge" if TERRAFORM_AWS_INSTANCE_C5_XLARGE
	default "c5.2xlarge" if TERRAFORM_AWS_INSTANCE_C5_2XLARGE
	default "c5.4xlarge" if TERRAFORM_AWS_INSTANCE_C5_4XLARGE
	default "c5.9xlarge" if TERRAFORM_AWS_INSTANCE_C5_9XLARGE
	default "c5.12xlarge" if TERRAFORM_AWS_INSTANCE_C5_12XLARGE
	default "c5.18xlarge" if TERRAFORM_AWS_INSTANCE_C5_18XLARGE
	default "c5.24xlarge" if TERRAFORM_AWS_INSTANCE_C5_24XLARGE
	default "c5.metal" if TERRAFORM_AWS_INSTANCE_C5_METAL
	default "c5.large"
```

## terraform/aws/kconfigs/instance-types/Kconfig.c5a.static
```kconfig
# AWS C5A instance sizes (dynamically generated)

choice
	prompt "Instance size for C5A family"
	default TERRAFORM_AWS_INSTANCE_C5A_LARGE
	help
	  Select the specific instance size within the C5A family.

config TERRAFORM_AWS_INSTANCE_C5A_LARGE
	bool "c5a.large"
	help
	  vCPUs: 2
	  Memory: 4.0 GB
	  Network: Up to 10 Gigabit
	  Price: pricing varies

config TERRAFORM_AWS_INSTANCE_C5A_XLARGE
	bool "c5a.xlarge"
	help
	  vCPUs: 4
	  Memory: 8.0 GB
	  Network: Up to 10 Gigabit
	  Price: pricing varies

config TERRAFORM_AWS_INSTANCE_C5A_2XLARGE
	bool "c5a.2xlarge"
	help
	  vCPUs: 8
	  Memory: 16.0 GB
	  Network: Up to 10 Gigabit
	  Price: pricing varies

config TERRAFORM_AWS_INSTANCE_C5A_4XLARGE
	bool "c5a.4xlarge"
	help
	  vCPUs: 16
	  Memory: 32.0 GB
	  Network: Up to 10 Gigabit
	  Price: pricing varies

config TERRAFORM_AWS_INSTANCE_C5A_8XLARGE
	bool "c5a.8xlarge"
	help
	  vCPUs: 32
	  Memory: 64.0 GB
	  Network: 10 Gigabit
	  Price: pricing varies

config TERRAFORM_AWS_INSTANCE_C5A_12XLARGE
	bool "c5a.12xlarge"
	help
	  vCPUs: 48
	  Memory: 96.0 GB
	  Network: 12 Gigabit
	  Price: pricing varies

config TERRAFORM_AWS_INSTANCE_C5A_16XLARGE
	bool "c5a.16xlarge"
	help
	  vCPUs: 64
	  Memory: 128.0 GB
	  Network: 20 Gigabit
	  Price: pricing varies

config TERRAFORM_AWS_INSTANCE_C5A_24XLARGE
	bool "c5a.24xlarge"
	help
	  vCPUs: 96
	  Memory: 192.0 GB
	  Network: 20 Gigabit
	  Price: pricing varies

endchoice

config TERRAFORM_AWS_C5A_SIZE
	string
	default "c5a.large" if TERRAFORM_AWS_INSTANCE_C5A_LARGE
	default "c5a.xlarge" if TERRAFORM_AWS_INSTANCE_C5A_XLARGE
	default "c5a.2xlarge" if TERRAFORM_AWS_INSTANCE_C5A_2XLARGE
	default "c5a.4xlarge" if TERRAFORM_AWS_INSTANCE_C5A_4XLARGE
	default "c5a.8xlarge" if TERRAFORM_AWS_INSTANCE_C5A_8XLARGE
	default "c5a.12xlarge" if TERRAFORM_AWS_INSTANCE_C5A_12XLARGE
	default "c5a.16xlarge" if TERRAFORM_AWS_INSTANCE_C5A_16XLARGE
	default "c5a.24xlarge" if TERRAFORM_AWS_INSTANCE_C5A_24XLARGE
	default "c5a.large"
```

## terraform/aws/kconfigs/instance-types/Kconfig.c5ad.static
```kconfig
# AWS C5AD instance sizes (dynamically generated)

choice
	prompt "Instance size for C5AD family"
	default TERRAFORM_AWS_INSTANCE_C5AD_LARGE
	help
	  Select the specific instance size within the C5AD family.

config TERRAFORM_AWS_INSTANCE_C5AD_LARGE
	bool "c5ad.large"
	help
	  vCPUs: 2
	  Memory: 4.0 GB
	  Network: Up to 10 Gigabit
	  Price: pricing varies
	  Instance storage: 75 GB

config TERRAFORM_AWS_INSTANCE_C5AD_XLARGE
	bool "c5ad.xlarge"
	help
	  vCPUs: 4
	  Memory: 8.0 GB
	  Network: Up to 10 Gigabit
	  Price: pricing varies
	  Instance storage: 150 GB

config TERRAFORM_AWS_INSTANCE_C5AD_2XLARGE
	bool "c5ad.2xlarge"
	help
	  vCPUs: 8
	  Memory: 16.0 GB
	  Network: Up to 10 Gigabit
	  Price: pricing varies
	  Instance storage: 300 GB

config TERRAFORM_AWS_INSTANCE_C5AD_4XLARGE
	bool "c5ad.4xlarge"
	help
	  vCPUs: 16
	  Memory: 32.0 GB
	  Network: Up to 10 Gigabit
	  Price: pricing varies
	  Instance storage: 600 GB

config TERRAFORM_AWS_INSTANCE_C5AD_8XLARGE
	bool "c5ad.8xlarge"
	help
	  vCPUs: 32
	  Memory: 64.0 GB
	  Network: 10 Gigabit
	  Price: pricing varies
	  Instance storage: 1200 GB

config TERRAFORM_AWS_INSTANCE_C5AD_12XLARGE
	bool "c5ad.12xlarge"
	help
	  vCPUs: 48
	  Memory: 96.0 GB
	  Network: 12 Gigabit
	  Price: pricing varies
	  Instance storage: 1800 GB

config TERRAFORM_AWS_INSTANCE_C5AD_16XLARGE
	bool "c5ad.16xlarge"
	help
	  vCPUs: 64
	  Memory: 128.0 GB
	  Network: 20 Gigabit
	  Price: pricing varies
	  Instance storage: 2400 GB

config TERRAFORM_AWS_INSTANCE_C5AD_24XLARGE
	bool "c5ad.24xlarge"
	help
	  vCPUs: 96
	  Memory: 192.0 GB
	  Network: 20 Gigabit
	  Price: pricing varies
	  Instance storage: 3800 GB

endchoice

config TERRAFORM_AWS_C5AD_SIZE
	string
	default "c5ad.large" if TERRAFORM_AWS_INSTANCE_C5AD_LARGE
	default "c5ad.xlarge" if TERRAFORM_AWS_INSTANCE_C5AD_XLARGE
	default "c5ad.2xlarge" if TERRAFORM_AWS_INSTANCE_C5AD_2XLARGE
	default "c5ad.4xlarge" if TERRAFORM_AWS_INSTANCE_C5AD_4XLARGE
	default "c5ad.8xlarge" if TERRAFORM_AWS_INSTANCE_C5AD_8XLARGE
	default "c5ad.12xlarge" if TERRAFORM_AWS_INSTANCE_C5AD_12XLARGE
	default "c5ad.16xlarge" if TERRAFORM_AWS_INSTANCE_C5AD_16XLARGE
	default "c5ad.24xlarge" if TERRAFORM_AWS_INSTANCE_C5AD_24XLARGE
	default "c5ad.large"
```

## terraform/aws/kconfigs/instance-types/Kconfig.c5d.static
```kconfig
# AWS C5D instance sizes (dynamically generated)

choice
	prompt "Instance size for C5D family"
	default TERRAFORM_AWS_INSTANCE_C5D_LARGE
	help
	  Select the specific instance size within the C5D family.

config TERRAFORM_AWS_INSTANCE_C5D_LARGE
	bool "c5d.large"
	help
	  vCPUs: 2
	  Memory: 4.0 GB
	  Network: Up to 10 Gigabit
	  Price: pricing varies
	  Instance storage: 50 GB

config TERRAFORM_AWS_INSTANCE_C5D_XLARGE
	bool "c5d.xlarge"
	help
	  vCPUs: 4
	  Memory: 8.0 GB
	  Network: Up to 10 Gigabit
	  Price: pricing varies
	  Instance storage: 100 GB

config TERRAFORM_AWS_INSTANCE_C5D_2XLARGE
	bool "c5d.2xlarge"
	help
	  vCPUs: 8
	  Memory: 16.0 GB
	  Network: Up to 10 Gigabit
	  Price: pricing varies
	  Instance storage: 200 GB

config TERRAFORM_AWS_INSTANCE_C5D_4XLARGE
	bool "c5d.4xlarge"
	help
	  vCPUs: 16
	  Memory: 32.0 GB
	  Network: Up to 10 Gigabit
	  Price: pricing varies
	  Instance storage: 400 GB

config TERRAFORM_AWS_INSTANCE_C5D_9XLARGE
	bool "c5d.9xlarge"
	help
	  vCPUs: 36
	  Memory: 72.0 GB
	  Network: 12 Gigabit
	  Price: pricing varies
	  Instance storage: 900 GB

config TERRAFORM_AWS_INSTANCE_C5D_12XLARGE
	bool "c5d.12xlarge"
	help
	  vCPUs: 48
	  Memory: 96.0 GB
	  Network: 12 Gigabit
	  Price: pricing varies
	  Instance storage: 1800 GB

config TERRAFORM_AWS_INSTANCE_C5D_18XLARGE
	bool "c5d.18xlarge"
	help
	  vCPUs: 72
	  Memory: 144.0 GB
	  Network: 25 Gigabit
	  Price: pricing varies
	  Instance storage: 1800 GB

config TERRAFORM_AWS_INSTANCE_C5D_24XLARGE
	bool "c5d.24xlarge"
	help
	  vCPUs: 96
	  Memory: 192.0 GB
	  Network: 25 Gigabit
	  Price: pricing varies
	  Instance storage: 3600 GB

config TERRAFORM_AWS_INSTANCE_C5D_METAL
	bool "c5d.metal"
	help
	  vCPUs: 96
	  Memory: 192.0 GB
	  Network: 25 Gigabit
	  Price: pricing varies
	  Instance storage: 3600 GB

endchoice

config TERRAFORM_AWS_C5D_SIZE
	string
	default "c5d.large" if TERRAFORM_AWS_INSTANCE_C5D_LARGE
	default "c5d.xlarge" if TERRAFORM_AWS_INSTANCE_C5D_XLARGE
	default "c5d.2xlarge" if TERRAFORM_AWS_INSTANCE_C5D_2XLARGE
	default "c5d.4xlarge" if TERRAFORM_AWS_INSTANCE_C5D_4XLARGE
	default "c5d.9xlarge" if TERRAFORM_AWS_INSTANCE_C5D_9XLARGE
	default "c5d.12xlarge" if TERRAFORM_AWS_INSTANCE_C5D_12XLARGE
	default "c5d.18xlarge" if TERRAFORM_AWS_INSTANCE_C5D_18XLARGE
	default "c5d.24xlarge" if TERRAFORM_AWS_INSTANCE_C5D_24XLARGE
	default "c5d.metal" if TERRAFORM_AWS_INSTANCE_C5D_METAL
	default "c5d.large"
```

## terraform/aws/kconfigs/instance-types/Kconfig.c5n.static
```kconfig
# AWS C5N instance sizes (dynamically generated)

choice
	prompt "Instance size for C5N family"
	default TERRAFORM_AWS_INSTANCE_C5N_LARGE
	help
	  Select the specific instance size within the C5N family.

config TERRAFORM_AWS_INSTANCE_C5N_LARGE
	bool "c5n.large"
	help
	  vCPUs: 2
	  Memory: 5.2 GB
	  Network: Up to 25 Gigabit
	  Price: pricing varies

config TERRAFORM_AWS_INSTANCE_C5N_XLARGE
	bool "c5n.xlarge"
	help
	  vCPUs: 4
	  Memory: 10.5 GB
	  Network: Up to 25 Gigabit
	  Price: pricing varies

config TERRAFORM_AWS_INSTANCE_C5N_2XLARGE
	bool "c5n.2xlarge"
	help
	  vCPUs: 8
	  Memory: 21.0 GB
	  Network: Up to 25 Gigabit
	  Price: pricing varies

config TERRAFORM_AWS_INSTANCE_C5N_4XLARGE
	bool "c5n.4xlarge"
	help
	  vCPUs: 16
	  Memory: 42.0 GB
	  Network: Up to 25 Gigabit
	  Price: pricing varies

config TERRAFORM_AWS_INSTANCE_C5N_9XLARGE
	bool "c5n.9xlarge"
	help
	  vCPUs: 36
	  Memory: 96.0 GB
	  Network: 50 Gigabit
	  Price: pricing varies

config TERRAFORM_AWS_INSTANCE_C5N_18XLARGE
	bool "c5n.18xlarge"
	help
	  vCPUs: 72
	  Memory: 192.0 GB
	  Network: 100 Gigabit
	  Price: pricing varies

config TERRAFORM_AWS_INSTANCE_C5N_METAL
	bool "c5n.metal"
	help
	  vCPUs: 72
	  Memory: 192.0 GB
	  Network: 100 Gigabit
	  Price: pricing varies

endchoice

config TERRAFORM_AWS_C5N_SIZE
	string
	default "c5n.large" if TERRAFORM_AWS_INSTANCE_C5N_LARGE
	default "c5n.xlarge" if TERRAFORM_AWS_INSTANCE_C5N_XLARGE
	default "c5n.2xlarge" if TERRAFORM_AWS_INSTANCE_C5N_2XLARGE
	default "c5n.4xlarge" if TERRAFORM_AWS_INSTANCE_C5N_4XLARGE
	default "c5n.9xlarge" if TERRAFORM_AWS_INSTANCE_C5N_9XLARGE
	default "c5n.18xlarge" if TERRAFORM_AWS_INSTANCE_C5N_18XLARGE
	default "c5n.metal" if TERRAFORM_AWS_INSTANCE_C5N_METAL
	default "c5n.large"
```
