## terraform/aws/kconfigs/instance-types/Kconfig.c6a.static
```kconfig
# AWS C6A instance sizes (dynamically generated)

choice
	prompt "Instance size for C6A family"
	default TERRAFORM_AWS_INSTANCE_C6A_LARGE
	help
	  Select the specific instance size within the C6A family.

config TERRAFORM_AWS_INSTANCE_C6A_LARGE
	bool "c6a.large"
	help
	  vCPUs: 2
	  Memory: 4.0 GB
	  Network: Up to 12.5 Gigabit
	  Price: pricing varies

config TERRAFORM_AWS_INSTANCE_C6A_XLARGE
	bool "c6a.xlarge"
	help
	  vCPUs: 4
	  Memory: 8.0 GB
	  Network: Up to 12.5 Gigabit
	  Price: pricing varies

config TERRAFORM_AWS_INSTANCE_C6A_2XLARGE
	bool "c6a.2xlarge"
	help
	  vCPUs: 8
	  Memory: 16.0 GB
	  Network: Up to 12.5 Gigabit
	  Price: pricing varies

config TERRAFORM_AWS_INSTANCE_C6A_4XLARGE
	bool "c6a.4xlarge"
	help
	  vCPUs: 16
	  Memory: 32.0 GB
	  Network: Up to 12.5 Gigabit
	  Price: pricing varies

config TERRAFORM_AWS_INSTANCE_C6A_8XLARGE
	bool "c6a.8xlarge"
	help
	  vCPUs: 32
	  Memory: 64.0 GB
	  Network: 12.5 Gigabit
	  Price: pricing varies

config TERRAFORM_AWS_INSTANCE_C6A_12XLARGE
	bool "c6a.12xlarge"
	help
	  vCPUs: 48
	  Memory: 96.0 GB
	  Network: 18.75 Gigabit
	  Price: pricing varies

config TERRAFORM_AWS_INSTANCE_C6A_16XLARGE
	bool "c6a.16xlarge"
	help
	  vCPUs: 64
	  Memory: 128.0 GB
	  Network: 25 Gigabit
	  Price: pricing varies

config TERRAFORM_AWS_INSTANCE_C6A_24XLARGE
	bool "c6a.24xlarge"
	help
	  vCPUs: 96
	  Memory: 192.0 GB
	  Network: 37.5 Gigabit
	  Price: pricing varies

config TERRAFORM_AWS_INSTANCE_C6A_32XLARGE
	bool "c6a.32xlarge"
	help
	  vCPUs: 128
	  Memory: 256.0 GB
	  Network: 50 Gigabit
	  Price: pricing varies

config TERRAFORM_AWS_INSTANCE_C6A_48XLARGE
	bool "c6a.48xlarge"
	help
	  vCPUs: 192
	  Memory: 384.0 GB
	  Network: 50 Gigabit
	  Price: pricing varies

config TERRAFORM_AWS_INSTANCE_C6A_METAL
	bool "c6a.metal"
	help
	  vCPUs: 192
	  Memory: 384.0 GB
	  Network: 50 Gigabit
	  Price: pricing varies

endchoice

config TERRAFORM_AWS_C6A_SIZE
	string
	default "c6a.large" if TERRAFORM_AWS_INSTANCE_C6A_LARGE
	default "c6a.xlarge" if TERRAFORM_AWS_INSTANCE_C6A_XLARGE
	default "c6a.2xlarge" if TERRAFORM_AWS_INSTANCE_C6A_2XLARGE
	default "c6a.4xlarge" if TERRAFORM_AWS_INSTANCE_C6A_4XLARGE
	default "c6a.8xlarge" if TERRAFORM_AWS_INSTANCE_C6A_8XLARGE
	default "c6a.12xlarge" if TERRAFORM_AWS_INSTANCE_C6A_12XLARGE
	default "c6a.16xlarge" if TERRAFORM_AWS_INSTANCE_C6A_16XLARGE
	default "c6a.24xlarge" if TERRAFORM_AWS_INSTANCE_C6A_24XLARGE
	default "c6a.32xlarge" if TERRAFORM_AWS_INSTANCE_C6A_32XLARGE
	default "c6a.48xlarge" if TERRAFORM_AWS_INSTANCE_C6A_48XLARGE
	default "c6a.metal" if TERRAFORM_AWS_INSTANCE_C6A_METAL
	default "c6a.large"
```

## terraform/aws/kconfigs/instance-types/Kconfig.c6g.static
```kconfig
# AWS C6G instance sizes (dynamically generated)

choice
	prompt "Instance size for C6G family"
	default TERRAFORM_AWS_INSTANCE_C6G_MEDIUM
	help
	  Select the specific instance size within the C6G family.

config TERRAFORM_AWS_INSTANCE_C6G_MEDIUM
	bool "c6g.medium"
	help
	  vCPUs: 1
	  Memory: 2.0 GB
	  Network: Up to 10 Gigabit
	  Price: pricing varies

config TERRAFORM_AWS_INSTANCE_C6G_LARGE
	bool "c6g.large"
	help
	  vCPUs: 2
	  Memory: 4.0 GB
	  Network: Up to 10 Gigabit
	  Price: pricing varies

config TERRAFORM_AWS_INSTANCE_C6G_XLARGE
	bool "c6g.xlarge"
	help
	  vCPUs: 4
	  Memory: 8.0 GB
	  Network: Up to 10 Gigabit
	  Price: pricing varies

config TERRAFORM_AWS_INSTANCE_C6G_2XLARGE
	bool "c6g.2xlarge"
	help
	  vCPUs: 8
	  Memory: 16.0 GB
	  Network: Up to 10 Gigabit
	  Price: pricing varies

config TERRAFORM_AWS_INSTANCE_C6G_4XLARGE
	bool "c6g.4xlarge"
	help
	  vCPUs: 16
	  Memory: 32.0 GB
	  Network: Up to 10 Gigabit
	  Price: pricing varies

config TERRAFORM_AWS_INSTANCE_C6G_8XLARGE
	bool "c6g.8xlarge"
	help
	  vCPUs: 32
	  Memory: 64.0 GB
	  Network: 12 Gigabit
	  Price: pricing varies

config TERRAFORM_AWS_INSTANCE_C6G_12XLARGE
	bool "c6g.12xlarge"
	help
	  vCPUs: 48
	  Memory: 96.0 GB
	  Network: 20 Gigabit
	  Price: pricing varies

config TERRAFORM_AWS_INSTANCE_C6G_16XLARGE
	bool "c6g.16xlarge"
	help
	  vCPUs: 64
	  Memory: 128.0 GB
	  Network: 25 Gigabit
	  Price: pricing varies

config TERRAFORM_AWS_INSTANCE_C6G_METAL
	bool "c6g.metal"
	help
	  vCPUs: 64
	  Memory: 128.0 GB
	  Network: 25 Gigabit
	  Price: pricing varies

endchoice

config TERRAFORM_AWS_C6G_SIZE
	string
	default "c6g.medium" if TERRAFORM_AWS_INSTANCE_C6G_MEDIUM
	default "c6g.large" if TERRAFORM_AWS_INSTANCE_C6G_LARGE
	default "c6g.xlarge" if TERRAFORM_AWS_INSTANCE_C6G_XLARGE
	default "c6g.2xlarge" if TERRAFORM_AWS_INSTANCE_C6G_2XLARGE
	default "c6g.4xlarge" if TERRAFORM_AWS_INSTANCE_C6G_4XLARGE
	default "c6g.8xlarge" if TERRAFORM_AWS_INSTANCE_C6G_8XLARGE
	default "c6g.12xlarge" if TERRAFORM_AWS_INSTANCE_C6G_12XLARGE
	default "c6g.16xlarge" if TERRAFORM_AWS_INSTANCE_C6G_16XLARGE
	default "c6g.metal" if TERRAFORM_AWS_INSTANCE_C6G_METAL
	default "c6g.medium"
```

## terraform/aws/kconfigs/instance-types/Kconfig.c6gn.static
```kconfig
# AWS C6GN instance sizes (dynamically generated)

choice
	prompt "Instance size for C6GN family"
	default TERRAFORM_AWS_INSTANCE_C6GN_MEDIUM
	help
	  Select the specific instance size within the C6GN family.

config TERRAFORM_AWS_INSTANCE_C6GN_MEDIUM
	bool "c6gn.medium"
	help
	  vCPUs: 1
	  Memory: 2.0 GB
	  Network: Up to 16 Gigabit
	  Price: pricing varies

config TERRAFORM_AWS_INSTANCE_C6GN_LARGE
	bool "c6gn.large"
	help
	  vCPUs: 2
	  Memory: 4.0 GB
	  Network: Up to 25 Gigabit
	  Price: pricing varies

config TERRAFORM_AWS_INSTANCE_C6GN_XLARGE
	bool "c6gn.xlarge"
	help
	  vCPUs: 4
	  Memory: 8.0 GB
	  Network: Up to 25 Gigabit
	  Price: pricing varies

config TERRAFORM_AWS_INSTANCE_C6GN_2XLARGE
	bool "c6gn.2xlarge"
	help
	  vCPUs: 8
	  Memory: 16.0 GB
	  Network: Up to 25 Gigabit
	  Price: pricing varies

config TERRAFORM_AWS_INSTANCE_C6GN_4XLARGE
	bool "c6gn.4xlarge"
	help
	  vCPUs: 16
	  Memory: 32.0 GB
	  Network: 25 Gigabit
	  Price: pricing varies

config TERRAFORM_AWS_INSTANCE_C6GN_8XLARGE
	bool "c6gn.8xlarge"
	help
	  vCPUs: 32
	  Memory: 64.0 GB
	  Network: 50 Gigabit
	  Price: pricing varies

config TERRAFORM_AWS_INSTANCE_C6GN_12XLARGE
	bool "c6gn.12xlarge"
	help
	  vCPUs: 48
	  Memory: 96.0 GB
	  Network: 75 Gigabit
	  Price: pricing varies

config TERRAFORM_AWS_INSTANCE_C6GN_16XLARGE
	bool "c6gn.16xlarge"
	help
	  vCPUs: 64
	  Memory: 128.0 GB
	  Network: 100 Gigabit
	  Price: pricing varies

endchoice

config TERRAFORM_AWS_C6GN_SIZE
	string
	default "c6gn.medium" if TERRAFORM_AWS_INSTANCE_C6GN_MEDIUM
	default "c6gn.large" if TERRAFORM_AWS_INSTANCE_C6GN_LARGE
	default "c6gn.xlarge" if TERRAFORM_AWS_INSTANCE_C6GN_XLARGE
	default "c6gn.2xlarge" if TERRAFORM_AWS_INSTANCE_C6GN_2XLARGE
	default "c6gn.4xlarge" if TERRAFORM_AWS_INSTANCE_C6GN_4XLARGE
	default "c6gn.8xlarge" if TERRAFORM_AWS_INSTANCE_C6GN_8XLARGE
	default "c6gn.12xlarge" if TERRAFORM_AWS_INSTANCE_C6GN_12XLARGE
	default "c6gn.16xlarge" if TERRAFORM_AWS_INSTANCE_C6GN_16XLARGE
	default "c6gn.medium"
```

## terraform/aws/kconfigs/instance-types/Kconfig.c6i.static
```kconfig
# AWS C6I instance sizes (dynamically generated)

choice
	prompt "Instance size for C6I family"
	default TERRAFORM_AWS_INSTANCE_C6I_LARGE
	help
	  Select the specific instance size within the C6I family.

config TERRAFORM_AWS_INSTANCE_C6I_LARGE
	bool "c6i.large"
	help
	  vCPUs: 2
	  Memory: 4.0 GB
	  Network: Up to 12.5 Gigabit
	  Price: pricing varies

config TERRAFORM_AWS_INSTANCE_C6I_XLARGE
	bool "c6i.xlarge"
	help
	  vCPUs: 4
	  Memory: 8.0 GB
	  Network: Up to 12.5 Gigabit
	  Price: pricing varies

config TERRAFORM_AWS_INSTANCE_C6I_2XLARGE
	bool "c6i.2xlarge"
	help
	  vCPUs: 8
	  Memory: 16.0 GB
	  Network: Up to 12.5 Gigabit
	  Price: pricing varies

config TERRAFORM_AWS_INSTANCE_C6I_4XLARGE
	bool "c6i.4xlarge"
	help
	  vCPUs: 16
	  Memory: 32.0 GB
	  Network: Up to 12.5 Gigabit
	  Price: pricing varies

config TERRAFORM_AWS_INSTANCE_C6I_8XLARGE
	bool "c6i.8xlarge"
	help
	  vCPUs: 32
	  Memory: 64.0 GB
	  Network: 12.5 Gigabit
	  Price: pricing varies

config TERRAFORM_AWS_INSTANCE_C6I_12XLARGE
	bool "c6i.12xlarge"
	help
	  vCPUs: 48
	  Memory: 96.0 GB
	  Network: 18.75 Gigabit
	  Price: pricing varies

config TERRAFORM_AWS_INSTANCE_C6I_16XLARGE
	bool "c6i.16xlarge"
	help
	  vCPUs: 64
	  Memory: 128.0 GB
	  Network: 25 Gigabit
	  Price: pricing varies

config TERRAFORM_AWS_INSTANCE_C6I_24XLARGE
	bool "c6i.24xlarge"
	help
	  vCPUs: 96
	  Memory: 192.0 GB
	  Network: 37.5 Gigabit
	  Price: pricing varies

config TERRAFORM_AWS_INSTANCE_C6I_32XLARGE
	bool "c6i.32xlarge"
	help
	  vCPUs: 128
	  Memory: 256.0 GB
	  Network: 50 Gigabit
	  Price: pricing varies

config TERRAFORM_AWS_INSTANCE_C6I_METAL
	bool "c6i.metal"
	help
	  vCPUs: 128
	  Memory: 256.0 GB
	  Network: 50 Gigabit
	  Price: pricing varies

endchoice

config TERRAFORM_AWS_C6I_SIZE
	string
	default "c6i.large" if TERRAFORM_AWS_INSTANCE_C6I_LARGE
	default "c6i.xlarge" if TERRAFORM_AWS_INSTANCE_C6I_XLARGE
	default "c6i.2xlarge" if TERRAFORM_AWS_INSTANCE_C6I_2XLARGE
	default "c6i.4xlarge" if TERRAFORM_AWS_INSTANCE_C6I_4XLARGE
	default "c6i.8xlarge" if TERRAFORM_AWS_INSTANCE_C6I_8XLARGE
	default "c6i.12xlarge" if TERRAFORM_AWS_INSTANCE_C6I_12XLARGE
	default "c6i.16xlarge" if TERRAFORM_AWS_INSTANCE_C6I_16XLARGE
	default "c6i.24xlarge" if TERRAFORM_AWS_INSTANCE_C6I_24XLARGE
	default "c6i.32xlarge" if TERRAFORM_AWS_INSTANCE_C6I_32XLARGE
	default "c6i.metal" if TERRAFORM_AWS_INSTANCE_C6I_METAL
	default "c6i.large"
```

## terraform/aws/kconfigs/instance-types/Kconfig.c6id.static
```kconfig
# AWS C6ID instance sizes (dynamically generated)

choice
	prompt "Instance size for C6ID family"
	default TERRAFORM_AWS_INSTANCE_C6ID_LARGE
	help
	  Select the specific instance size within the C6ID family.

config TERRAFORM_AWS_INSTANCE_C6ID_LARGE
	bool "c6id.large"
	help
	  vCPUs: 2
	  Memory: 4.0 GB
	  Network: Up to 12.5 Gigabit
	  Price: pricing varies
	  Instance storage: 118 GB

config TERRAFORM_AWS_INSTANCE_C6ID_XLARGE
	bool "c6id.xlarge"
	help
	  vCPUs: 4
	  Memory: 8.0 GB
	  Network: Up to 12.5 Gigabit
	  Price: pricing varies
	  Instance storage: 237 GB

config TERRAFORM_AWS_INSTANCE_C6ID_2XLARGE
	bool "c6id.2xlarge"
	help
	  vCPUs: 8
	  Memory: 16.0 GB
	  Network: Up to 12.5 Gigabit
	  Price: pricing varies
	  Instance storage: 474 GB

config TERRAFORM_AWS_INSTANCE_C6ID_4XLARGE
	bool "c6id.4xlarge"
	help
	  vCPUs: 16
	  Memory: 32.0 GB
	  Network: Up to 12.5 Gigabit
	  Price: pricing varies
	  Instance storage: 950 GB

config TERRAFORM_AWS_INSTANCE_C6ID_8XLARGE
	bool "c6id.8xlarge"
	help
	  vCPUs: 32
	  Memory: 64.0 GB
	  Network: 12.5 Gigabit
	  Price: pricing varies
	  Instance storage: 1900 GB

config TERRAFORM_AWS_INSTANCE_C6ID_12XLARGE
	bool "c6id.12xlarge"
	help
	  vCPUs: 48
	  Memory: 96.0 GB
	  Network: 18.75 Gigabit
	  Price: pricing varies
	  Instance storage: 2850 GB

config TERRAFORM_AWS_INSTANCE_C6ID_16XLARGE
	bool "c6id.16xlarge"
	help
	  vCPUs: 64
	  Memory: 128.0 GB
	  Network: 25 Gigabit
	  Price: pricing varies
	  Instance storage: 3800 GB

config TERRAFORM_AWS_INSTANCE_C6ID_24XLARGE
	bool "c6id.24xlarge"
	help
	  vCPUs: 96
	  Memory: 192.0 GB
	  Network: 37.5 Gigabit
	  Price: pricing varies
	  Instance storage: 5700 GB

config TERRAFORM_AWS_INSTANCE_C6ID_32XLARGE
	bool "c6id.32xlarge"
	help
	  vCPUs: 128
	  Memory: 256.0 GB
	  Network: 50 Gigabit
	  Price: pricing varies
	  Instance storage: 7600 GB

config TERRAFORM_AWS_INSTANCE_C6ID_METAL
	bool "c6id.metal"
	help
	  vCPUs: 128
	  Memory: 256.0 GB
	  Network: 50 Gigabit
	  Price: pricing varies
	  Instance storage: 7600 GB

endchoice

config TERRAFORM_AWS_C6ID_SIZE
	string
	default "c6id.large" if TERRAFORM_AWS_INSTANCE_C6ID_LARGE
	default "c6id.xlarge" if TERRAFORM_AWS_INSTANCE_C6ID_XLARGE
	default "c6id.2xlarge" if TERRAFORM_AWS_INSTANCE_C6ID_2XLARGE
	default "c6id.4xlarge" if TERRAFORM_AWS_INSTANCE_C6ID_4XLARGE
	default "c6id.8xlarge" if TERRAFORM_AWS_INSTANCE_C6ID_8XLARGE
	default "c6id.12xlarge" if TERRAFORM_AWS_INSTANCE_C6ID_12XLARGE
	default "c6id.16xlarge" if TERRAFORM_AWS_INSTANCE_C6ID_16XLARGE
	default "c6id.24xlarge" if TERRAFORM_AWS_INSTANCE_C6ID_24XLARGE
	default "c6id.32xlarge" if TERRAFORM_AWS_INSTANCE_C6ID_32XLARGE
	default "c6id.metal" if TERRAFORM_AWS_INSTANCE_C6ID_METAL
	default "c6id.large"
```

## terraform/aws/kconfigs/instance-types/Kconfig.c6in.static
```kconfig
# AWS C6IN instance sizes (dynamically generated)

choice
	prompt "Instance size for C6IN family"
	default TERRAFORM_AWS_INSTANCE_C6IN_LARGE
	help
	  Select the specific instance size within the C6IN family.

config TERRAFORM_AWS_INSTANCE_C6IN_LARGE
	bool "c6in.large"
	help
	  vCPUs: 2
	  Memory: 4.0 GB
	  Network: Up to 25 Gigabit
	  Price: pricing varies

config TERRAFORM_AWS_INSTANCE_C6IN_XLARGE
	bool "c6in.xlarge"
	help
	  vCPUs: 4
	  Memory: 8.0 GB
	  Network: Up to 30 Gigabit
	  Price: pricing varies

config TERRAFORM_AWS_INSTANCE_C6IN_2XLARGE
	bool "c6in.2xlarge"
	help
	  vCPUs: 8
	  Memory: 16.0 GB
	  Network: Up to 40 Gigabit
	  Price: pricing varies

config TERRAFORM_AWS_INSTANCE_C6IN_4XLARGE
	bool "c6in.4xlarge"
	help
	  vCPUs: 16
	  Memory: 32.0 GB
	  Network: Up to 50 Gigabit
	  Price: pricing varies

config TERRAFORM_AWS_INSTANCE_C6IN_8XLARGE
	bool "c6in.8xlarge"
	help
	  vCPUs: 32
	  Memory: 64.0 GB
	  Network: 50 Gigabit
	  Price: pricing varies

config TERRAFORM_AWS_INSTANCE_C6IN_12XLARGE
	bool "c6in.12xlarge"
	help
	  vCPUs: 48
	  Memory: 96.0 GB
	  Network: 75 Gigabit
	  Price: pricing varies

config TERRAFORM_AWS_INSTANCE_C6IN_16XLARGE
	bool "c6in.16xlarge"
	help
	  vCPUs: 64
	  Memory: 128.0 GB
	  Network: 100 Gigabit
	  Price: pricing varies

config TERRAFORM_AWS_INSTANCE_C6IN_24XLARGE
	bool "c6in.24xlarge"
	help
	  vCPUs: 96
	  Memory: 192.0 GB
	  Network: 150 Gigabit
	  Price: pricing varies

config TERRAFORM_AWS_INSTANCE_C6IN_32XLARGE
	bool "c6in.32xlarge"
	help
	  vCPUs: 128
	  Memory: 256.0 GB
	  Network: 200 Gigabit
	  Price: pricing varies

config TERRAFORM_AWS_INSTANCE_C6IN_METAL
	bool "c6in.metal"
	help
	  vCPUs: 128
	  Memory: 256.0 GB
	  Network: 200 Gigabit
	  Price: pricing varies

endchoice

config TERRAFORM_AWS_C6IN_SIZE
	string
	default "c6in.large" if TERRAFORM_AWS_INSTANCE_C6IN_LARGE
	default "c6in.xlarge" if TERRAFORM_AWS_INSTANCE_C6IN_XLARGE
	default "c6in.2xlarge" if TERRAFORM_AWS_INSTANCE_C6IN_2XLARGE
	default "c6in.4xlarge" if TERRAFORM_AWS_INSTANCE_C6IN_4XLARGE
	default "c6in.8xlarge" if TERRAFORM_AWS_INSTANCE_C6IN_8XLARGE
	default "c6in.12xlarge" if TERRAFORM_AWS_INSTANCE_C6IN_12XLARGE
	default "c6in.16xlarge" if TERRAFORM_AWS_INSTANCE_C6IN_16XLARGE
	default "c6in.24xlarge" if TERRAFORM_AWS_INSTANCE_C6IN_24XLARGE
	default "c6in.32xlarge" if TERRAFORM_AWS_INSTANCE_C6IN_32XLARGE
	default "c6in.metal" if TERRAFORM_AWS_INSTANCE_C6IN_METAL
	default "c6in.large"
```

## terraform/aws/kconfigs/instance-types/Kconfig.c7a
```kconfig
if TERRAFORM_AWS_INSTANCE_TYPE_C7A

choice
	prompt "AWS instance size"
	default TERRAFORM_AWS_INSTANCE_SIZE_C7A_8XLARGE
	help
	  Add storage by selecting the TERRAFORM_AWS_ENABLE_EBS_VOLUMES
	  option and adjusting the size and number of additional devices.

config TERRAFORM_AWS_INSTANCE_SIZE_C7A_8XLARGE
	bool "c7a.8xlarge"
	help
	  32 core, 64 GiB RAM, EBS drives.

config TERRAFORM_AWS_INSTANCE_SIZE_C7A_METAL_48XL
	bool "c7a.metal-48xl"
	help
	  192 core, 384 GiB RAM, EBS drive.

endchoice

config TERRAFORM_AWS_INSTANCE_TYPE
	string
	output yaml
	default "c7a.8xlarge" if TERRAFORM_AWS_INSTANCE_SIZE_C7A_8XLARGE
	default "c7a.metal-48xl" if TERRAFORM_AWS_INSTANCE_SIZE_C7A_METAL_48XL

endif # TERRAFORM_AWS_INSTANCE_TYPE_C7A
```
