## terraform/aws/kconfigs/instance-types/Kconfig.c8g.static
```kconfig
# AWS C8G instance sizes (dynamically generated)

choice
	prompt "Instance size for C8G family"
	default TERRAFORM_AWS_INSTANCE_C8G_MEDIUM
	help
	  Select the specific instance size within the C8G family.

config TERRAFORM_AWS_INSTANCE_C8G_MEDIUM
	bool "c8g.medium"
	help
	  vCPUs: 1
	  Memory: 2.0 GB
	  Network: Up to 12.5 Gigabit
	  Price: pricing varies

config TERRAFORM_AWS_INSTANCE_C8G_LARGE
	bool "c8g.large"
	help
	  vCPUs: 2
	  Memory: 4.0 GB
	  Network: Up to 12.5 Gigabit
	  Price: pricing varies

config TERRAFORM_AWS_INSTANCE_C8G_XLARGE
	bool "c8g.xlarge"
	help
	  vCPUs: 4
	  Memory: 8.0 GB
	  Network: Up to 12.5 Gigabit
	  Price: pricing varies

config TERRAFORM_AWS_INSTANCE_C8G_2XLARGE
	bool "c8g.2xlarge"
	help
	  vCPUs: 8
	  Memory: 16.0 GB
	  Network: Up to 15 Gigabit
	  Price: pricing varies

config TERRAFORM_AWS_INSTANCE_C8G_4XLARGE
	bool "c8g.4xlarge"
	help
	  vCPUs: 16
	  Memory: 32.0 GB
	  Network: Up to 15 Gigabit
	  Price: pricing varies

config TERRAFORM_AWS_INSTANCE_C8G_8XLARGE
	bool "c8g.8xlarge"
	help
	  vCPUs: 32
	  Memory: 64.0 GB
	  Network: 15 Gigabit
	  Price: pricing varies

config TERRAFORM_AWS_INSTANCE_C8G_12XLARGE
	bool "c8g.12xlarge"
	help
	  vCPUs: 48
	  Memory: 96.0 GB
	  Network: 22.5 Gigabit
	  Price: pricing varies

config TERRAFORM_AWS_INSTANCE_C8G_16XLARGE
	bool "c8g.16xlarge"
	help
	  vCPUs: 64
	  Memory: 128.0 GB
	  Network: 30 Gigabit
	  Price: pricing varies

config TERRAFORM_AWS_INSTANCE_C8G_24XLARGE
	bool "c8g.24xlarge"
	help
	  vCPUs: 96
	  Memory: 192.0 GB
	  Network: 40 Gigabit
	  Price: pricing varies

config TERRAFORM_AWS_INSTANCE_C8G_METAL_24XL
	bool "c8g.metal-24xl"
	help
	  vCPUs: 96
	  Memory: 192.0 GB
	  Network: 40 Gigabit
	  Price: pricing varies

config TERRAFORM_AWS_INSTANCE_C8G_48XLARGE
	bool "c8g.48xlarge"
	help
	  vCPUs: 192
	  Memory: 384.0 GB
	  Network: 50 Gigabit
	  Price: pricing varies

config TERRAFORM_AWS_INSTANCE_C8G_METAL_48XL
	bool "c8g.metal-48xl"
	help
	  vCPUs: 192
	  Memory: 384.0 GB
	  Network: 50 Gigabit
	  Price: pricing varies

endchoice

config TERRAFORM_AWS_C8G_SIZE
	string
	default "c8g.medium" if TERRAFORM_AWS_INSTANCE_C8G_MEDIUM
	default "c8g.large" if TERRAFORM_AWS_INSTANCE_C8G_LARGE
	default "c8g.xlarge" if TERRAFORM_AWS_INSTANCE_C8G_XLARGE
	default "c8g.2xlarge" if TERRAFORM_AWS_INSTANCE_C8G_2XLARGE
	default "c8g.4xlarge" if TERRAFORM_AWS_INSTANCE_C8G_4XLARGE
	default "c8g.8xlarge" if TERRAFORM_AWS_INSTANCE_C8G_8XLARGE
	default "c8g.12xlarge" if TERRAFORM_AWS_INSTANCE_C8G_12XLARGE
	default "c8g.16xlarge" if TERRAFORM_AWS_INSTANCE_C8G_16XLARGE
	default "c8g.24xlarge" if TERRAFORM_AWS_INSTANCE_C8G_24XLARGE
	default "c8g.metal-24xl" if TERRAFORM_AWS_INSTANCE_C8G_METAL_24XL
	default "c8g.48xlarge" if TERRAFORM_AWS_INSTANCE_C8G_48XLARGE
	default "c8g.metal-48xl" if TERRAFORM_AWS_INSTANCE_C8G_METAL_48XL
	default "c8g.medium"
```

## terraform/aws/kconfigs/instance-types/Kconfig.c8gd.static
```kconfig
# AWS C8GD instance sizes (dynamically generated)

choice
	prompt "Instance size for C8GD family"
	default TERRAFORM_AWS_INSTANCE_C8GD_MEDIUM
	help
	  Select the specific instance size within the C8GD family.

config TERRAFORM_AWS_INSTANCE_C8GD_MEDIUM
	bool "c8gd.medium"
	help
	  vCPUs: 1
	  Memory: 2.0 GB
	  Network: Up to 12.5 Gigabit
	  Price: pricing varies
	  Instance storage: 59 GB

config TERRAFORM_AWS_INSTANCE_C8GD_LARGE
	bool "c8gd.large"
	help
	  vCPUs: 2
	  Memory: 4.0 GB
	  Network: Up to 12.5 Gigabit
	  Price: pricing varies
	  Instance storage: 118 GB

config TERRAFORM_AWS_INSTANCE_C8GD_XLARGE
	bool "c8gd.xlarge"
	help
	  vCPUs: 4
	  Memory: 8.0 GB
	  Network: Up to 12.5 Gigabit
	  Price: pricing varies
	  Instance storage: 237 GB

config TERRAFORM_AWS_INSTANCE_C8GD_2XLARGE
	bool "c8gd.2xlarge"
	help
	  vCPUs: 8
	  Memory: 16.0 GB
	  Network: Up to 15 Gigabit
	  Price: pricing varies
	  Instance storage: 474 GB

config TERRAFORM_AWS_INSTANCE_C8GD_4XLARGE
	bool "c8gd.4xlarge"
	help
	  vCPUs: 16
	  Memory: 32.0 GB
	  Network: Up to 15 Gigabit
	  Price: pricing varies
	  Instance storage: 950 GB

config TERRAFORM_AWS_INSTANCE_C8GD_8XLARGE
	bool "c8gd.8xlarge"
	help
	  vCPUs: 32
	  Memory: 64.0 GB
	  Network: 15 Gigabit
	  Price: pricing varies
	  Instance storage: 1900 GB

config TERRAFORM_AWS_INSTANCE_C8GD_12XLARGE
	bool "c8gd.12xlarge"
	help
	  vCPUs: 48
	  Memory: 96.0 GB
	  Network: 22.5 Gigabit
	  Price: pricing varies
	  Instance storage: 2850 GB

config TERRAFORM_AWS_INSTANCE_C8GD_16XLARGE
	bool "c8gd.16xlarge"
	help
	  vCPUs: 64
	  Memory: 128.0 GB
	  Network: 30 Gigabit
	  Price: pricing varies
	  Instance storage: 3800 GB

config TERRAFORM_AWS_INSTANCE_C8GD_24XLARGE
	bool "c8gd.24xlarge"
	help
	  vCPUs: 96
	  Memory: 192.0 GB
	  Network: 40 Gigabit
	  Price: pricing varies
	  Instance storage: 5700 GB

config TERRAFORM_AWS_INSTANCE_C8GD_METAL_24XL
	bool "c8gd.metal-24xl"
	help
	  vCPUs: 96
	  Memory: 192.0 GB
	  Network: 40 Gigabit
	  Price: pricing varies
	  Instance storage: 5700 GB

config TERRAFORM_AWS_INSTANCE_C8GD_48XLARGE
	bool "c8gd.48xlarge"
	help
	  vCPUs: 192
	  Memory: 384.0 GB
	  Network: 50 Gigabit
	  Price: pricing varies
	  Instance storage: 11400 GB

config TERRAFORM_AWS_INSTANCE_C8GD_METAL_48XL
	bool "c8gd.metal-48xl"
	help
	  vCPUs: 192
	  Memory: 384.0 GB
	  Network: 50 Gigabit
	  Price: pricing varies
	  Instance storage: 11400 GB

endchoice

config TERRAFORM_AWS_C8GD_SIZE
	string
	default "c8gd.medium" if TERRAFORM_AWS_INSTANCE_C8GD_MEDIUM
	default "c8gd.large" if TERRAFORM_AWS_INSTANCE_C8GD_LARGE
	default "c8gd.xlarge" if TERRAFORM_AWS_INSTANCE_C8GD_XLARGE
	default "c8gd.2xlarge" if TERRAFORM_AWS_INSTANCE_C8GD_2XLARGE
	default "c8gd.4xlarge" if TERRAFORM_AWS_INSTANCE_C8GD_4XLARGE
	default "c8gd.8xlarge" if TERRAFORM_AWS_INSTANCE_C8GD_8XLARGE
	default "c8gd.12xlarge" if TERRAFORM_AWS_INSTANCE_C8GD_12XLARGE
	default "c8gd.16xlarge" if TERRAFORM_AWS_INSTANCE_C8GD_16XLARGE
	default "c8gd.24xlarge" if TERRAFORM_AWS_INSTANCE_C8GD_24XLARGE
	default "c8gd.metal-24xl" if TERRAFORM_AWS_INSTANCE_C8GD_METAL_24XL
	default "c8gd.48xlarge" if TERRAFORM_AWS_INSTANCE_C8GD_48XLARGE
	default "c8gd.metal-48xl" if TERRAFORM_AWS_INSTANCE_C8GD_METAL_48XL
	default "c8gd.medium"
```

## terraform/aws/kconfigs/instance-types/Kconfig.c8gn.static
```kconfig
# AWS C8GN instance sizes (dynamically generated)

choice
	prompt "Instance size for C8GN family"
	default TERRAFORM_AWS_INSTANCE_C8GN_MEDIUM
	help
	  Select the specific instance size within the C8GN family.

config TERRAFORM_AWS_INSTANCE_C8GN_MEDIUM
	bool "c8gn.medium"
	help
	  vCPUs: 1
	  Memory: 2.0 GB
	  Network: Up to 25 Gigabit
	  Price: pricing varies

config TERRAFORM_AWS_INSTANCE_C8GN_LARGE
	bool "c8gn.large"
	help
	  vCPUs: 2
	  Memory: 4.0 GB
	  Network: Up to 30 Gigabit
	  Price: pricing varies

config TERRAFORM_AWS_INSTANCE_C8GN_XLARGE
	bool "c8gn.xlarge"
	help
	  vCPUs: 4
	  Memory: 8.0 GB
	  Network: Up to 40 Gigabit
	  Price: pricing varies

config TERRAFORM_AWS_INSTANCE_C8GN_2XLARGE
	bool "c8gn.2xlarge"
	help
	  vCPUs: 8
	  Memory: 16.0 GB
	  Network: Up to 50 Gigabit
	  Price: pricing varies

config TERRAFORM_AWS_INSTANCE_C8GN_4XLARGE
	bool "c8gn.4xlarge"
	help
	  vCPUs: 16
	  Memory: 32.0 GB
	  Network: 50 Gigabit
	  Price: pricing varies

config TERRAFORM_AWS_INSTANCE_C8GN_8XLARGE
	bool "c8gn.8xlarge"
	help
	  vCPUs: 32
	  Memory: 64.0 GB
	  Network: 100 Gigabit
	  Price: pricing varies

config TERRAFORM_AWS_INSTANCE_C8GN_12XLARGE
	bool "c8gn.12xlarge"
	help
	  vCPUs: 48
	  Memory: 96.0 GB
	  Network: 150 Gigabit
	  Price: pricing varies

config TERRAFORM_AWS_INSTANCE_C8GN_16XLARGE
	bool "c8gn.16xlarge"
	help
	  vCPUs: 64
	  Memory: 128.0 GB
	  Network: 200 Gigabit
	  Price: pricing varies

config TERRAFORM_AWS_INSTANCE_C8GN_METAL_24XL
	bool "c8gn.metal-24xl"
	help
	  vCPUs: 96
	  Memory: 192.0 GB
	  Network: 300 Gigabit
	  Price: pricing varies

config TERRAFORM_AWS_INSTANCE_C8GN_24XLARGE
	bool "c8gn.24xlarge"
	help
	  vCPUs: 96
	  Memory: 192.0 GB
	  Network: 300 Gigabit
	  Price: pricing varies

config TERRAFORM_AWS_INSTANCE_C8GN_48XLARGE
	bool "c8gn.48xlarge"
	help
	  vCPUs: 192
	  Memory: 384.0 GB
	  Network: 600 Gigabit
	  Price: pricing varies

config TERRAFORM_AWS_INSTANCE_C8GN_METAL_48XL
	bool "c8gn.metal-48xl"
	help
	  vCPUs: 192
	  Memory: 384.0 GB
	  Network: 600 Gigabit
	  Price: pricing varies

endchoice

config TERRAFORM_AWS_C8GN_SIZE
	string
	default "c8gn.medium" if TERRAFORM_AWS_INSTANCE_C8GN_MEDIUM
	default "c8gn.large" if TERRAFORM_AWS_INSTANCE_C8GN_LARGE
	default "c8gn.xlarge" if TERRAFORM_AWS_INSTANCE_C8GN_XLARGE
	default "c8gn.2xlarge" if TERRAFORM_AWS_INSTANCE_C8GN_2XLARGE
	default "c8gn.4xlarge" if TERRAFORM_AWS_INSTANCE_C8GN_4XLARGE
	default "c8gn.8xlarge" if TERRAFORM_AWS_INSTANCE_C8GN_8XLARGE
	default "c8gn.12xlarge" if TERRAFORM_AWS_INSTANCE_C8GN_12XLARGE
	default "c8gn.16xlarge" if TERRAFORM_AWS_INSTANCE_C8GN_16XLARGE
	default "c8gn.metal-24xl" if TERRAFORM_AWS_INSTANCE_C8GN_METAL_24XL
	default "c8gn.24xlarge" if TERRAFORM_AWS_INSTANCE_C8GN_24XLARGE
	default "c8gn.48xlarge" if TERRAFORM_AWS_INSTANCE_C8GN_48XLARGE
	default "c8gn.metal-48xl" if TERRAFORM_AWS_INSTANCE_C8GN_METAL_48XL
	default "c8gn.medium"
```

## terraform/aws/kconfigs/instance-types/Kconfig.d2.static
```kconfig
# AWS D2 instance sizes (dynamically generated)

choice
	prompt "Instance size for D2 family"
	default TERRAFORM_AWS_INSTANCE_D2_XLARGE
	help
	  Select the specific instance size within the D2 family.

config TERRAFORM_AWS_INSTANCE_D2_XLARGE
	bool "d2.xlarge"
	help
	  vCPUs: 4
	  Memory: 30.5 GB
	  Network: Moderate
	  Price: pricing varies
	  Instance storage: 6144 GB

config TERRAFORM_AWS_INSTANCE_D2_2XLARGE
	bool "d2.2xlarge"
	help
	  vCPUs: 8
	  Memory: 61.0 GB
	  Network: High
	  Price: pricing varies
	  Instance storage: 12288 GB

config TERRAFORM_AWS_INSTANCE_D2_4XLARGE
	bool "d2.4xlarge"
	help
	  vCPUs: 16
	  Memory: 122.0 GB
	  Network: High
	  Price: pricing varies
	  Instance storage: 24576 GB

config TERRAFORM_AWS_INSTANCE_D2_8XLARGE
	bool "d2.8xlarge"
	help
	  vCPUs: 36
	  Memory: 244.0 GB
	  Network: 10 Gigabit
	  Price: pricing varies
	  Instance storage: 49152 GB

endchoice

config TERRAFORM_AWS_D2_SIZE
	string
	default "d2.xlarge" if TERRAFORM_AWS_INSTANCE_D2_XLARGE
	default "d2.2xlarge" if TERRAFORM_AWS_INSTANCE_D2_2XLARGE
	default "d2.4xlarge" if TERRAFORM_AWS_INSTANCE_D2_4XLARGE
	default "d2.8xlarge" if TERRAFORM_AWS_INSTANCE_D2_8XLARGE
	default "d2.xlarge"
```

## terraform/aws/kconfigs/instance-types/Kconfig.d3.static
```kconfig
# AWS D3 instance sizes (dynamically generated)

choice
	prompt "Instance size for D3 family"
	default TERRAFORM_AWS_INSTANCE_D3_XLARGE
	help
	  Select the specific instance size within the D3 family.

config TERRAFORM_AWS_INSTANCE_D3_XLARGE
	bool "d3.xlarge"
	help
	  vCPUs: 4
	  Memory: 32.0 GB
	  Network: Up to 15 Gigabit
	  Price: pricing varies
	  Instance storage: 5940 GB

config TERRAFORM_AWS_INSTANCE_D3_2XLARGE
	bool "d3.2xlarge"
	help
	  vCPUs: 8
	  Memory: 64.0 GB
	  Network: Up to 15 Gigabit
	  Price: pricing varies
	  Instance storage: 11880 GB

config TERRAFORM_AWS_INSTANCE_D3_4XLARGE
	bool "d3.4xlarge"
	help
	  vCPUs: 16
	  Memory: 128.0 GB
	  Network: Up to 15 Gigabit
	  Price: pricing varies
	  Instance storage: 23760 GB

config TERRAFORM_AWS_INSTANCE_D3_8XLARGE
	bool "d3.8xlarge"
	help
	  vCPUs: 32
	  Memory: 256.0 GB
	  Network: 25 Gigabit
	  Price: pricing varies
	  Instance storage: 47520 GB

endchoice

config TERRAFORM_AWS_D3_SIZE
	string
	default "d3.xlarge" if TERRAFORM_AWS_INSTANCE_D3_XLARGE
	default "d3.2xlarge" if TERRAFORM_AWS_INSTANCE_D3_2XLARGE
	default "d3.4xlarge" if TERRAFORM_AWS_INSTANCE_D3_4XLARGE
	default "d3.8xlarge" if TERRAFORM_AWS_INSTANCE_D3_8XLARGE
	default "d3.xlarge"
```
