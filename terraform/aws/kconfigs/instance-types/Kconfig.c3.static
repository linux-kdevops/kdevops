## terraform/aws/kconfigs/instance-types/Kconfig.c7a.static
```kconfig
# AWS C7A instance sizes (dynamically generated)

choice
	prompt "Instance size for C7A family"
	default TERRAFORM_AWS_INSTANCE_C7A_MEDIUM
	help
	  Select the specific instance size within the C7A family.

config TERRAFORM_AWS_INSTANCE_C7A_MEDIUM
	bool "c7a.medium"
	help
	  vCPUs: 1
	  Memory: 2.0 GB
	  Network: Up to 12.5 Gigabit
	  Price: $0.039/hour

config TERRAFORM_AWS_INSTANCE_C7A_LARGE
	bool "c7a.large"
	help
	  vCPUs: 2
	  Memory: 4.0 GB
	  Network: Up to 12.5 Gigabit
	  Price: $0.077/hour

config TERRAFORM_AWS_INSTANCE_C7A_XLARGE
	bool "c7a.xlarge"
	help
	  vCPUs: 4
	  Memory: 8.0 GB
	  Network: Up to 12.5 Gigabit
	  Price: $0.155/hour

config TERRAFORM_AWS_INSTANCE_C7A_2XLARGE
	bool "c7a.2xlarge"
	help
	  vCPUs: 8
	  Memory: 16.0 GB
	  Network: Up to 12.5 Gigabit
	  Price: $0.310/hour

config TERRAFORM_AWS_INSTANCE_C7A_4XLARGE
	bool "c7a.4xlarge"
	help
	  vCPUs: 16
	  Memory: 32.0 GB
	  Network: Up to 12.5 Gigabit
	  Price: $0.619/hour

config TERRAFORM_AWS_INSTANCE_C7A_8XLARGE
	bool "c7a.8xlarge"
	help
	  vCPUs: 32
	  Memory: 64.0 GB
	  Network: 12.5 Gigabit
	  Price: $1.238/hour

config TERRAFORM_AWS_INSTANCE_C7A_12XLARGE
	bool "c7a.12xlarge"
	help
	  vCPUs: 48
	  Memory: 96.0 GB
	  Network: 18.75 Gigabit
	  Price: $1.858/hour

config TERRAFORM_AWS_INSTANCE_C7A_16XLARGE
	bool "c7a.16xlarge"
	help
	  vCPUs: 64
	  Memory: 128.0 GB
	  Network: 25 Gigabit
	  Price: $2.477/hour

config TERRAFORM_AWS_INSTANCE_C7A_24XLARGE
	bool "c7a.24xlarge"
	help
	  vCPUs: 96
	  Memory: 192.0 GB
	  Network: 37.5 Gigabit
	  Price: $3.715/hour

config TERRAFORM_AWS_INSTANCE_C7A_32XLARGE
	bool "c7a.32xlarge"
	help
	  vCPUs: 128
	  Memory: 256.0 GB
	  Network: 50 Gigabit
	  Price: $4.954/hour

config TERRAFORM_AWS_INSTANCE_C7A_METAL_48XL
	bool "c7a.metal-48xl"
	help
	  vCPUs: 192
	  Memory: 384.0 GB
	  Network: 50 Gigabit
	  Price: pricing varies

config TERRAFORM_AWS_INSTANCE_C7A_48XLARGE
	bool "c7a.48xlarge"
	help
	  vCPUs: 192
	  Memory: 384.0 GB
	  Network: 50 Gigabit
	  Price: $7.430/hour

endchoice

config TERRAFORM_AWS_C7A_SIZE
	string
	default "c7a.medium" if TERRAFORM_AWS_INSTANCE_C7A_MEDIUM
	default "c7a.large" if TERRAFORM_AWS_INSTANCE_C7A_LARGE
	default "c7a.xlarge" if TERRAFORM_AWS_INSTANCE_C7A_XLARGE
	default "c7a.2xlarge" if TERRAFORM_AWS_INSTANCE_C7A_2XLARGE
	default "c7a.4xlarge" if TERRAFORM_AWS_INSTANCE_C7A_4XLARGE
	default "c7a.8xlarge" if TERRAFORM_AWS_INSTANCE_C7A_8XLARGE
	default "c7a.12xlarge" if TERRAFORM_AWS_INSTANCE_C7A_12XLARGE
	default "c7a.16xlarge" if TERRAFORM_AWS_INSTANCE_C7A_16XLARGE
	default "c7a.24xlarge" if TERRAFORM_AWS_INSTANCE_C7A_24XLARGE
	default "c7a.32xlarge" if TERRAFORM_AWS_INSTANCE_C7A_32XLARGE
	default "c7a.metal-48xl" if TERRAFORM_AWS_INSTANCE_C7A_METAL_48XL
	default "c7a.48xlarge" if TERRAFORM_AWS_INSTANCE_C7A_48XLARGE
	default "c7a.medium"
```

## terraform/aws/kconfigs/instance-types/Kconfig.c7g.static
```kconfig
# AWS C7G instance sizes (dynamically generated)

choice
	prompt "Instance size for C7G family"
	default TERRAFORM_AWS_INSTANCE_C7G_MEDIUM
	help
	  Select the specific instance size within the C7G family.

config TERRAFORM_AWS_INSTANCE_C7G_MEDIUM
	bool "c7g.medium"
	help
	  vCPUs: 1
	  Memory: 2.0 GB
	  Network: Up to 12.5 Gigabit
	  Price: pricing varies

config TERRAFORM_AWS_INSTANCE_C7G_LARGE
	bool "c7g.large"
	help
	  vCPUs: 2
	  Memory: 4.0 GB
	  Network: Up to 12.5 Gigabit
	  Price: pricing varies

config TERRAFORM_AWS_INSTANCE_C7G_XLARGE
	bool "c7g.xlarge"
	help
	  vCPUs: 4
	  Memory: 8.0 GB
	  Network: Up to 12.5 Gigabit
	  Price: pricing varies

config TERRAFORM_AWS_INSTANCE_C7G_2XLARGE
	bool "c7g.2xlarge"
	help
	  vCPUs: 8
	  Memory: 16.0 GB
	  Network: Up to 15 Gigabit
	  Price: pricing varies

config TERRAFORM_AWS_INSTANCE_C7G_4XLARGE
	bool "c7g.4xlarge"
	help
	  vCPUs: 16
	  Memory: 32.0 GB
	  Network: Up to 15 Gigabit
	  Price: pricing varies

config TERRAFORM_AWS_INSTANCE_C7G_8XLARGE
	bool "c7g.8xlarge"
	help
	  vCPUs: 32
	  Memory: 64.0 GB
	  Network: 15 Gigabit
	  Price: pricing varies

config TERRAFORM_AWS_INSTANCE_C7G_12XLARGE
	bool "c7g.12xlarge"
	help
	  vCPUs: 48
	  Memory: 96.0 GB
	  Network: 22.5 Gigabit
	  Price: pricing varies

config TERRAFORM_AWS_INSTANCE_C7G_16XLARGE
	bool "c7g.16xlarge"
	help
	  vCPUs: 64
	  Memory: 128.0 GB
	  Network: 30 Gigabit
	  Price: pricing varies

config TERRAFORM_AWS_INSTANCE_C7G_METAL
	bool "c7g.metal"
	help
	  vCPUs: 64
	  Memory: 128.0 GB
	  Network: 30 Gigabit
	  Price: pricing varies

endchoice

config TERRAFORM_AWS_C7G_SIZE
	string
	default "c7g.medium" if TERRAFORM_AWS_INSTANCE_C7G_MEDIUM
	default "c7g.large" if TERRAFORM_AWS_INSTANCE_C7G_LARGE
	default "c7g.xlarge" if TERRAFORM_AWS_INSTANCE_C7G_XLARGE
	default "c7g.2xlarge" if TERRAFORM_AWS_INSTANCE_C7G_2XLARGE
	default "c7g.4xlarge" if TERRAFORM_AWS_INSTANCE_C7G_4XLARGE
	default "c7g.8xlarge" if TERRAFORM_AWS_INSTANCE_C7G_8XLARGE
	default "c7g.12xlarge" if TERRAFORM_AWS_INSTANCE_C7G_12XLARGE
	default "c7g.16xlarge" if TERRAFORM_AWS_INSTANCE_C7G_16XLARGE
	default "c7g.metal" if TERRAFORM_AWS_INSTANCE_C7G_METAL
	default "c7g.medium"
```

## terraform/aws/kconfigs/instance-types/Kconfig.c7gd.static
```kconfig
# AWS C7GD instance sizes (dynamically generated)

choice
	prompt "Instance size for C7GD family"
	default TERRAFORM_AWS_INSTANCE_C7GD_MEDIUM
	help
	  Select the specific instance size within the C7GD family.

config TERRAFORM_AWS_INSTANCE_C7GD_MEDIUM
	bool "c7gd.medium"
	help
	  vCPUs: 1
	  Memory: 2.0 GB
	  Network: Up to 12.5 Gigabit
	  Price: pricing varies
	  Instance storage: 59 GB

config TERRAFORM_AWS_INSTANCE_C7GD_LARGE
	bool "c7gd.large"
	help
	  vCPUs: 2
	  Memory: 4.0 GB
	  Network: Up to 12.5 Gigabit
	  Price: pricing varies
	  Instance storage: 118 GB

config TERRAFORM_AWS_INSTANCE_C7GD_XLARGE
	bool "c7gd.xlarge"
	help
	  vCPUs: 4
	  Memory: 8.0 GB
	  Network: Up to 12.5 Gigabit
	  Price: pricing varies
	  Instance storage: 237 GB

config TERRAFORM_AWS_INSTANCE_C7GD_2XLARGE
	bool "c7gd.2xlarge"
	help
	  vCPUs: 8
	  Memory: 16.0 GB
	  Network: Up to 15 Gigabit
	  Price: pricing varies
	  Instance storage: 474 GB

config TERRAFORM_AWS_INSTANCE_C7GD_4XLARGE
	bool "c7gd.4xlarge"
	help
	  vCPUs: 16
	  Memory: 32.0 GB
	  Network: Up to 15 Gigabit
	  Price: pricing varies
	  Instance storage: 950 GB

config TERRAFORM_AWS_INSTANCE_C7GD_8XLARGE
	bool "c7gd.8xlarge"
	help
	  vCPUs: 32
	  Memory: 64.0 GB
	  Network: 15 Gigabit
	  Price: pricing varies
	  Instance storage: 1900 GB

config TERRAFORM_AWS_INSTANCE_C7GD_12XLARGE
	bool "c7gd.12xlarge"
	help
	  vCPUs: 48
	  Memory: 96.0 GB
	  Network: 22.5 Gigabit
	  Price: pricing varies
	  Instance storage: 2850 GB

config TERRAFORM_AWS_INSTANCE_C7GD_16XLARGE
	bool "c7gd.16xlarge"
	help
	  vCPUs: 64
	  Memory: 128.0 GB
	  Network: 30 Gigabit
	  Price: pricing varies
	  Instance storage: 3800 GB

config TERRAFORM_AWS_INSTANCE_C7GD_METAL
	bool "c7gd.metal"
	help
	  vCPUs: 64
	  Memory: 128.0 GB
	  Network: 30 Gigabit
	  Price: pricing varies
	  Instance storage: 3800 GB

endchoice

config TERRAFORM_AWS_C7GD_SIZE
	string
	default "c7gd.medium" if TERRAFORM_AWS_INSTANCE_C7GD_MEDIUM
	default "c7gd.large" if TERRAFORM_AWS_INSTANCE_C7GD_LARGE
	default "c7gd.xlarge" if TERRAFORM_AWS_INSTANCE_C7GD_XLARGE
	default "c7gd.2xlarge" if TERRAFORM_AWS_INSTANCE_C7GD_2XLARGE
	default "c7gd.4xlarge" if TERRAFORM_AWS_INSTANCE_C7GD_4XLARGE
	default "c7gd.8xlarge" if TERRAFORM_AWS_INSTANCE_C7GD_8XLARGE
	default "c7gd.12xlarge" if TERRAFORM_AWS_INSTANCE_C7GD_12XLARGE
	default "c7gd.16xlarge" if TERRAFORM_AWS_INSTANCE_C7GD_16XLARGE
	default "c7gd.metal" if TERRAFORM_AWS_INSTANCE_C7GD_METAL
	default "c7gd.medium"
```

## terraform/aws/kconfigs/instance-types/Kconfig.c7gn.static
```kconfig
# AWS C7GN instance sizes (dynamically generated)

choice
	prompt "Instance size for C7GN family"
	default TERRAFORM_AWS_INSTANCE_C7GN_MEDIUM
	help
	  Select the specific instance size within the C7GN family.

config TERRAFORM_AWS_INSTANCE_C7GN_MEDIUM
	bool "c7gn.medium"
	help
	  vCPUs: 1
	  Memory: 2.0 GB
	  Network: Up to 25 Gigabit
	  Price: pricing varies

config TERRAFORM_AWS_INSTANCE_C7GN_LARGE
	bool "c7gn.large"
	help
	  vCPUs: 2
	  Memory: 4.0 GB
	  Network: Up to 30 Gigabit
	  Price: pricing varies

config TERRAFORM_AWS_INSTANCE_C7GN_XLARGE
	bool "c7gn.xlarge"
	help
	  vCPUs: 4
	  Memory: 8.0 GB
	  Network: Up to 40 Gigabit
	  Price: pricing varies

config TERRAFORM_AWS_INSTANCE_C7GN_2XLARGE
	bool "c7gn.2xlarge"
	help
	  vCPUs: 8
	  Memory: 16.0 GB
	  Network: Up to 50 Gigabit
	  Price: pricing varies

config TERRAFORM_AWS_INSTANCE_C7GN_4XLARGE
	bool "c7gn.4xlarge"
	help
	  vCPUs: 16
	  Memory: 32.0 GB
	  Network: 50 Gigabit
	  Price: pricing varies

config TERRAFORM_AWS_INSTANCE_C7GN_8XLARGE
	bool "c7gn.8xlarge"
	help
	  vCPUs: 32
	  Memory: 64.0 GB
	  Network: 100 Gigabit
	  Price: pricing varies

config TERRAFORM_AWS_INSTANCE_C7GN_12XLARGE
	bool "c7gn.12xlarge"
	help
	  vCPUs: 48
	  Memory: 96.0 GB
	  Network: 150 Gigabit
	  Price: pricing varies

config TERRAFORM_AWS_INSTANCE_C7GN_16XLARGE
	bool "c7gn.16xlarge"
	help
	  vCPUs: 64
	  Memory: 128.0 GB
	  Network: 200 Gigabit
	  Price: pricing varies

config TERRAFORM_AWS_INSTANCE_C7GN_METAL
	bool "c7gn.metal"
	help
	  vCPUs: 64
	  Memory: 128.0 GB
	  Network: 200 Gigabit
	  Price: pricing varies

endchoice

config TERRAFORM_AWS_C7GN_SIZE
	string
	default "c7gn.medium" if TERRAFORM_AWS_INSTANCE_C7GN_MEDIUM
	default "c7gn.large" if TERRAFORM_AWS_INSTANCE_C7GN_LARGE
	default "c7gn.xlarge" if TERRAFORM_AWS_INSTANCE_C7GN_XLARGE
	default "c7gn.2xlarge" if TERRAFORM_AWS_INSTANCE_C7GN_2XLARGE
	default "c7gn.4xlarge" if TERRAFORM_AWS_INSTANCE_C7GN_4XLARGE
	default "c7gn.8xlarge" if TERRAFORM_AWS_INSTANCE_C7GN_8XLARGE
	default "c7gn.12xlarge" if TERRAFORM_AWS_INSTANCE_C7GN_12XLARGE
	default "c7gn.16xlarge" if TERRAFORM_AWS_INSTANCE_C7GN_16XLARGE
	default "c7gn.metal" if TERRAFORM_AWS_INSTANCE_C7GN_METAL
	default "c7gn.medium"
```

## terraform/aws/kconfigs/instance-types/Kconfig.c7i-flex.static
```kconfig
# AWS C7I-FLEX instance sizes (dynamically generated)

choice
	prompt "Instance size for C7I-FLEX family"
	default TERRAFORM_AWS_INSTANCE_C7I_FLEX_LARGE
	help
	  Select the specific instance size within the C7I-FLEX family.

config TERRAFORM_AWS_INSTANCE_C7I_FLEX_LARGE
	bool "c7i-flex.large"
	help
	  vCPUs: 2
	  Memory: 4.0 GB
	  Network: Up to 12.5 Gigabit
	  Price: pricing varies

config TERRAFORM_AWS_INSTANCE_C7I_FLEX_XLARGE
	bool "c7i-flex.xlarge"
	help
	  vCPUs: 4
	  Memory: 8.0 GB
	  Network: Up to 12.5 Gigabit
	  Price: pricing varies

config TERRAFORM_AWS_INSTANCE_C7I_FLEX_2XLARGE
	bool "c7i-flex.2xlarge"
	help
	  vCPUs: 8
	  Memory: 16.0 GB
	  Network: Up to 12.5 Gigabit
	  Price: pricing varies

config TERRAFORM_AWS_INSTANCE_C7I_FLEX_4XLARGE
	bool "c7i-flex.4xlarge"
	help
	  vCPUs: 16
	  Memory: 32.0 GB
	  Network: Up to 12.5 Gigabit
	  Price: pricing varies

config TERRAFORM_AWS_INSTANCE_C7I_FLEX_8XLARGE
	bool "c7i-flex.8xlarge"
	help
	  vCPUs: 32
	  Memory: 64.0 GB
	  Network: Up to 12.5 Gigabit
	  Price: pricing varies

config TERRAFORM_AWS_INSTANCE_C7I_FLEX_12XLARGE
	bool "c7i-flex.12xlarge"
	help
	  vCPUs: 48
	  Memory: 96.0 GB
	  Network: Up to 18.75 Gigabit
	  Price: pricing varies

config TERRAFORM_AWS_INSTANCE_C7I_FLEX_16XLARGE
	bool "c7i-flex.16xlarge"
	help
	  vCPUs: 64
	  Memory: 128.0 GB
	  Network: Up to 25 Gigabit
	  Price: pricing varies

endchoice

config TERRAFORM_AWS_C7I_FLEX_SIZE
	string
	default "c7i-flex.large" if TERRAFORM_AWS_INSTANCE_C7I_FLEX_LARGE
	default "c7i-flex.xlarge" if TERRAFORM_AWS_INSTANCE_C7I_FLEX_XLARGE
	default "c7i-flex.2xlarge" if TERRAFORM_AWS_INSTANCE_C7I_FLEX_2XLARGE
	default "c7i-flex.4xlarge" if TERRAFORM_AWS_INSTANCE_C7I_FLEX_4XLARGE
	default "c7i-flex.8xlarge" if TERRAFORM_AWS_INSTANCE_C7I_FLEX_8XLARGE
	default "c7i-flex.12xlarge" if TERRAFORM_AWS_INSTANCE_C7I_FLEX_12XLARGE
	default "c7i-flex.16xlarge" if TERRAFORM_AWS_INSTANCE_C7I_FLEX_16XLARGE
	default "c7i-flex.large"
```

## terraform/aws/kconfigs/instance-types/Kconfig.c7i.static
```kconfig
# AWS C7I instance sizes (dynamically generated)

choice
	prompt "Instance size for C7I family"
	default TERRAFORM_AWS_INSTANCE_C7I_LARGE
	help
	  Select the specific instance size within the C7I family.

config TERRAFORM_AWS_INSTANCE_C7I_LARGE
	bool "c7i.large"
	help
	  vCPUs: 2
	  Memory: 4.0 GB
	  Network: Up to 12.5 Gigabit
	  Price: pricing varies

config TERRAFORM_AWS_INSTANCE_C7I_XLARGE
	bool "c7i.xlarge"
	help
	  vCPUs: 4
	  Memory: 8.0 GB
	  Network: Up to 12.5 Gigabit
	  Price: pricing varies

config TERRAFORM_AWS_INSTANCE_C7I_2XLARGE
	bool "c7i.2xlarge"
	help
	  vCPUs: 8
	  Memory: 16.0 GB
	  Network: Up to 12.5 Gigabit
	  Price: pricing varies

config TERRAFORM_AWS_INSTANCE_C7I_4XLARGE
	bool "c7i.4xlarge"
	help
	  vCPUs: 16
	  Memory: 32.0 GB
	  Network: Up to 12.5 Gigabit
	  Price: pricing varies

config TERRAFORM_AWS_INSTANCE_C7I_8XLARGE
	bool "c7i.8xlarge"
	help
	  vCPUs: 32
	  Memory: 64.0 GB
	  Network: 12.5 Gigabit
	  Price: pricing varies

config TERRAFORM_AWS_INSTANCE_C7I_12XLARGE
	bool "c7i.12xlarge"
	help
	  vCPUs: 48
	  Memory: 96.0 GB
	  Network: 18.75 Gigabit
	  Price: pricing varies

config TERRAFORM_AWS_INSTANCE_C7I_16XLARGE
	bool "c7i.16xlarge"
	help
	  vCPUs: 64
	  Memory: 128.0 GB
	  Network: 25 Gigabit
	  Price: pricing varies

config TERRAFORM_AWS_INSTANCE_C7I_METAL_24XL
	bool "c7i.metal-24xl"
	help
	  vCPUs: 96
	  Memory: 192.0 GB
	  Network: 37.5 Gigabit
	  Price: pricing varies

config TERRAFORM_AWS_INSTANCE_C7I_24XLARGE
	bool "c7i.24xlarge"
	help
	  vCPUs: 96
	  Memory: 192.0 GB
	  Network: 37.5 Gigabit
	  Price: pricing varies

config TERRAFORM_AWS_INSTANCE_C7I_METAL_48XL
	bool "c7i.metal-48xl"
	help
	  vCPUs: 192
	  Memory: 384.0 GB
	  Network: 50 Gigabit
	  Price: pricing varies

config TERRAFORM_AWS_INSTANCE_C7I_48XLARGE
	bool "c7i.48xlarge"
	help
	  vCPUs: 192
	  Memory: 384.0 GB
	  Network: 50 Gigabit
	  Price: pricing varies

endchoice

config TERRAFORM_AWS_C7I_SIZE
	string
	default "c7i.large" if TERRAFORM_AWS_INSTANCE_C7I_LARGE
	default "c7i.xlarge" if TERRAFORM_AWS_INSTANCE_C7I_XLARGE
	default "c7i.2xlarge" if TERRAFORM_AWS_INSTANCE_C7I_2XLARGE
	default "c7i.4xlarge" if TERRAFORM_AWS_INSTANCE_C7I_4XLARGE
	default "c7i.8xlarge" if TERRAFORM_AWS_INSTANCE_C7I_8XLARGE
	default "c7i.12xlarge" if TERRAFORM_AWS_INSTANCE_C7I_12XLARGE
	default "c7i.16xlarge" if TERRAFORM_AWS_INSTANCE_C7I_16XLARGE
	default "c7i.metal-24xl" if TERRAFORM_AWS_INSTANCE_C7I_METAL_24XL
	default "c7i.24xlarge" if TERRAFORM_AWS_INSTANCE_C7I_24XLARGE
	default "c7i.metal-48xl" if TERRAFORM_AWS_INSTANCE_C7I_METAL_48XL
	default "c7i.48xlarge" if TERRAFORM_AWS_INSTANCE_C7I_48XLARGE
	default "c7i.large"
```
