## terraform/azure/kconfigs/Kconfig.location
```kconfig
choice
	prompt "Azure resource location"
	default TERRAFORM_AZURE_REGION_WESTUS
	help
	  Choose the region and data center which will host your
	  kdevops resouces. A current list of Azure region codes can
	  be generated via the Azure CLI:

	  "az account list-locations -o table"

	  Azure chooses an availability zone for your resources
	  automatically.

config TERRAFORM_AZURE_REGION_EASTASIA
	bool "East Asia"
	help
	  This option selects the East Asia region, located in
	  Hong Kong and paired with the Southeast Asia region.

config TERRAFORM_AZURE_REGION_SOUTHEASTASIA
	bool "Southeast Asia"
	help
	  This option selects the Southeast Asia region, located in
	  Singapore and paired with the East Asia region.

config TERRAFORM_AZURE_REGION_CANADACENTRAL
	bool "Canada Central"
	help
	  This option selects the Canada Central region, located in
	  the province of Ontario and paired with the Canada East
	  region.

config TERRAFORM_AZURE_REGION_CANADAEAST
	bool "Canada East"
	help
	  This option selects the Canada East region, located in the
	  province of Quebec and paired with the Canada Central
	  region.

config TERRAFORM_AZURE_REGION_CENTRALINDIA
	bool "Central India"
	help
	  This option selects the Central India region, located in
	  Pune, India and paired with the South India region.

config TERRAFORM_AZURE_REGION_SOUTHINDIA
	bool "South India"
	help
	  This option selects the South India region, located in
	  Chennai, India and paired with the Central India region.

config TERRAFORM_AZURE_REGION_WESTINDIA
	bool "West India"
	help
	  This option selects the West India region, located in
	  Mumbai, India and paired with the Central India region.

config TERRAFORM_AZURE_REGION_CENTRALUS
	bool "Central US"
	help
	  This option selects the Central US region, located in the
	  US state of Iowa and paired with the East US 2 region.

config TERRAFORM_AZURE_REGION_EASTUS
	bool "East US"
	help
	  This option selects the East US region, located in the
	  US state of Virgina and paired with the West US region.

config TERRAFORM_AZURE_REGION_EASTUS2
	bool "East US 2"
	help
	  This option selects the East US 2 region, located in
	  the US state of Virgina and paired with the Central US
	  region.

config TERRAFORM_AZURE_REGION_NORTHCENTRALUS
	bool "North Central US"
	help
	  This option selects the North Central US region, located
	  in the US state of Illinois and paired with the South
	  Central US region.

config TERRAFORM_AZURE_REGION_SOUTHCENTRALUS
	bool "South Central US"
	help
	  This option selects the South Central US region, located
	  in the US state of Texas and paired with the North Central
	  US region.

config TERRAFORM_AZURE_REGION_WESTUS
	bool "West US"
	help
	  This option selects the West US region, located in the US
	  state of California and paired with the East US region.

config TERRAFORM_AZURE_REGION_WESTUS2
	bool "West US 2"
	help
	  This option selects the West US 2 region, located in the
	  US state of Washington and paired with the West Central
	  US region.

config TERRAFORM_AZURE_REGION_WESTUS3
	bool "West US 3"
	help
	  This option selects the West US 3 region, located in the
	  US state of Arizona and paired with the East US region.

config TERRAFORM_AZURE_REGION_WESTCENTRALUS
	bool "West Central US"
	help
	  This option selects the (US) West Central US region,
	  located in the US state of Wyoming and paired with the
	  West US 2 region.

endchoice

config TERRAFORM_AZURE_LOCATION
	string
	output yaml
	default "eastasia" if TERRAFORM_AZURE_REGION_EASTASIA
	default "southeastasia" if TERRAFORM_AZURE_REGION_SOUTHEASTASIA
	default "canadacentral" if TERRAFORM_AZURE_REGION_CANADACENTRAL
	default "canadaeast" if TERRAFORM_AZURE_REGION_CANADAEAST
	default "centralindia" if TERRAFORM_AZURE_REGION_CENTRALINDIA
	default "southindia" if TERRAFORM_AZURE_REGION_SOUTHINDIA
	default "centralus" if TERRAFORM_AZURE_REGION_CENTRALUS
	default "eastus" if TERRAFORM_AZURE_REGION_EASTUS
	default "eastus2" if TERRAFORM_AZURE_REGION_EASTUS2
	default "northcentralus" if TERRAFORM_AZURE_REGION_NORTHCENTRALUS
	default "southcentralus" if TERRAFORM_AZURE_REGION_SOUTHCENTRALUS
	default "westus" if TERRAFORM_AZURE_REGION_WESTUS
	default "westus2" if TERRAFORM_AZURE_REGION_WESTUS2
	default "westus3" if TERRAFORM_AZURE_REGION_WESTUS3
	default "westcentralus" if TERRAFORM_AZURE_REGION_WESTCENTRALUS

config TERRAFORM_AZURE_RESOURCE_GROUP_NAME
	string "Azure resource group name"
	output yaml
	default "kdevops_resource_group"
	help
	  An Azure resource group is a container that holds related
	  resources so they can be managed as a single unit. These
	  resources share the same life cycle and are deployed,
	  updated, and deleted together. Resource groups are global
	  to your subscription.

	  To run concurrent kdevops jobs in Azure, each run must
	  have a unique resouce group name.

	  https://learn.microsoft.com/en-us/azure/azure-resource-manager/management/overview#resource-groups
```
