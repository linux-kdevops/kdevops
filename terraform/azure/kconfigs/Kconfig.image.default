## terraform/gce/kconfigs/Kconfig.location
```kconfig
choice
	prompt "GCE region"
	default TERRAFORM_GCE_REGION_US_WEST2
	help
	  GCE regions are collections of co-located zones. Zones have
	  high-bandwidth, low-latency network connections to other
	  zones within the same region.

	  For details:
	  https://cloud.google.com/compute/docs/regions-zones/

	  For guidance selecting a region to use, try:
	  https://cloud.withgoogle.com/region-picker/

config TERRAFORM_GCE_REGION_ASIA_SOUTH1
	bool "asia-south1"
	help
	  Mumbai, India

config TERRAFORM_GCE_REGION_ASIA_SOUTH2
	bool "asia-south2"
	help
	  Delhi, India

config TERRAFORM_GCE_REGION_NORTHAMERICA_NORTHEAST1
	bool "northamerica-northeast1"
	help
	  Montreal, Quebec, Canada

config TERRAFORM_GCE_REGION_NORTHAMERICA_NORTHEAST2
	bool "northamerica-northeast2"
	help
	  Toronto, Ontario, Canada

config TERRAFORM_GCE_REGION_NORTHAMERICA_SOUTH1
	bool "northamerica-south1"
	help
	  Querétaro, Mexico

config TERRAFORM_GCE_REGION_US_CENTRAL1
	bool "us-central1"
	help
	  Council Bluffs, Iowa, USA

config TERRAFORM_GCE_REGION_US_EAST1
	bool "us-east1"
	help
	  Moncks Corner, South Carolina, USA

config TERRAFORM_GCE_REGION_US_EAST4
	bool "us-east4"
	help
	  Ashburn, Virginia, USA

config TERRAFORM_GCE_REGION_US_EAST5
	bool "us-east5"
	help
	  Columbus, Ohio, USA

config TERRAFORM_GCE_REGION_US_SOUTH1
	bool "us-south1"
	help
	  Dallas, Texas, USA

config TERRAFORM_GCE_REGION_US_WEST1
	bool "us-west1"
	help
	  The Dalles, Oregon, USA

config TERRAFORM_GCE_REGION_US_WEST2
	bool "us-west2"
	help
	  Los Angeles, California, USA

config TERRAFORM_GCE_REGION_US_WEST3
	bool "us-west3"
	help
	  Salt Lake City, Utah, USA

config TERRAFORM_GCE_REGION_US_WEST4
	bool "us-west4"
	help
	  Las Vegas, Nevada, USA

endchoice

config TERRAFORM_GCE_REGION
	string
	output yaml
	default "asia-south1" if TERRAFORM_GCE_REGION_ASIA_SOUTH1
	default "asia-south2" if TERRAFORM_GCE_REGION_ASIA_SOUTH2
	default "northamerica-northeast1" if TERRAFORM_GCE_REGION_NORTHAMERICA_NORTHEAST1
	default "northamerica-northeast2" if TERRAFORM_GCE_REGION_NORTHAMERICA_NORTHEAST2
	default "northamerica-south1" if TERRAFORM_GCE_REGION_NORTHAMERICA_SOUTH1
	default "us-central1" if TERRAFORM_GCE_REGION_US_CENTRAL1
	default "us-east1" if TERRAFORM_GCE_REGION_US_EAST1
	default "us-east4" if TERRAFORM_GCE_REGION_US_EAST4
	default "us-east5" if TERRAFORM_GCE_REGION_US_EAST5
	default "us-south1" if TERRAFORM_GCE_REGION_US_SOUTH1
	default "us-west1" if TERRAFORM_GCE_REGION_US_WEST1
	default "us-west2" if TERRAFORM_GCE_REGION_US_WEST2
	default "us-west3" if TERRAFORM_GCE_REGION_US_WEST3
	default "us-west4" if TERRAFORM_GCE_REGION_US_WEST4

if TERRAFORM_GCE_REGION_ASIA_SOUTH1

choice
	prompt "GCE zone"
	default TERRAFORM_GCE_REGION_ASIA_SOUTH1_B
	help
	  A zone is a deployment area within a region.

config TERRAFORM_GCE_REGION_ASIA_SOUTH1_A
	bool "asia-south1-a"

config TERRAFORM_GCE_REGION_ASIA_SOUTH1_B
	bool "asia-south1-b"

config TERRAFORM_GCE_REGION_ASIA_SOUTH1_C
	bool "asia-south1-c"

endchoice

config TERRAFORM_GCE_ZONE
	string
	output yaml
	default "asia-south1-a" if TERRAFORM_GCE_REGION_ASIA_SOUTH1_A
	default "asia-south1-b" if TERRAFORM_GCE_REGION_ASIA_SOUTH1_B
	default "asia-south1-c" if TERRAFORM_GCE_REGION_ASIA_SOUTH1_C

endif # TERRAFORM_GCE_REGION_ASIA_SOUTH1

if TERRAFORM_GCE_REGION_ASIA_SOUTH2

choice
	prompt "GCE zone"
	default TERRAFORM_GCE_REGION_ASIA_SOUTH2_B
	help
	  A zone is a deployment area within a region.

config TERRAFORM_GCE_REGION_ASIA_SOUTH2_A
	bool "asia-south2-a"

config TERRAFORM_GCE_REGION_ASIA_SOUTH2_B
	bool "asia-south2-b"

config TERRAFORM_GCE_REGION_ASIA_SOUTH2_C
	bool "asia-south2-c"

endchoice

config TERRAFORM_GCE_ZONE
	string
	output yaml
	default "asia-south2-a" if TERRAFORM_GCE_REGION_ASIA_SOUTH2_A
	default "asia-south2-b" if TERRAFORM_GCE_REGION_ASIA_SOUTH2_B
	default "asia-south2-c" if TERRAFORM_GCE_REGION_ASIA_SOUTH2_C

endif # TERRAFORM_GCE_REGION_ASIA_SOUTH2

if TERRAFORM_GCE_REGION_NORTHAMERICA_NORTHEAST1

choice
	prompt "GCE zone"
	default TERRAFORM_GCE_REGION_NORTHAMERICA_NORTHEAST1_B
	help
	  A zone is a deployment area within a region.

config TERRAFORM_GCE_REGION_NORTHAMERICA_NORTHEAST1_A
	bool "northamerica-northeast1-a"

config TERRAFORM_GCE_REGION_NORTHAMERICA_NORTHEAST1_B
	bool "northamerica-northeast1-b"

config TERRAFORM_GCE_REGION_NORTHAMERICA_NORTHEAST1_C
	bool "northamerica-northeast1-c"

endchoice

config TERRAFORM_GCE_ZONE
	string
	output yaml
	default "northamerica-northeast1-a" if TERRAFORM_GCE_REGION_NORTHAMERICA_NORTHEAST1_A
	default "northamerica-northeast1-b" if TERRAFORM_GCE_REGION_NORTHAMERICA_NORTHEAST1_B
	default "northamerica-northeast1-c" if TERRAFORM_GCE_REGION_NORTHAMERICA_NORTHEAST1_C

endif # TERRAFORM_GCE_REGION_NORTHAMERICA_NORTHEAST1

if TERRAFORM_GCE_REGION_NORTHAMERICA_NORTHEAST2

choice
	prompt "GCE zone"
	default TERRAFORM_GCE_REGION_NORTHAMERICA_NORTHEAST2_B
	help
	  A zone is a deployment area within a region.

config TERRAFORM_GCE_REGION_NORTHAMERICA_NORTHEAST2_A
	bool "northamerica-northeast2-a"

config TERRAFORM_GCE_REGION_NORTHAMERICA_NORTHEAST2_B
	bool "northamerica-northeast2-b"

config TERRAFORM_GCE_REGION_NORTHAMERICA_NORTHEAST2_C
	bool "northamerica-northeast2-c"

endchoice

config TERRAFORM_GCE_ZONE
	string
	output yaml
	default "northamerica-northeast2-a" if TERRAFORM_GCE_REGION_NORTHAMERICA_NORTHEAST2_A
	default "northamerica-northeast2-b" if TERRAFORM_GCE_REGION_NORTHAMERICA_NORTHEAST2_B
	default "northamerica-northeast2-c" if TERRAFORM_GCE_REGION_NORTHAMERICA_NORTHEAST2_C

endif # TERRAFORM_GCE_REGION_NORTHAMERICA_NORTHEAST2

if TERRAFORM_GCE_REGION_NORTHAMERICA_SOUTH1

choice
	prompt "GCE zone"
	default TERRAFORM_GCE_REGION_NORTHAMERICA_SOUTH1_B
	help
	  A zone is a deployment area within a region.

config TERRAFORM_GCE_REGION_NORTHAMERICA_SOUTH1_A
	bool "northamerica-south1-a"

config TERRAFORM_GCE_REGION_NORTHAMERICA_SOUTH1_B
	bool "northamerica-south1-b"

config TERRAFORM_GCE_REGION_NORTHAMERICA_SOUTH1_C
	bool "northamerica-south1-c"

endchoice

config TERRAFORM_GCE_ZONE
	string
	output yaml
	default "northamerica-south1-a" if TERRAFORM_GCE_REGION_NORTHAMERICA_SOUTH1_A
	default "northamerica-south1-b" if TERRAFORM_GCE_REGION_NORTHAMERICA_SOUTH1_B
	default "northamerica-south1-c" if TERRAFORM_GCE_REGION_NORTHAMERICA_SOUTH1_C

endif # TERRAFORM_GCE_REGION_NORTHAMERICA_SOUTH1

if TERRAFORM_GCE_REGION_US_CENTRAL1

choice
	prompt "GCE zone"
	default TERRAFORM_GCE_ZONE_US_CENTRAL1_C
	help
	  A zone is a deployment area within a region.

config TERRAFORM_GCE_ZONE_US_CENTRAL1_A
	bool "us-central1-a"

config TERRAFORM_GCE_ZONE_US_CENTRAL1_B
	bool "us-central1-b"

config TERRAFORM_GCE_ZONE_US_CENTRAL1_C
	bool "us-central1-c"

config TERRAFORM_GCE_ZONE_US_CENTRAL1_F
	bool "us-central1-f"

endchoice

config TERRAFORM_GCE_ZONE
	string
	output yaml
	default "us-central1-a" if TERRAFORM_GCE_ZONE_US_CENTRAL1_A
	default "us-central1-b" if TERRAFORM_GCE_ZONE_US_CENTRAL1_B
	default "us-central1-c" if TERRAFORM_GCE_ZONE_US_CENTRAL1_C
	default "us-central1-f" if TERRAFORM_GCE_ZONE_US_CENTRAL1_F

endif # TERRAFORM_GCE_REGION_US_CENTRAL1

if TERRAFORM_GCE_REGION_US_EAST1

choice
	prompt "GCE zone"
	default TERRAFORM_GCE_ZONE_US_EAST1_B
	help
	  A zone is a deployment area within a region.

config TERRAFORM_GCE_ZONE_US_EAST1_B
	bool "us-east1-b"

config TERRAFORM_GCE_ZONE_US_EAST1_C
	bool "us-east1-c"

config TERRAFORM_GCE_ZONE_US_EAST1_D
	bool "us-east1-d"

endchoice

config TERRAFORM_GCE_ZONE
	string
	output yaml
	default "us-east1-b" if TERRAFORM_GCE_ZONE_US_EAST1_B
	default "us-east1-c" if TERRAFORM_GCE_ZONE_US_EAST1_C
	default "us-east1-d" if TERRAFORM_GCE_ZONE_US_EAST1_D

endif # TERRAFORM_GCE_REGION_US_EAST1

if TERRAFORM_GCE_REGION_US_EAST4

choice
	prompt "GCE zone"
	default TERRAFORM_GCE_ZONE_US_EAST4_C
	help
	  A zone is a deployment area within a region.

config TERRAFORM_GCE_ZONE_US_EAST4_A
	bool "us-east4-a"

config TERRAFORM_GCE_ZONE_US_EAST4_B
	bool "us-east4-b"

config TERRAFORM_GCE_ZONE_US_EAST4_C
	bool "us-east4-c"

endchoice

config TERRAFORM_GCE_ZONE
	string
	output yaml
	default "us-east4-a" if TERRAFORM_GCE_ZONE_US_EAST4_A
	default "us-east4-b" if TERRAFORM_GCE_ZONE_US_EAST4_B
	default "us-east4-c" if TERRAFORM_GCE_ZONE_US_EAST4_C

endif # TERRAFORM_GCE_REGION_US_EAST4

if TERRAFORM_GCE_REGION_US_EAST5

choice
	prompt "GCE zone"
	default TERRAFORM_GCE_ZONE_US_EAST5_B
	help
	  A zone is a deployment area within a region.

config TERRAFORM_GCE_ZONE_US_EAST5_A
	bool "us-east5-a"

config TERRAFORM_GCE_ZONE_US_EAST5_B
	bool "us-east5-b"

config TERRAFORM_GCE_ZONE_US_EAST5_C
	bool "us-east5-c"

endchoice

config TERRAFORM_GCE_ZONE
	string
	output yaml
	default "us-east5-a" if TERRAFORM_GCE_ZONE_US_EAST5_A
	default "us-east5-b" if TERRAFORM_GCE_ZONE_US_EAST5_B
	default "us-east5-c" if TERRAFORM_GCE_ZONE_US_EAST5_C

endif # TERRAFORM_GCE_REGION_US_EAST5

if TERRAFORM_GCE_REGION_US_SOUTH1

choice
	prompt "GCE zone"
	default TERRAFORM_GCE_ZONE_US_SOUTH1_B
	help
	  A zone is a deployment area within a region.

config TERRAFORM_GCE_ZONE_US_SOUTH1_A
	bool "us-south1-a"

config TERRAFORM_GCE_ZONE_US_SOUTH1_B
	bool "us-south1-b"

config TERRAFORM_GCE_ZONE_US_SOUTH1_C
	bool "us-south1-c"

endchoice

config TERRAFORM_GCE_ZONE
	string
	output yaml
	default "us-south1-a" if TERRAFORM_GCE_ZONE_US_SOUTH1_A
	default "us-south1-b" if TERRAFORM_GCE_ZONE_US_SOUTH1_B
	default "us-south1-c" if TERRAFORM_GCE_ZONE_US_SOUTH1_C

endif # TERRAFORM_GCE_REGION_US_SOUTH1

if TERRAFORM_GCE_REGION_US_WEST1

choice
	prompt "GCE zone"
	default TERRAFORM_GCE_ZONE_US_WEST1_B
	help
	  A zone is a deployment area within a region.

config TERRAFORM_GCE_ZONE_US_WEST1_A
	bool "us-west1-a"

config TERRAFORM_GCE_ZONE_US_WEST1_B
	bool "us-west1-b"

config TERRAFORM_GCE_ZONE_US_WEST1_C
	bool "us-west1-c"

endchoice

config TERRAFORM_GCE_ZONE
	string
	output yaml
	default "us-west1-a" if TERRAFORM_GCE_ZONE_US_WEST1_A
	default "us-west1-b" if TERRAFORM_GCE_ZONE_US_WEST1_B
	default "us-west1-c" if TERRAFORM_GCE_ZONE_US_WEST1_C

endif # TERRAFORM_GCE_REGION_US_WEST1

if TERRAFORM_GCE_REGION_US_WEST2

choice
	prompt "GCE zone"
	default TERRAFORM_GCE_ZONE_US_WEST2_C
	help
	  A zone is a deployment area within a region.

config TERRAFORM_GCE_ZONE_US_WEST2_A
	bool "us-west2-a"

config TERRAFORM_GCE_ZONE_US_WEST2_B
	bool "us-west2-b"

config TERRAFORM_GCE_ZONE_US_WEST2_C
	bool "us-west2-c"

endchoice

config TERRAFORM_GCE_ZONE
	string
	output yaml
	default "us-west2-a" if TERRAFORM_GCE_ZONE_US_WEST2_A
	default "us-west2-b" if TERRAFORM_GCE_ZONE_US_WEST2_B
	default "us-west2-c" if TERRAFORM_GCE_ZONE_US_WEST2_C

endif # TERRAFORM_GCE_REGION_US_WEST2

if TERRAFORM_GCE_REGION_US_WEST3

choice
	prompt "GCE zone"
	default TERRAFORM_GCE_ZONE_US_WEST3_B
	help
	  A zone is a deployment area within a region.

config TERRAFORM_GCE_ZONE_US_WEST3_A
	bool "us-west3-a"

config TERRAFORM_GCE_ZONE_US_WEST3_B
	bool "us-west3-b"

config TERRAFORM_GCE_ZONE_US_WEST3_C
	bool "us-west3-c"

endchoice

config TERRAFORM_GCE_ZONE
	string
	output yaml
	default "us-west3-a" if TERRAFORM_GCE_ZONE_US_WEST3_A
	default "us-west3-b" if TERRAFORM_GCE_ZONE_US_WEST3_B
	default "us-west3-c" if TERRAFORM_GCE_ZONE_US_WEST3_C

endif # TERRAFORM_GCE_REGION_US_WEST3

if TERRAFORM_GCE_REGION_US_WEST4

choice
	prompt "GCE zone"
	default TERRAFORM_GCE_ZONE_US_WEST4_B
	help
	  A zone is a deployment area within a region.

config TERRAFORM_GCE_ZONE_US_WEST4_A
	bool "us-west4-a"

config TERRAFORM_GCE_ZONE_US_WEST4_B
	bool "us-west4-b"

config TERRAFORM_GCE_ZONE_US_WEST4_C
	bool "us-west4-c"

endchoice

config TERRAFORM_GCE_ZONE
	string
	output yaml
	default "us-west4-a" if TERRAFORM_GCE_ZONE_US_WEST4_A
	default "us-west4-b" if TERRAFORM_GCE_ZONE_US_WEST4_B
	default "us-west4-c" if TERRAFORM_GCE_ZONE_US_WEST4_C

endif # TERRAFORM_GCE_REGION_US_WEST4
```
