## terraform/azure/kconfigs/Kconfig.size
```kconfig
choice
	prompt "Azure vmsize"
	default TERRAFORM_AZURE_VM_SIZE_STANDARD_DS3_V2
	help
	  This option chooses the size of the virtual machine instances
	  to be created for the kdevops target nodes.

config TERRAFORM_AZURE_VM_SIZE_STANDARD_DS1_V2
	bool "Standard_DS1_v2"
	depends on TARGET_ARCH_X86_64
	help
	  This virtual machine size has one vCPU and 3.5GB of memory.
	  Azure documentation notes that this size is part of a
	  previous generation series, and is to become unavailable
	  after May 1, 2028.

config TERRAFORM_AZURE_VM_SIZE_STANDARD_DS3_V2
	bool "Standard_DS3_v2"
	depends on TARGET_ARCH_X86_64
	help
	  This virtual machine size has four vCPUs and 14GB of memory.
	  Azure documentation notes that this size is part of a
	  previous generation series, and is to become unavailable
	  after May 1, 2028.

config TERRAFORM_AZURE_VM_SIZE_STANDARD_D2S_V3
	bool "Standard_D2s_v3"
	depends on TARGET_ARCH_X86_64
	help
	  This virtual machine size has two vCPUs and 8GB of memory.

config TERRAFORM_AZURE_VM_SIZE_STANDARD_D4S_V3
	bool "Standard_D4s_v3"
	depends on TARGET_ARCH_X86_64
	help
	  This virtual machine size has four vCPUs and 16GB of memory.

config TERRAFORM_AZURE_VM_SIZE_STANDARD_D8S_V3
	bool "Standard_D8s_v3"
	depends on TARGET_ARCH_X86_64
	help
	  This virtual machine size has eight vCPUs and 32GB of memory.

config TERRAFORM_AZURE_VM_SIZE_STANDARD_D2S_V4
	bool "Standard_D2s_v4"
	depends on TARGET_ARCH_X86_64
	help
	  This virtual machine size has two vCPUs and 8GB of memory.

config TERRAFORM_AZURE_VM_SIZE_STANDARD_D4S_V4
	bool "Standard_D4s_v4"
	depends on TARGET_ARCH_X86_64
	help
	  This virtual machine size has four vCPUs and 16GB of memory.

config TERRAFORM_AZURE_VM_SIZE_STANDARD_D8S_V4
	bool "Standard_D8s_v4"
	depends on TARGET_ARCH_X86_64
	help
	  This virtual machine size has eight vCPUs and 32GB of memory.

config TERRAFORM_AZURE_VM_SIZE_STANDARD_D2S_V6
	bool "Standard_D2s_v6"
	depends on TARGET_ARCH_X86_64
	help
	  This virtual machine size has two vCPUs and 8GB of memory.

config TERRAFORM_AZURE_VM_SIZE_STANDARD_D4S_V6
	bool "Standard_D4s_v6"
	depends on TARGET_ARCH_X86_64
	help
	  This virtual machine size has four vCPUs and 16GB of memory.

config TERRAFORM_AZURE_VM_SIZE_STANDARD_D8S_V6
	bool "Standard_D8s_v6"
	depends on TARGET_ARCH_X86_64
	help
	  This virtual machine size has eight vCPUs and 32GB of memory.

endchoice

config TERRAFORM_AZURE_VM_SIZE
	string
	output yaml
	default "Standard_DS1_v2" if TERRAFORM_AZURE_VM_SIZE_STANDARD_DS1_V2
	default "Standard_DS3_v2" if TERRAFORM_AZURE_VM_SIZE_STANDARD_DS3_V2
	default "Standard_D2s_v3" if TERRAFORM_AZURE_VM_SIZE_STANDARD_D2S_V3
	default "Standard_D4s_v3" if TERRAFORM_AZURE_VM_SIZE_STANDARD_D4S_V3
	default "Standard_D8s_v3" if TERRAFORM_AZURE_VM_SIZE_STANDARD_D8S_V3
	default "Standard_D2s_v4" if TERRAFORM_AZURE_VM_SIZE_STANDARD_D2S_V4
	default "Standard_D4s_v4" if TERRAFORM_AZURE_VM_SIZE_STANDARD_D4S_V4
	default "Standard_D8s_v4" if TERRAFORM_AZURE_VM_SIZE_STANDARD_D8S_V4
	default "Standard_D2s_v6" if TERRAFORM_AZURE_VM_SIZE_STANDARD_D2S_V6
	default "Standard_D4s_v6" if TERRAFORM_AZURE_VM_SIZE_STANDARD_D4S_V6
	default "Standard_D8s_v6" if TERRAFORM_AZURE_VM_SIZE_STANDARD_D8S_V6

config TERRAFORM_AZURE_ACCELERATED_NETWORKING_ENABLED
	bool
	output yaml
	default n if TERRAFORM_AZURE_VM_SIZE_STANDARD_B1S
	default n if TERRAFORM_AZURE_VM_SIZE_STANDARD_B2S
	default n if TERRAFORM_AZURE_VM_SIZE_STANDARD_B4MS
	default n if TERRAFORM_AZURE_VM_SIZE_STANDARD_B8MS
	default n if TERRAFORM_AZURE_VM_SIZE_STANDARD_B12MS
	default n if TERRAFORM_AZURE_VM_SIZE_STANDARD_B16MS
	default n if TERRAFORM_AZURE_VM_SIZE_STANDARD_B20MS
	default n if TERRAFORM_AZURE_VM_SIZE_STANDARD_B2TS_V2
	default n if TERRAFORM_AZURE_VM_SIZE_STANDARD_B2LS_V2
	default n if TERRAFORM_AZURE_VM_SIZE_STANDARD_B2S_V2
	default n if TERRAFORM_AZURE_VM_SIZE_STANDARD_B4LS_V2
	default n if TERRAFORM_AZURE_VM_SIZE_STANDARD_B4S_V2
	default n if TERRAFORM_AZURE_VM_SIZE_STANDARD_B8LS_V2
	default n if TERRAFORM_AZURE_VM_SIZE_STANDARD_B8S_V2
	default n if TERRAFORM_AZURE_VM_SIZE_STANDARD_B16LS_V2
	default n if TERRAFORM_AZURE_VM_SIZE_STANDARD_B16S_V2
	default n if TERRAFORM_AZURE_VM_SIZE_STANDARD_B32LS_V2
	default n if TERRAFORM_AZURE_VM_SIZE_STANDARD_B32S_V2
	default n if TERRAFORM_AZURE_VM_SIZE_STANDARD_DS1_V2
	default n if TERRAFORM_AZURE_VM_SIZE_STANDARD_DS3_V2
	default y if TERRAFORM_AZURE_VM_SIZE_STANDARD_D2S_V3
	default y if TERRAFORM_AZURE_VM_SIZE_STANDARD_D4S_V3
	default y if TERRAFORM_AZURE_VM_SIZE_STANDARD_D8S_V3
	default y if TERRAFORM_AZURE_VM_SIZE_STANDARD_D2S_V4
	default y if TERRAFORM_AZURE_VM_SIZE_STANDARD_D4S_V4
	default y if TERRAFORM_AZURE_VM_SIZE_STANDARD_D8S_V4
	default y if TERRAFORM_AZURE_VM_SIZE_STANDARD_D2S_V6
	default y if TERRAFORM_AZURE_VM_SIZE_STANDARD_D4S_V6
	default y if TERRAFORM_AZURE_VM_SIZE_STANDARD_D8S_V6
```

## terraform/azure/kconfigs/Kconfig.storage
```kconfig
choice
	prompt "Count of extra managed disks"
	default TERRAFORM_AZURE_MANAGED_DISKS_PER_INSTANCE_4
	help
	  The count of managed disks attached to each instance.

config TERRAFORM_AZURE_MANAGED_DISKS_PER_INSTANCE_0
	bool "0"
	help
	  Provision no extra managed disks per instance.

config TERRAFORM_AZURE_MANAGED_DISKS_PER_INSTANCE_1
	bool "1"
	help
	  Provision 1 extra managed disk per instance.

config TERRAFORM_AZURE_MANAGED_DISKS_PER_INSTANCE_2
	bool "2"
	help
	  Provision 2 extra managed disks per instance.

config TERRAFORM_AZURE_MANAGED_DISKS_PER_INSTANCE_3
	bool "3"
	help
	  Provision 3 extra managed disks per instance.

config TERRAFORM_AZURE_MANAGED_DISKS_PER_INSTANCE_4
	bool "4"
	help
	  Provision 4 extra managed disks per instance.

config TERRAFORM_AZURE_MANAGED_DISKS_PER_INSTANCE_5
	bool "5"
	help
	  Provision 5 extra managed disks per instance.

config TERRAFORM_AZURE_MANAGED_DISKS_PER_INSTANCE_6
	bool "6"
	help
	  Provision 6 extra managed disks per instance.

config TERRAFORM_AZURE_MANAGED_DISKS_PER_INSTANCE_7
	bool "7"
	help
	  Provision 7 extra managed disks per instance.

config TERRAFORM_AZURE_MANAGED_DISKS_PER_INSTANCE_8
	bool "8"
	help
	  Provision 8 extra managed disks per instance.

config TERRAFORM_AZURE_MANAGED_DISKS_PER_INSTANCE_9
	bool "9"
	help
	  Provision 9 extra managed disks per instance.

config TERRAFORM_AZURE_MANAGED_DISKS_PER_INSTANCE_10
	bool "10"
	help
	  Provision 10 extra managed disks per instance.

endchoice

config TERRAFORM_AZURE_MANAGED_DISKS_PER_INSTANCE
	int
	output yaml
	default 1 if TERRAFORM_AZURE_MANAGED_DISKS_PER_INSTANCE_1
	default 2 if TERRAFORM_AZURE_MANAGED_DISKS_PER_INSTANCE_2
	default 3 if TERRAFORM_AZURE_MANAGED_DISKS_PER_INSTANCE_3
	default 4 if TERRAFORM_AZURE_MANAGED_DISKS_PER_INSTANCE_4
	default 5 if TERRAFORM_AZURE_MANAGED_DISKS_PER_INSTANCE_5
	default 6 if TERRAFORM_AZURE_MANAGED_DISKS_PER_INSTANCE_6
	default 7 if TERRAFORM_AZURE_MANAGED_DISKS_PER_INSTANCE_7
	default 8 if TERRAFORM_AZURE_MANAGED_DISKS_PER_INSTANCE_8
	default 9 if TERRAFORM_AZURE_MANAGED_DISKS_PER_INSTANCE_9
	default 10 if TERRAFORM_AZURE_MANAGED_DISKS_PER_INSTANCE_10

choice
	prompt "Volume size for each additional volume"
	default TERRAFORM_AZURE_MANAGED_DISKS_SIZE_64G
	help
	  This option selects the size (in gibibytes) of managed
	  disks create for each instance.

config TERRAFORM_AZURE_MANAGED_DISKS_SIZE_4G
	bool "4G"
	help
	  Managed disks are 4 GiB in size.

config TERRAFORM_AZURE_MANAGED_DISKS_SIZE_8G
	bool "8G"
	help
	  Managed disks are 8 GiB in size.

config TERRAFORM_AZURE_MANAGED_DISKS_SIZE_16G
	bool "16G"
	help
	  Managed disks are 16 GiB in size.

config TERRAFORM_AZURE_MANAGED_DISKS_SIZE_32G
	bool "32G"
	help
	  Managed disks are 32 GiB in size.

config TERRAFORM_AZURE_MANAGED_DISKS_SIZE_64G
	bool "64G"
	help
	  Managed disks are 64 GiB in size.

config TERRAFORM_AZURE_MANAGED_DISKS_SIZE_128G
	bool "128G"
	help
	  Managed disks are 128 GiB in size.

config TERRAFORM_AZURE_MANAGED_DISKS_SIZE_256G
	bool "256G"
	help
	  Managed disks are 256 GiB in size.

config TERRAFORM_AZURE_MANAGED_DISKS_SIZE_512G
	bool "512G"
	help
	  Managed disks are 512 GiB in size.

config TERRAFORM_AZURE_MANAGED_DISKS_SIZE_1024G
	bool "1024G"
	help
	  Managed disks are 1024 GiB in size.

config TERRAFORM_AZURE_MANAGED_DISKS_SIZE_2048G
	bool "2048G"
	help
	  Managed disks are 2048 GiB in size.

config TERRAFORM_AZURE_MANAGED_DISKS_SIZE_4096G
	bool "4096G"
	help
	  Managed disks are 4096 GiB in size.

endchoice

config TERRAFORM_AZURE_MANAGED_DISKS_SIZE
	int
	output yaml
	default 4 if TERRAFORM_AZURE_MANAGED_DISKS_SIZE_4G
	default 8 if TERRAFORM_AZURE_MANAGED_DISKS_SIZE_8G
	default 16 if TERRAFORM_AZURE_MANAGED_DISKS_SIZE_16G
	default 32 if TERRAFORM_AZURE_MANAGED_DISKS_SIZE_32G
	default 64 if TERRAFORM_AZURE_MANAGED_DISKS_SIZE_64G
	default 128 if TERRAFORM_AZURE_MANAGED_DISKS_SIZE_128G
	default 256 if TERRAFORM_AZURE_MANAGED_DISKS_SIZE_256G
	default 512 if TERRAFORM_AZURE_MANAGED_DISKS_SIZE_512G
	default 1024 if TERRAFORM_AZURE_MANAGED_DISKS_SIZE_1024G
	default 2048 if TERRAFORM_AZURE_MANAGED_DISKS_SIZE_2048G
	default 4096 if TERRAFORM_AZURE_MANAGED_DISKS_SIZE_4096G

choice
	prompt "Performance tier for each managed disk"
	default TERRAFORM_AZURE_MANAGED_DISKS_TIER_P20
	help
	  The performance tier determines the maximum IOPS
	  and throughput each managed disk can handle.

config TERRAFORM_AZURE_MANAGED_DISKS_TIER_P1
	bool "P1"

config TERRAFORM_AZURE_MANAGED_DISKS_TIER_P2
	bool "P2"

config TERRAFORM_AZURE_MANAGED_DISKS_TIER_P3
	bool "P3"

config TERRAFORM_AZURE_MANAGED_DISKS_TIER_P4
	bool "P4"

config TERRAFORM_AZURE_MANAGED_DISKS_TIER_P6
	bool "P6"

config TERRAFORM_AZURE_MANAGED_DISKS_TIER_P10
	bool "P10"

config TERRAFORM_AZURE_MANAGED_DISKS_TIER_P15
	bool "P15"

config TERRAFORM_AZURE_MANAGED_DISKS_TIER_P20
	bool "P20"

config TERRAFORM_AZURE_MANAGED_DISKS_TIER_P30
	bool "P30"

config TERRAFORM_AZURE_MANAGED_DISKS_TIER_P40
	bool "P40"

config TERRAFORM_AZURE_MANAGED_DISKS_TIER_P50
	bool "P50"

endchoice

config TERRAFORM_AZURE_MANAGED_DISKS_TIER
	string
	output yaml
	default "P1" if TERRAFORM_AZURE_MANAGED_DISKS_TIER_P1
	default "P2" if TERRAFORM_AZURE_MANAGED_DISKS_TIER_P2
	default "P3" if TERRAFORM_AZURE_MANAGED_DISKS_TIER_P3
	default "P4" if TERRAFORM_AZURE_MANAGED_DISKS_TIER_P4
	default "P6" if TERRAFORM_AZURE_MANAGED_DISKS_TIER_P6
	default "P10" if TERRAFORM_AZURE_MANAGED_DISKS_TIER_P10
	default "P15" if TERRAFORM_AZURE_MANAGED_DISKS_TIER_P15
	default "P20" if TERRAFORM_AZURE_MANAGED_DISKS_TIER_P20
	default "P30" if TERRAFORM_AZURE_MANAGED_DISKS_TIER_P30
	default "P40" if TERRAFORM_AZURE_MANAGED_DISKS_TIER_P40
	default "P50" if TERRAFORM_AZURE_MANAGED_DISKS_TIER_P50

config TERRAFORM_AZURE_DATA_VOLUME_DEVICE_FILE_NAME
	string "Device name for the /data file system"
	default "/dev/disk/azure/scsi1/lun0"
	help
	  This option sets the name of the block device on each target
	  node that is to be used for the /data file system.
```

## terraform/azure/kconfigs/publishers/Kconfig.rhel
```kconfig
if TERRAFORM_AZURE_IMAGE_PUBLISHER_REDHAT

if TARGET_ARCH_X86_64

choice
	prompt "Red Hat Enterprise Linux release"
	default TERRAFORM_AZURE_IMAGE_LINUX_RHEL_9_6
	help
	  This option specifies which of a publisher's offers to use
	  when creating kdevops compute instances.

config TERRAFORM_AZURE_IMAGE_LINUX_RHEL_7_9
	bool "RHEL 7.9 x64"
	help
	  This option sets the OS image to Red Hat Enterprise Linux
	  release 7 update 9.

config TERRAFORM_AZURE_IMAGE_LINUX_RHEL_8_9
	bool "RHEL 8.9 x64"
	help
	  This option sets the OS image to Red Hat Enterprise Linux
	  release 8 update 9.

config TERRAFORM_AZURE_IMAGE_LINUX_RHEL_8_10
	bool "RHEL 8.10 x64"
	help
	  This option sets the OS image to Red Hat Enterprise Linux
	  release 8 update 10.

config TERRAFORM_AZURE_IMAGE_LINUX_RHEL_9_5
	bool "RHEL 9.5 x64"
	help
	  This option sets the OS image to Red Hat Enterprise Linux
	  release 9 update 5.

config TERRAFORM_AZURE_IMAGE_LINUX_RHEL_9_6
	bool "RHEL 9.6 x64"
	help
	  This option sets the OS image to Red Hat Enterprise Linux
	  release 9 update 6.

endchoice

config TERRAFORM_AZURE_IMAGE_OFFER
	string
	output yaml
	default "RHEL" if TERRAFORM_AZURE_IMAGE_LINUX_RHEL_7_9
	default "RHEL" if TERRAFORM_AZURE_IMAGE_LINUX_RHEL_8_9
	default "RHEL" if TERRAFORM_AZURE_IMAGE_LINUX_RHEL_8_10
	default "RHEL" if TERRAFORM_AZURE_IMAGE_LINUX_RHEL_9_5
	default "RHEL" if TERRAFORM_AZURE_IMAGE_LINUX_RHEL_9_6

config TERRAFORM_AZURE_IMAGE_SKU
	string
	output yaml
	default "7_9" if TERRAFORM_AZURE_IMAGE_LINUX_RHEL_7_9
	default "8_9" if TERRAFORM_AZURE_IMAGE_LINUX_RHEL_8_9
	default "8_10" if TERRAFORM_AZURE_IMAGE_LINUX_RHEL_8_10
	default "9_5" if TERRAFORM_AZURE_IMAGE_LINUX_RHEL_9_5
	default "9_6" if TERRAFORM_AZURE_IMAGE_LINUX_RHEL_9_6

endif # TARGET_ARCH_X86_64

endif # TERRAFORM_AZURE_IMAGE_PUBLISHER_REDHAT
```

## terraform/datacrunch/Kconfig
```kconfig
if TERRAFORM_DATACRUNCH

menu "Compute"
source "terraform/datacrunch/kconfigs/Kconfig.compute"
endmenu

menu "OS Image"
source "terraform/datacrunch/kconfigs/Kconfig.images"
endmenu

menu "Identity & Access"
source "terraform/datacrunch/kconfigs/Kconfig.identity"
endmenu

config TERRAFORM_DATACRUNCH_KEEP_VOLUMES
	bool "Keep OS-NVMe volumes on destroy for faster reprovisioning"
	default $(shell, test -n "$KEEP" && echo y || echo n)
	help
	  When enabled, OS-NVMe volumes are preserved after instance destruction
	  and cached for reuse on subsequent bringups. This significantly speeds
	  up provisioning by skipping OS installation and configuration.

	  DataCrunch charges $0.01370/h (~$10/month) for stored volumes.

	  Volume mappings are stored in:
	  ~/.cache/kdevops/datacrunch/$KDEVOPS_HOSTS_PREFIX.yml

	  When disabled (default), volumes are actively deleted on destroy to
	  avoid ongoing charges.

	  You can enable this via CLI:
	  make defconfig-datacrunch-a100 KEEP=1

config TERRAFORM_DATACRUNCH_API_KEY_FILE
	string "Path to DataCrunch API credentials file"
	default "~/.datacrunch/credentials"
	help
	  Path to the file containing your DataCrunch API client secret.
	  The file should be in INI format with a [default] section containing
	  datacrunch_api_key = your_client_secret_here

	  You can create this file with:
	  python3 scripts/datacrunch_credentials.py set <your_api_key>

endif # TERRAFORM_DATACRUNCH
```

## terraform/datacrunch/kconfigs/Kconfig.compute
```kconfig
# DataCrunch compute configuration

# Include dynamically generated instance types
source "terraform/datacrunch/kconfigs/Kconfig.compute.generated"

# This string config is defined in the generated file with proper defaults
# based on the chosen instance type option
```
