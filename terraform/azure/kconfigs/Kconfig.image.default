## terraform/datacrunch/kconfigs/Kconfig.location.generated
```kconfig
# DataCrunch locations (dynamically generated)

choice
	prompt "DataCrunch datacenter location"
	default TERRAFORM_DATACRUNCH_LOCATION_AUTO
	help
	  Select the datacenter location for your deployment.
	  These options are dynamically generated from the DataCrunch API.

config TERRAFORM_DATACRUNCH_LOCATION_AUTO
	bool "AUTO - Pick first available location"
	help
	  Automatically select the first datacenter location where the
	  configured instance type is available. This is determined
	  dynamically at provisioning time by querying the DataCrunch API.

config TERRAFORM_DATACRUNCH_LOCATION_FIN_01
	bool "FIN-01 - Finland 1, "
	help
	  DataCrunch datacenter in Finland 1, .

config TERRAFORM_DATACRUNCH_LOCATION_FIN_02
	bool "FIN-02 - Finland 2, "
	help
	  DataCrunch datacenter in Finland 2, .

config TERRAFORM_DATACRUNCH_LOCATION_FIN_03
	bool "FIN-03 - Finland 3, "
	help
	  DataCrunch datacenter in Finland 3, .

config TERRAFORM_DATACRUNCH_LOCATION_ICE_01
	bool "ICE-01 - Iceland 1, "
	help
	  DataCrunch datacenter in Iceland 1, .

endchoice

config TERRAFORM_DATACRUNCH_LOCATION
	string "DataCrunch location code"
	output yaml
	default "AUTO" if TERRAFORM_DATACRUNCH_LOCATION_AUTO
	default "FIN-01" if TERRAFORM_DATACRUNCH_LOCATION_FIN_01
	default "FIN-02" if TERRAFORM_DATACRUNCH_LOCATION_FIN_02
	default "FIN-03" if TERRAFORM_DATACRUNCH_LOCATION_FIN_03
	default "ICE-01" if TERRAFORM_DATACRUNCH_LOCATION_ICE_01
	help
	  The actual location code to use for provisioning.
```

## terraform/gce/Kconfig
```kconfig
if TERRAFORM_GCE

menu "Resource Location"
source "terraform/gce/kconfigs/Kconfig.location.generated"
endmenu
menu "Compute"
comment "Machine selection"
source "terraform/gce/kconfigs/Kconfig.machine.generated"
comment "OS image selection"
source "terraform/gce/kconfigs/Kconfig.image.generated"
endmenu
menu "Storage"
source "terraform/gce/kconfigs/Kconfig.storage"
endmenu
menu "Identity & Access"
source "terraform/gce/kconfigs/Kconfig.identity"
endmenu

endif # TERRAFORM_GCE
```

## terraform/gce/kconfigs/Kconfig.compute
```kconfig
choice
	prompt "GCE Machine Family"
	default TERRAFORM_GCE_MACHINE_FAMILY_N1_STANDARD
	help
	  Select the family of platforms to choose from below.

config TERRAFORM_GCE_MACHINE_FAMILY_N1_STANDARD
	bool "N1 Standard family"
	depends on TARGET_ARCH_X86_64
	help
	  Balanced performance and cost-effectiveness. Intel
	  Haswell CPUs.

config TERRAFORM_GCE_MACHINE_FAMILY_N2_STANDARD
	bool "N2 Standard family"
	depends on TARGET_ARCH_X86_64
	help
	  General purpose computing on Intel Cascade Lake CPUs.

config TERRAFORM_GCE_MACHINE_FAMILY_N2_HIGHCPU
	bool "N2 High CPU family"
	depends on TARGET_ARCH_X86_64
	help
	  General purpose computing on Intel Cascade Lake CPUs.

config TERRAFORM_GCE_MACHINE_FAMILY_N2D_STANDARD
	bool "N2D Standard family"
	depends on TARGET_ARCH_X86_64
	help
	  General purpose computing on AMD Milan CPUs.

config TERRAFORM_GCE_MACHINE_FAMILY_N2D_HIGHCPU
	bool "N2D High CPU family"
	depends on TARGET_ARCH_X86_64
	help
	  General purpose computing on AMD Milan CPUs.

config TERRAFORM_GCE_MACHINE_FAMILY_N4_STANDARD
	bool "N4 Standard family"
	depends on TARGET_ARCH_X86_64
	help
	  General purpose computing on Intel Emerald Rapids CPUs.

config TERRAFORM_GCE_MACHINE_FAMILY_N4_HIGHCPU
	bool "N4 High CPU family"
	depends on TARGET_ARCH_X86_64
	help
	  General purpose computing on Intel Emerald Rapids CPUs.

endchoice

source "terraform/gce/kconfigs/machines/Kconfig.n1-standard"
source "terraform/gce/kconfigs/machines/Kconfig.n2-standard"
source "terraform/gce/kconfigs/machines/Kconfig.n2-highcpu"
source "terraform/gce/kconfigs/machines/Kconfig.n2d-standard"
source "terraform/gce/kconfigs/machines/Kconfig.n2d-highcpu"
source "terraform/gce/kconfigs/machines/Kconfig.n4-standard"
source "terraform/gce/kconfigs/machines/Kconfig.n4-highcpu"

choice
	prompt "OS Distributor"
	default TERRAFORM_GCE_DISTRO_DEBIAN
	help
	  Select the Linux distribution for the OS base image of the
	  instances to be created.

config TERRAFORM_GCE_DISTRO_CENTOS
	bool "CentOS"

config TERRAFORM_GCE_DISTRO_DEBIAN
	bool "Debian"

config TERRAFORM_GCE_DISTRO_FEDORA
	bool "Fedora"

config TERRAFORM_GCE_DISTRO_OL
	bool "Oracle Linux"

config TERRAFORM_GCE_DISTRO_OPENSUSE
	bool "OpenSUSE"

config TERRAFORM_GCE_DISTRO_RHEL
	bool "Red Hat Enterprise Linux"

config TERRAFORM_GCE_DISTRO_ROCKY
	bool "Rocky Linux"

config TERRAFORM_GCE_DISTRO_SLES
	bool "SUSE Enterprise Linux Server"

endchoice

source "terraform/gce/kconfigs/images/Kconfig.centos"
source "terraform/gce/kconfigs/images/Kconfig.debian"
source "terraform/gce/kconfigs/images/Kconfig.fedora"
source "terraform/gce/kconfigs/images/Kconfig.oracle"
source "terraform/gce/kconfigs/images/Kconfig.opensuse"
source "terraform/gce/kconfigs/images/Kconfig.rhel"
source "terraform/gce/kconfigs/images/Kconfig.rocky"
source "terraform/gce/kconfigs/images/Kconfig.sles"
```

## terraform/gce/kconfigs/Kconfig.identity
```kconfig
config TERRAFORM_GCE_PROJECT_NAME
	string "GCE Project name"
	default "kdevops"
	help
	  This option will set the GCE project name. This name must match
	  the actual name of the project you have created using the
	  GCE interface.

config TERRAFORM_GCE_JSON_CREDENTIALS_PATH
	string "GCE json credential file path"
	default "account.json"
	help
	  Path to the GCE json credentials file. Refer to the following links
	  for documentation about this:

	    o https://www.terraform.io/docs/providers/google/getting_started.html
	    o https://www.terraform.io/docs/providers/google/index.html
	    o https://cloud.google.com/community/tutorials/getting-started-on-gcp-with-terraform
	    o https://cloud.google.com/iam/docs/creating-managing-service-account-keys
	    o https://cloud.google.com/iam/docs/granting-roles-to-service-accounts#granting_access_to_a_service_account_for_a_resource
```

## terraform/gce/kconfigs/Kconfig.image
```kconfig
choice
	prompt "OS Distributor"
	default TERRAFORM_GCE_DISTRO_DEBIAN
	help
	  Select the Linux distribution for the OS base image of the
	  instances to be created.

config TERRAFORM_GCE_DISTRO_CENTOS
	bool "CentOS"

config TERRAFORM_GCE_DISTRO_DEBIAN
	bool "Debian"

config TERRAFORM_GCE_DISTRO_OL
	bool "Oracle Linux"

config TERRAFORM_GCE_DISTRO_OPENSUSE
	bool "OpenSUSE"

config TERRAFORM_GCE_DISTRO_RHEL
	bool "Red Hat Enterprise Linux"

config TERRAFORM_GCE_DISTRO_ROCKY
	bool "Rocky Linux"

config TERRAFORM_GCE_DISTRO_SLES
	bool "SUSE Enterprise Linux Server"

endchoice

if TERRAFORM_GCE_DISTRO_CENTOS

config TERRAFORM_GCE_IMAGE_PROJECT
	string
	output yaml
	default "centos-cloud"

config TERRAFORM_GCE_IMAGE_SIZE
	int
	output yaml
	default 20

if TARGET_ARCH_X86_64

choice
	prompt "OS image to use"
	default TERRAFORM_GCE_IMAGE_CENTOS_STREAM_9_X86_64

config TERRAFORM_GCE_IMAGE_CENTOS_STREAM_9_X86_64
	bool "CentOS Stream 9 (x86)"

endchoice

config TERRAFORM_GCE_IMAGE_FAMILY
	string
	output yaml
	default "centos-stream-9" if TERRAFORM_GCE_IMAGE_CENTOS_STREAM_9_X86_64

endif # TARGET_ARCH_X86_64

if TARGET_ARCH_ARM64

choice
	prompt "OS image to use"
	default TERRAFORM_GCE_IMAGE_CENTOS_STREAM_9_ARM64

config TERRAFORM_GCE_IMAGE_CENTOS_STREAM_9_ARM64
	bool "CentOS Stream 9 (arm64)"

endchoice

config TERRAFORM_GCE_IMAGE_FAMILY
	string
	output yaml
	default "centos-stream-9-arm64" if TERRAFORM_GCE_IMAGE_CENTOS_STREAM_9_ARM64

endif # TARGET_ARCH_ARM64

endif # TERRAFORM_GCE_DISTRO_CENTOS

if TERRAFORM_GCE_DISTRO_DEBIAN

config TERRAFORM_GCE_IMAGE_PROJECT
	string
	output yaml
	default "debian-cloud"

config TERRAFORM_GCE_IMAGE_SIZE
	int
	output yaml
	default 10

if TARGET_ARCH_X86_64

choice
	prompt "OS image to use"
	default TERRAFORM_GCE_IMAGE_DEBIAN_11_X86_64

config TERRAFORM_GCE_IMAGE_DEBIAN_11_X86_64
	bool "Debian-11 Bullseye (x86)"

config TERRAFORM_GCE_IMAGE_DEBIAN_12_X86_64
	bool "Debian-12 Bookworm (x86)"

endchoice

config TERRAFORM_GCE_IMAGE_FAMILY
	string
	output yaml
	default "debian-11" if TERRAFORM_GCE_IMAGE_DEBIAN_11_X86_64
	default "debian-12" if TERRAFORM_GCE_IMAGE_DEBIAN_12_X86_64

endif # TARGET_ARCH_X86_64

if TARGET_ARCH_ARM64

choice
	prompt "OS image to use"
	default TERRAFORM_GCE_IMAGE_DEBIAN_12_ARM64

config TERRAFORM_GCE_IMAGE_DEBIAN_12_ARM64
	bool "Debian-12 Bookworm (arm64)"

endchoice

config TERRAFORM_GCE_IMAGE_FAMILY
	string
	output yaml
	default "debian-12-arm64" if TERRAFORM_GCE_IMAGE_DEBIAN_12_ARM64

endif # TARGET_ARCH_ARM64

endif # TERRAFORM_GCE_DISTRO_DEBIAN

if TERRAFORM_GCE_DISTRO_OPENSUSE

config TERRAFORM_GCE_IMAGE_PROJECT
	string
	output yaml
	default "opensuse-cloud"

config TERRAFORM_GCE_IMAGE_SIZE
	int
	output yaml
	default 10

if TARGET_ARCH_X86_64

choice
	prompt "OS image to use"
	default TERRAFORM_GCE_IMAGE_OPENLEAP_15_5_X86_64

config TERRAFORM_GCE_IMAGE_OPENLEAP_15_5_X86_64
	bool "OpenLeap 15.5 (x86)"

config TERRAFORM_GCE_IMAGE_OPENLEAP_15_6_X86_64
	bool "OpenLeap 15.6 (x86)"

endchoice

config TERRAFORM_GCE_IMAGE_FAMILY
	string
	output yaml
	default "opensuse-leap-15-5" if TERRAFORM_GCE_IMAGE_OPENLEAP_15_5_X86_64
	default "opensuse-leap-15-6" if TERRAFORM_GCE_IMAGE_OPENLEAP_15_6_X86_64

endif # TARGET_ARCH_X86_64

endif # TERRAFORM_GCE_DISTRO_OPENSUSE

if TERRAFORM_GCE_DISTRO_OL

config TERRAFORM_GCE_IMAGE_PROJECT
	string
	output yaml
	default "oracle-linux-cloud"

config TERRAFORM_GCE_IMAGE_SIZE
	int
	output yaml
	default 20

if TARGET_ARCH_X86_64

choice
	prompt "OS image to use"

config TERRAFORM_GCE_IMAGE_OL_8_X86_64
	bool "Oracle Linux 8 (x86)"

config TERRAFORM_GCE_IMAGE_OL_9_X86_64
	bool "Oracle Linux 9 (x86)"

endchoice

config TERRAFORM_GCE_IMAGE_FAMILY
	string
	output yaml
	default "oracle-linux-8" if TERRAFORM_GCE_IMAGE_OL_8_X86_64
	default "oracle-linux-9" if TERRAFORM_GCE_IMAGE_OL_9_X86_64

endif # TARGET_ARCH_X86_64

endif # TERRAFORM_GCE_DISTRO_OL

if TERRAFORM_GCE_DISTRO_RHEL

config TERRAFORM_GCE_IMAGE_PROJECT
	string
	output yaml
	default "rhel-cloud"

config TERRAFORM_GCE_IMAGE_SIZE
	int
	output yaml
	default 20

choice
	prompt "License type"
	default TERRAFORM_GCE_LICENSE_TYPE_PAYGO_RHEL

config TERRAFORM_GCE_LICENSE_TYPE_PAYGO_RHEL
	bool "Pay as you go"

config TERRAFORM_GCE_LICENSE_TYPE_BYOS_RHEL
	bool "Bring your own subscription or license"

endchoice

if TARGET_ARCH_X86_64

choice
	prompt "OS image to use"

config TERRAFORM_GCE_IMAGE_RHEL_8_X86_64_PAYGO
	depends on TERRAFORM_GCE_LICENSE_TYPE_PAYGO_RHEL
	bool "Red Hat Enterprise Linux 8 (x86)"

config TERRAFORM_GCE_IMAGE_RHEL_9_X86_64_PAYGO
	depends on TERRAFORM_GCE_LICENSE_TYPE_PAYGO_RHEL
	bool "Red Hat Enterprise Linux 9 (x86)"

endchoice

config TERRAFORM_GCE_IMAGE_FAMILY
	string
	output yaml
	default "rhel-8" if TERRAFORM_GCE_IMAGE_RHEL_8_X86_64_PAYGO
	default "rhel-9" if TERRAFORM_GCE_IMAGE_RHEL_9_X86_64_PAYGO

endif # TARGET_ARCH_X86_64

if TARGET_ARCH_ARM64

choice
	prompt "OS image to use"

config TERRAFORM_GCE_IMAGE_RHEL_9_ARM64_PAYGO
	depends on TERRAFORM_GCE_LICENSE_TYPE_PAYGO_RHEL
	bool "Red Hat Enterprise Linux 9 (arm64)"

endchoice

config TERRAFORM_GCE_IMAGE_FAMILY
	string
	output yaml
	default "rhel-9-arm64" if TERRAFORM_GCE_IMAGE_RHEL_9_ARM64_PAYGO

endif # TARGET_ARCH_ARM64

endif # TERRAFORM_GCE_DISTRO_RHEL

if TERRAFORM_GCE_DISTRO_ROCKY

config TERRAFORM_GCE_IMAGE_PROJECT
	string
	output yaml
	default "rocky-linux-cloud"

config TERRAFORM_GCE_IMAGE_SIZE
	int
	output yaml
	default 20

if TARGET_ARCH_X86_64

choice
	prompt "OS image to use"
	default TERRAFORM_GCE_IMAGE_ROCKY_8_X86_64

config TERRAFORM_GCE_IMAGE_ROCKY_8_X86_64
	bool "Rocky Linux 8 (x86)"

config TERRAFORM_GCE_IMAGE_ROCKY_9_X86_64
	bool "Rocky Linux 9 (x86)"

endchoice

config TERRAFORM_GCE_IMAGE_FAMILY
	string
	output yaml
	default "rocky-linux-8" if TERRAFORM_GCE_IMAGE_ROCKY_8_X86_64
	default "rocky-linux-9" if TERRAFORM_GCE_IMAGE_ROCKY_9_X86_64

endif # TARGET_ARCH_X86_64

if TARGET_ARCH_ARM64

choice
	prompt "OS image to use"
	default TERRAFORM_GCE_IMAGE_ROCKY_9_ARM64

config TERRAFORM_GCE_IMAGE_ROCKY_9_ARM64
	bool "Rocky Linux 9 (arm64)"

endchoice

config TERRAFORM_GCE_IMAGE_FAMILY
	string
	output yaml
	default "rocky-linux-9-arm64" if TERRAFORM_GCE_IMAGE_ROCKY_9_ARM64

endif # TARGET_ARCH_ARM64

endif # TERRAFORM_GCE_DISTRO_ROCKY

if TERRAFORM_GCE_DISTRO_SLES

config TERRAFORM_GCE_IMAGE_PROJECT
	string
	output yaml
	default "suse-cloud"

config TERRAFORM_GCE_IMAGE_SIZE
	int
	output yaml
	default 10

if TARGET_ARCH_X86_64

choice
	prompt "OS image to use"

config TERRAFORM_GCE_IMAGE_SLES_12_X86_64
	bool "SUSE Linux Enterprise Server 12 (x86)"

config TERRAFORM_GCE_IMAGE_SLES_15_X86_64
	bool "SUSE Linux Enterprise Server 15 (x86)"

endchoice

config TERRAFORM_GCE_IMAGE_FAMILY
	string
	output yaml
	default "sles-12" if TERRAFORM_GCE_IMAGE_SLES_12_X86_64
	default "sles-15" if TERRAFORM_GCE_IMAGE_SLES_15_X86_64

endif # TARGET_ARCH_X86_64

if TARGET_ARCH_ARM64

choice
	prompt "OS image to use"

config TERRAFORM_GCE_IMAGE_SLES_15_ARM64
	bool "SUSE Linux Enterprise Server 15 (arm64)"

endchoice

config TERRAFORM_GCE_IMAGE_FAMILY
	string
	output yaml
	default "sles-15-arm64" if TERRAFORM_GCE_IMAGE_SLES_15_ARM64

endif # TARGET_ARCH_ARM64

endif # TERRAFORM_GCE_DISTRO_SLES
```
