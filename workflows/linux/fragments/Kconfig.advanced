## workflows/linux/fragments/Kconfig.advanced
```kconfig
menu "Advanced features"

config BOOTLINUX_FRAGMENT_EBPF
	bool "eBPF support (kdevops: ebpf.config)"
	output yaml
	help
	  Enable extended Berkeley Packet Filter support.

config BOOTLINUX_FRAGMENT_EBPF_ERRORINJ
	bool "eBPF error injection (kdevops: ebpf-errorinj.config)"
	output yaml
	help
	  Enable eBPF-based error injection capabilities for testing.

config BOOTLINUX_FRAGMENT_XARRAY
	bool "XArray data structure support (kdevops: xarray.config)"
	output yaml
	help
	  Enable XArray data structure support in the kernel.

config BOOTLINUX_FRAGMENT_XARRAY_NO_MULTI
	bool "XArray without multi-index (kdevops: xarray_no_multi.config)"
	output yaml
	help
	  Enable XArray support but disable multi-index functionality.

endmenu
```

## workflows/linux/fragments/Kconfig.arch
```kconfig
menu "Architecture-specific configuration"

choice
	prompt "ARM64 page size configuration"
	depends on TARGET_ARCH_ARM64
	default BOOTLINUX_FRAGMENT_ARM64_4K_PAGES
	help
	  Choose the page size configuration for ARM64.

config BOOTLINUX_FRAGMENT_ARM64_4K_PAGES
	bool "4KB pages (kdevops: arm64_4k_pages.config)"
	output yaml
	help
	  Use 4KB page size (default for most systems).

config BOOTLINUX_FRAGMENT_ARM64_16K_PAGES
	bool "16KB pages (kdevops: arm64_16k_pages.config)"
	output yaml
	help
	  Use 16KB page size for better performance in some workloads.

config BOOTLINUX_FRAGMENT_ARM64_64K_PAGES
	bool "64KB pages (kdevops: arm64_64k_pages.config)"
	output yaml
	help
	  Use 64KB page size for high-performance computing workloads.

endchoice

endmenu
```

## workflows/linux/fragments/Kconfig.container
```kconfig
menu "Container and virtualization"

config BOOTLINUX_FRAGMENT_XEN
	bool "Xen guest support (upstream: xen.config)"
	output yaml
	help
	  Use the upstream xen.config fragment to enable Xen hypervisor support.

config BOOTLINUX_FRAGMENT_MOBY
	bool "Container/Moby support (kdevops: moby.config)"
	output yaml
	help
	  Enable kernel features required for container runtimes like Moby/Docker.

endmenu
```

## workflows/linux/fragments/Kconfig.development
```kconfig
menu "Development and debugging"

config BOOTLINUX_FRAGMENT_DEBUG
	bool "Kernel debugging features (upstream: debug.config)"
	output yaml
	help
	  Use the upstream debug.config fragment to enable various kernel debugging
	  and diagnostic features.

config BOOTLINUX_FRAGMENT_GDB
	bool "Kernel GDB support (kdevops: gdb.config)"
	output yaml
	help
	  Enable kernel debugging via GDB.

config BOOTLINUX_FRAGMENT_VM_DEBUG
	bool "Virtual memory debugging (kdevops: vm_debug.config)"
	output yaml
	help
	  Enable virtual memory debugging features.

config BOOTLINUX_FRAGMENT_BLKTRACE
	bool "Block I/O tracing support (kdevops: blktrace.config)"
	output yaml
	help
	  Enable block layer tracing and debugging capabilities.

endmenu
```

## workflows/linux/fragments/Kconfig.essential
```kconfig
menu "Essential kernel configuration"

config BOOTLINUX_FRAGMENT_64BIT
	bool "64-bit architecture optimizations (kdevops: 64bit.config)"
	default y
	output yaml
	help
	  Enable 64-bit specific optimizations and features.

config BOOTLINUX_FRAGMENT_KVM_GUEST
	bool "KVM guest optimizations (upstream: kvm_guest.config)"
	default y
	output yaml
	help
	  Use the upstream kvm_guest.config fragment to enable optimizations for
	  running the kernel as a KVM guest.

config BOOTLINUX_FRAGMENT_VIRTIO_FS
	bool "VirtIO filesystem support (kdevops: virtio-fs.config)"
	default y
	output yaml
	help
	  Enable VirtIO filesystem support for virtualized environments.

config BOOTLINUX_FRAGMENT_SYSTEMD
	bool "systemd support (kdevops: systemd.config)"
	default y
	output yaml
	help
	  Enable kernel features required by systemd init system.

config BOOTLINUX_FRAGMENT_DISTRO
	bool "Distribution kernel features (kdevops: distro.config)"
	default y
	output yaml
	help
	  Enable features commonly needed by Linux distributions.

config BOOTLINUX_FRAGMENT_STORAGE
	bool "Storage and filesystem features (kdevops: storage.config)"
	default y
	output yaml
	help
	  Enable advanced storage and filesystem features.

config BOOTLINUX_FRAGMENT_INITRAMFS
	bool "Initial RAM disk support (kdevops: initramfs.config)"
	default y
	output yaml
	help
	  Enable initramfs (initial RAM disk) support with compression
	  algorithms. This is essential for most Linux distributions
	  and is needed for generating initrd images during kernel
	  installation.

config BOOTLINUX_FRAGMENT_LOCALAUTO
	bool "Local version auto generation (kdevops: localauto.config)"
	default y
	output yaml
	help
	  Automatically generate local version strings with git information.

endmenu
```

## workflows/linux/fragments/Kconfig.legacy
```kconfig
menu "Legacy and compatibility"

config BOOTLINUX_FRAGMENT_BUFFER_HEAD
	bool "Buffer head support (kdevops: buffer_head.config)"
	output yaml
	help
	  Enable buffer head infrastructure for filesystem operations.

endmenu
```

## workflows/linux/fragments/Kconfig.memory
```kconfig
menu "Memory management"

config BOOTLINUX_FRAGMENT_NUMA
	bool "NUMA support (kdevops: numa.config)"
	output yaml
	help
	  Enable Non-Uniform Memory Access support.

config BOOTLINUX_FRAGMENT_KSM
	bool "Kernel Samepage Merging (kdevops: ksm.config)"
	output yaml
	help
	  Enable KSM for memory deduplication in virtualized environments.

endmenu
```

## workflows/linux/fragments/Kconfig.modules
```kconfig
menu "Module and extensibility"

config BOOTLINUX_FRAGMENT_MODULES
	bool "Enhanced module support (kdevops: modules.config)"
	output yaml
	help
	  Enable advanced kernel module features.

config BOOTLINUX_FRAGMENT_MODULES_BLK
	bool "Block layer module support (kdevops: modules-blk.config)"
	depends on BOOTLINUX_FRAGMENT_MODULES
	output yaml
	help
	  Enhanced block layer module support and debugging.

config BOOTLINUX_FRAGMENT_MODULES_MODVERSIONS
	bool "Standard module versioning (kdevops: modules-modversions.config)"
	depends on BOOTLINUX_FRAGMENT_MODULES
	output yaml
	help
	  Enable standard module versioning support for module compatibility checking.

config BOOTLINUX_FRAGMENT_MODULES_EXTENDED_MODVERSIONS
	bool "Extended module versioning (kdevops: modules-extended-modversions.config)"
	depends on BOOTLINUX_FRAGMENT_MODULES
	output yaml
	help
	  Enable extended module versioning support for long symbol names.
	  Required for Rust support and advanced module versioning.

config BOOTLINUX_FRAGMENT_MODULES_TESTING
	bool "Module testing support (kdevops: modules-testing.config)"
	depends on BOOTLINUX_FRAGMENT_MODULES
	output yaml
	help
	  Enable kernel module testing features including kallsyms and kmod tests.

config BOOTLINUX_FRAGMENT_KMEMLEAK
	bool "Kernel memory leak detection (kdevops: kmemleak.config)"
	depends on BOOTLINUX_FRAGMENT_MODULES
	output yaml
	help
	  Enable kernel memory leak detection and sample module for debugging
	  memory leaks in kernel code.

endmenu
```

## workflows/linux/fragments/Kconfig.security
```kconfig
menu "Security and hardening"

config BOOTLINUX_FRAGMENT_HARDENING
	bool "Security hardening options (upstream: hardening.config)"
	output yaml
	help
	  Use the upstream hardening.config fragment to enable kernel security
	  hardening features.

endmenu
```

## workflows/linux/fragments/Kconfig.specialized
```kconfig
menu "Specialized kernel variants"

config BOOTLINUX_FRAGMENT_TINY
	bool "Tiny kernel configuration (upstream: tiny.config)"
	output yaml
	help
	  Use the upstream tiny.config fragment from the kernel sources.
	  This enables CONFIG_EMBEDDED and other options for minimal kernels.

config BOOTLINUX_FRAGMENT_NOPM
	bool "Disable power management (upstream: nopm.config)"
	output yaml
	help
	  Use the upstream nopm.config fragment to disable power management features.

config BOOTLINUX_FRAGMENT_RUST
	bool "Rust language support (upstream: rust.config)"
	output yaml
	help
	  Use the upstream rust.config fragment to enable Rust programming language
	  support in the kernel.

endmenu
```

## workflows/ltp/Kconfig
```kconfig
if KDEVOPS_WORKFLOW_ENABLE_LTP

if WORKFLOWS_DEDICATED_WORKFLOW

menu "Test groups to enable"

config LTP_TESTS_CVE
	bool "CVE group"
	help
	  Run the CVE regression tests.

config LTP_TESTS_FCNTL
	bool "fcntl group"
	help
	  Run the fcntl unit tests.

config LTP_TESTS_FS
	bool "FS group"
	help
	  Run the file system-related unit tests.

config LTP_TESTS_FS_BIND
	bool "Bind mount group"
	help
	  Run the file system bind mount unit tests.

config LTP_TESTS_FS_PERMS_SIMPLE
	bool "FS simple permission group"
	help
	  Run the file system permission unit tests.

config LTP_TESTS_FS_READONLY
	bool "FS read-only group"
	help
	  Run the file system read-only unit tests.

config LTP_TESTS_NFS
	bool "NFS group"
	help
	  Run the NFS, NFS locking, and RPC unit tests.

config LTP_TESTS_NOTIFY
	bool "inotify and fanotify group"
	help
	  Run the inotify and fanotify unit tests.

config LTP_TESTS_RPC
	bool "Traditional SunRPC group"
	help
	  Run SunRPC library unit tests.

config LTP_TESTS_SMACK
	bool "SMACK tests"
	help
	  Run the SMACK unit group.

config LTP_TESTS_TIRPC
	bool "Transport-Independent SunRPC group"
	help
	  Run the TI-RPC library unit tests.

endmenu

endif # WORKFLOWS_DEDICATED_WORKFLOW

config HAVE_MIRROR_LTP
	bool
	depends on USE_LIBVIRT_MIRROR
	default $(shell, scripts/check_mirror_present.sh /mirror/ltp.git)

config LTP_REPO_CUSTOM
	bool "Clone a custom version of the ltp source code"
	default n
	help
	  Choose Y to enter a custom URL to clone from. Choose N to clone
	  from the master ltp source code on github.com or a local mirror
	  (chosen automatically).

config LTP_REPO_URL
	string "The URL of the custom ltp source code repository to clone"
	depends on LTP_REPO_CUSTOM
	help
	  Enter the URL of the ltp source code repository to clone.

config LTP_REPO
	string
	default DEFAULT_LTP_URL if !LTP_REPO_CUSTOM && !HAVE_MIRROR_LTP
	default LTP_REPO_URL if LTP_REPO_CUSTOM
	default $(shell, scripts/append-makefile-vars.sh git:// $(KDEVOPS_DEFAULT_BRIDGE_IP_GUESTFS) /mirror/ltp.git) if HAVE_MIRROR_LTP && GUESTFS

config LTP_REPO_COMMIT
	string "The version of ltp to check out"
	default "20240129"
	help
	  The reference (tag, commit hash, or branch) to be checked out
	  and used for the test.

endif # KDEVOPS_WORKFLOW_ENABLE_LTP
```

## workflows/minio/Kconfig
```kconfig
if KDEVOPS_WORKFLOW_ENABLE_MINIO

menu "MinIO S3 Storage Testing"

config KDEVOPS_WORKFLOW_ENABLE_MINIO_WARP
	bool "Enable MinIO Warp benchmarking"
	default y
	help
	Enable MinIO Warp for S3 storage benchmarking. Warp provides
	comprehensive S3 API performance testing with multiple benchmark
	types including GET, PUT, DELETE, LIST, and MULTIPART operations.

if KDEVOPS_WORKFLOW_ENABLE_MINIO_WARP

source "workflows/minio/Kconfig.docker"
source "workflows/minio/Kconfig.storage"
source "workflows/minio/Kconfig.warp"

endif # KDEVOPS_WORKFLOW_ENABLE_MINIO_WARP

endmenu

endif # KDEVOPS_WORKFLOW_ENABLE_MINIO
```

## workflows/minio/Kconfig.docker
```kconfig
config MINIO_CONTAINER_IMAGE_STRING
	string "MinIO container image"
	output yaml
	default "minio/minio:RELEASE.2024-01-16T16-07-38Z"
	help
	The MinIO container image to use for S3 storage benchmarking.
	Using a recent stable release with performance improvements.

	When KDEVOPS_DOCKER_MIRROR is enabled, Docker's native registry-mirrors
	configuration automatically uses the local cache transparently without
	requiring image URL rewriting.

config MINIO_CONTAINER_NAME
	string "The local MinIO container name"
	default "minio-warp-server"
	output yaml
	help
	Set the name for the MinIO Docker container.

config MINIO_ACCESS_KEY
	string "MinIO access key"
	output yaml
	default "minioadmin"
	help
	Access key for MinIO S3 API access.

config MINIO_SECRET_KEY
	string "MinIO secret key"
	output yaml
	default "minioadmin"
	help
	Secret key for MinIO S3 API access.

config MINIO_DATA_PATH
	string "Host path for MinIO data storage"
	output yaml
	default "/data/minio"
	help
	Directory on the host where MinIO data will be persisted.
	If using dedicated storage, this will be the mount point.
	Otherwise, uses the existing filesystem at this path.

config MINIO_DOCKER_NETWORK_NAME
	string "Docker network name"
	output yaml
	default "minio-warp-network"
	help
	Name of the Docker network to create for MinIO containers.

config MINIO_API_PORT
	int "MinIO API port"
	output yaml
	default "9000"
	help
	Port for MinIO S3 API access.

config MINIO_CONSOLE_PORT
	int "MinIO console port"
	output yaml
	default "9001"
	help
	Port for MinIO web console access.

config MINIO_MEMORY_LIMIT
	string "MinIO container memory limit"
	output yaml
	default "4g"
	help
	Memory limit for the MinIO container. Adjust based on
	your system resources and workload requirements.
```
