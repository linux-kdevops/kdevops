## workflows/mmtests/Kconfig
```kconfig
if KDEVOPS_WORKFLOW_ENABLE_MMTESTS

config HAVE_MIRROR_MMTESTS
	bool
	depends on USE_LIBVIRT_MIRROR
	default $(shell, scripts/check_mirror_present.sh /mirror/mmtests.git)

config MMTESTS_GIT_URL
	string "The mmtests git tree to clone"
	output yaml
	default $(shell, scripts/append-makefile-vars.sh git:// $(KDEVOPS_DEFAULT_BRIDGE_IP_GUESTFS) /mirror/mmtests.git) if HAVE_MIRROR_MMTESTS && GUESTFS
	default DEFAULT_MMTESTS_GITHUB_HTTPS_URL if !HAVE_MIRROR_MMTESTS
	help
	  The mmtests git tree to clone.

config MMTESTS_TEST_TYPE
	string
	output yaml
	default "thpcompact" if MMTESTS_ENABLE_THPCOMPACT
	default "thpchallenge" if MMTESTS_ENABLE_THPCHALLENGE

choice
	prompt "mmtests test type"
	default MMTESTS_ENABLE_THPCOMPACT
	help
	  Select the type of mmtests test to run.

config MMTESTS_ENABLE_THPCOMPACT
	bool "thpcompact"
	help
	  Run thpcompact test to stress THP allocations through multi-stage
	  memory allocation and migration. This test is designed to exercise
	  memory compaction and huge page allocation under various thread
	  counts while staying within system memory limits.

config MMTESTS_ENABLE_THPCHALLENGE
	bool "thpchallenge"
	help
	  Run thpchallenge fio test which uses fio for background I/O
	  workload while testing THP allocation performance.

endchoice

config MMTESTS_ITERATIONS
	int "Number of iterations per test"
	default 5
	range 1 100
	output yaml
	help
	  The number of iterations to run for each mmtests configuration.

config MMTESTS_MONITOR_INTERVAL
	int "Monitor update interval in seconds"
	default 1
	range 1 60
	output yaml
	help
	  The interval in seconds between monitoring updates during
	  mmtests execution.

config MMTESTS_MONITOR_ENABLE_FTRACE
	bool "Enable ftrace monitoring"
	default y
	output yaml
	help
	  Enable ftrace events for compaction and kernel memory monitoring
	  during mmtests execution.

config MMTESTS_MONITOR_ENABLE_PROC_MONITORING
	bool "Enable /proc monitoring"
	default y
	output yaml
	help
	  Enable monitoring of /proc/vmstat, /proc/buddyinfo, and
	  /proc/pagetypeinfo during mmtests execution.

config MMTESTS_MONITOR_ENABLE_MPSTAT
	bool "Enable mpstat monitoring"
	default y
	output yaml
	help
	  Enable mpstat monitoring during mmtests execution.

config MMTESTS_PRETEST_DROPVMCACHES
	bool "Trigger to drop vm cache before the test"
	output yaml
	help
	  Manually trigger to drop the vm cache before the test.

config MMTESTS_PRETEST_COMPACTION
	bool "Trigger memory compaction before the test"
	output yaml
	help
	  Manually trigger memory comapction before run.

config MMTESTS_PRETEST_THP_SETTING
	string "THP setting"
	default "always"
	output yaml
	help
	  Transparent huge page setting for all nodes.
	  Options: always, madvise, never

source "workflows/mmtests/Kconfig.thpcompact"
source "workflows/mmtests/Kconfig.thpchallenge"
source "workflows/mmtests/Kconfig.fs"

endif # KDEVOPS_WORKFLOW_ENABLE_MMTESTS
```

## workflows/mmtests/Kconfig.ext4
```kconfig
if MMTESTS_FS_EXT4

choice
	prompt "ext4 filesystem configuration to use"

config MMTESTS_FS_EXT4_4K_4KS
	bool "ext4 4k -  4k sector size"
	select MMTESTS_EXT4_SECTOR_SIZE_4K
	output yaml
	help
	  ext4 4k FSB with 4k sector size.

config MMTESTS_FS_EXT4_4K_4KS_BIGALLOC_16K
	bool "ext4 4k block size bigalloc 16k cluster sizes -  4k sector size"
	select MMTESTS_EXT4_SECTOR_SIZE_4K
	select MMTESTS_EXT4_SECTION_4K_BIGALLOC_16K
	output yaml
	help
	  ext4 4 KiB FSB with 4 KiB sector size, 16 KiB cluster sizes.

config MMTESTS_FS_EXT4_4K_4KS_BIGALLOC_32K
	bool "ext4 4k block size bigalloc 32k cluster sizes -  4k sector size"
	select MMTESTS_EXT4_SECTOR_SIZE_4K
	select MMTESTS_EXT4_SECTION_4K_BIGALLOC_32K
	output yaml
	help
	  ext4 4 KiB FSB with 4 KiB sector size, 32 KiB cluster sizes.

config MMTESTS_FS_EXT4_4K_4KS_BIGALLOC_64K
	bool "ext4 4k block size bigalloc 64k cluster sizes -  4k sector size"
	select MMTESTS_EXT4_SECTOR_SIZE_4K
	select MMTESTS_EXT4_SECTION_4K_BIGALLOC_64K
	output yaml
	help
	  ext4 4 KiB FSB with 4 KiB sector size, 64 KiB cluster sizes.

endchoice

choice
    prompt "EXT4 filesystem sector size to use"
    default MMTESTS_EXT4_SECTOR_SIZE_4K

config MMTESTS_EXT4_SECTOR_SIZE_512
	bool "512 bytes"
	output yaml
	depends on EXTRA_STORAGE_SUPPORTS_512
	help
	  Use 512 byte sector size.

config MMTESTS_EXT4_SECTOR_SIZE_4K
	bool "4 KiB"
	output yaml
	depends on EXTRA_STORAGE_SUPPORTS_4K
	help
	  Use 4 KiB sector size.

endchoice

config MMTESTS_EXT4_SECTOR_SIZE
	string
	output yaml
	default "512" if MMTESTS_EXT4_SECTOR_SIZE_512
	default "4k"  if MMTESTS_EXT4_SECTOR_SIZE_4K

config MMTESTS_EXT4_SECTION_4K
	bool

config MMTESTS_EXT4_SECTION_4K_CMD
	string
	depends on MMTESTS_EXT4_SECTION_4K
	default "-F -b 4k"

config MMTESTS_EXT4_SECTION_4K_BIGALLOC_16K
	bool

config MMTESTS_EXT4_SECTION_4K_BIGALLOC_16K_CMD
	string
	depends on MMTESTS_EXT4_SECTION_4K_BIGALLOC_16K
	default "-F -b 4k -O bigalloc -C 16k"

config MMTESTS_EXT4_SECTION_4K_BIGALLOC_32K
	bool

config MMTESTS_EXT4_SECTION_4K_BIGALLOC_32K_CMD
	string
	depends on MMTESTS_EXT4_SECTION_4K_BIGALLOC_32K
	default "-F -b 4k -O bigalloc -C 32k"

config MMTESTS_EXT4_SECTION_4K_BIGALLOC_64K
	bool

config MMTESTS_EXT4_SECTION_4K_BIGALLOC_64K_CMD
	string
	depends on MMTESTS_EXT4_SECTION_4K_BIGALLOC_64K
	default "-F -b 4k -O bigalloc -C 64k"

config MMTESTS_EXT4_CMD
	string
	output yaml
	default MMTESTS_EXT4_SECTION_4K_CMD if MMTESTS_FS_EXT4_4K_4KS
	default MMTESTS_EXT4_SECTION_4K_BIGALLOC_16K_CMD if MMTESTS_FS_EXT4_4K_4KS_BIGALLOC_16K
	default MMTESTS_EXT4_SECTION_4K_BIGALLOC_32K_CMD if MMTESTS_FS_EXT4_4K_4KS_BIGALLOC_32K
	default MMTESTS_EXT4_SECTION_4K_BIGALLOC_64K_CMD if MMTESTS_FS_EXT4_4K_4KS_BIGALLOC_64K

endif # MMTESTS_FS_EXT4
```

## workflows/mmtests/Kconfig.thpchallenge
```kconfig
if MMTESTS_ENABLE_THPCHALLENGE

config MMTESTS_THPCHALLENGE_BACKGROUND
	string "Background workload for THP challenge"
	output yaml
	default "fio-random-reader-inefficient"
	help
	  Name of the background workload to use during the THP challenge.
	  This workload is typically one that causes memory fragmentation.

config MMTESTS_THPCHALLENGE_FIO_THREADS
	int "Number of FIO threads for THP challenge background workload"
	output yaml
	default 4
	help
	  The number of FIO threads used for the background memory
	  fragmentation workload during the THP challenge benchmark.

config MMTESTS_THPCHALLENGE_MIN_THREADS
	int "Minimum number of threads for THP workload"
	output yaml
	default 1
	help
	  Minimum number of threads used in the THP challenge benchmark.
	  This is typically computed as a function of NUMCPUS and NUMNODES.
	  If unsure, leave at default and let the runtime environment compute it.

config MMTESTS_THPCHALLENGE_MAX_THREADS
	int "Maximum number of threads for THP workload"
	output yaml
	default 1
	help
	  Maximum number of threads used in the THP challenge benchmark.
	  Should be equal to or greater than MIN_THREADS.

config MMTESTS_THPCHALLENGE_THP_WSETSIZE
	int "Working set size for THP workload - percertage"
	output yaml
	range 1 100
	help
	  Working set size for the main THP challenge workload.
	  Typically 80% of total system memory.

config MMTESTS_THPCHALLENGE_FIO_WSETSIZE
	int "Working set size for FIO workload - percentage"
	output yaml
	range 1 200
	help
	  Working set size for the background FIO workload in the THP challenge.
	  Typically 150% of total system memory.

endif # MMTESTS_ENABLE_THPCHALLENGE
```

## workflows/mmtests/Kconfig.thpcompact
```kconfig
if MMTESTS_ENABLE_THPCOMPACT

config MMTESTS_THPCOMPACT_THREADS_MIN
	int "Minimum number of threads to use for mmtests"
	default 1
	range 1 128
	output yaml
	help
	  The minimum number of threads to use for mmtests runs.

choice
	prompt "mmtests max thread count strategy"
	default MMTESTS_THPCOMPACT_THREADS_MAX_TYPE_AUTO
	help
	  Select the strategy to set the maximum number of threads we'll use.

config MMTESTS_THPCOMPACT_THREADS_MAX_TYPE_AUTO
	bool "auto"
	output yaml
	help
	  We use a heuristic to use 4 times the number of threads the system has
	  so 4 * $(nproc).

config MMTESTS_THPCOMPACT_THREADS_MAX_TYPE_MANUAL
	bool "manual"
	output yaml
	help
	  Lets you select the max number of threads mmtests will use.

endchoice

if MMTESTS_THPCOMPACT_THREADS_MAX_TYPE_MANUAL

config MMTESTS_THPCOMPACT_THREADS_MAX
	int "Maximum number of threads to use for mmtests"
	default 32
	range 1 128
	output yaml
	help
	  The maximum number of threads to use for mmtests runs.

endif

config MMTESTS_THPCOMPACT_ANONYMOUS_MEMORY_PERCENT
	int "Percentage of system memory to use for anonymous memory"
	default 80
	range 10 95
	output yaml
	help
	  The percentage of total system memory to use for anonymous
	  memory allocation during tests.

config MMTESTS_THPCOMPACT_FILEMAP_MEMORY_SCALE
	int "How much to scale file memory used"
	default 4
	output yaml
	help
	  The amount of scaling of memory in comparison to anonymous memory to
	  use for file mappings. Is set set to 4 then we'll use the 1/4th the
	  amount of set for MMTESTS_ANONYMOUS_MEMORY_PERCENT.

endif # MMTESTS_ENABLE_THPCOMPACT
```

## workflows/mmtests/Kconfig.xfs
```kconfig
if MMTESTS_FS_XFS

choice
	prompt "XFS filesystem configuration to use"
	default MMTESTS_FS_XFS_4K_4KS

config MMTESTS_FS_XFS_4K_4KS
	bool "XFS 4k LBS - 4k sector size"
	select MMTESTS_XFS_SECTOR_SIZE_4K
	select MMTESTS_XFS_SECTION_REFLINK_4K
	output yaml
	help
	  XFS with 4k FSB with 4k sector size.

config MMTESTS_FS_XFS_8K_4KS
	bool "XFS 8k LBS - 4k sector size"
	select MMTESTS_XFS_SECTOR_SIZE_4K
	select MMTESTS_XFS_SECTION_REFLINK_16K
	output yaml
	help
	  XFS with 8k FSB with 4k sector size.

config MMTESTS_FS_XFS_16K_4KS
	bool "XFS 16k LBS - 4k sector size"
	select MMTESTS_XFS_SECTOR_SIZE_4K
	select MMTESTS_XFS_SECTION_REFLINK_16K
	output yaml
	help
	  XFS with 16k FSB with 4k sector size.

config MMTESTS_FS_XFS_32K_4KS
	bool "XFS 32k LBS - 4k sector size"
	select MMTESTS_XFS_SECTOR_SIZE_4K
	select MMTESTS_XFS_SECTION_REFLINK_32K
	output yaml
	help
	  XFS with 32k FSB with 4k sector size.

config MMTESTS_FS_XFS_64K_4KS
	bool "XFS 64k LBS - 4k sector size"
	select MMTESTS_XFS_SECTOR_SIZE_4K
	select MMTESTS_XFS_SECTION_REFLINK_64K
	output yaml
	help
	  XFS with 64k FSB with 8k sector size.

config MMTESTS_FS_XFS_8K_8KS
	bool "XFS 8k LBS - 8k sector size"
	select MMTESTS_XFS_SECTOR_SIZE_8K
	select MMTESTS_XFS_SECTION_REFLINK_16K
	output yaml
	help
	  XFS with 8k FSB with 8k sector size.

config MMTESTS_FS_XFS_16K_8KS
	bool "XFS 16k LBS - 8k sector size"
	select MMTESTS_XFS_SECTOR_SIZE_8K
	select MMTESTS_XFS_SECTION_REFLINK_16K
	output yaml
	help
	  XFS with 16k FSB with 8k sector size.

config MMTESTS_FS_XFS_32K_8KS
	bool "XFS 32k LBS - 8k sector size"
	select MMTESTS_XFS_SECTOR_SIZE_8K
	select MMTESTS_XFS_SECTION_REFLINK_32K
	output yaml
	help
	  XFS with 32k FSB with 8k sector size.

config MMTESTS_FS_XFS_64K_8KS
	bool "XFS 64k LBS - 8k sector size"
	select MMTESTS_XFS_SECTOR_SIZE_8K
	select MMTESTS_XFS_SECTION_REFLINK_64K
	output yaml
	help
	  XFS with 64k FSB with 8k sector size.

config MMTESTS_FS_XFS_16K_16KS
	bool "XFS 16k LBS - 16k sector size"
	select MMTESTS_XFS_SECTOR_SIZE_16K
	select MMTESTS_XFS_SECTION_REFLINK_16K
	output yaml
	help
	  XFS with 16k FSB with 16k sector size.

config MMTESTS_FS_XFS_32K_16KS
	bool "XFS 32k LBS - 16k sector size"
	select MMTESTS_XFS_SECTOR_SIZE_16K
	select MMTESTS_XFS_SECTION_REFLINK_32K
	output yaml
	help
	  XFS with 32k FSB with 16k sector size.

config MMTESTS_FS_XFS_64K_16KS
	bool "XFS 64k LBS - 16k sector size"
	select MMTESTS_XFS_SECTOR_SIZE_16K
	select MMTESTS_XFS_SECTION_REFLINK_64K
	output yaml
	help
	  XFS with 64k FSB with 16k sector size.

config MMTESTS_FS_XFS_32K_32KS
	bool "XFS 32k LBS - 32k sector size"
	select MMTESTS_XFS_SECTOR_SIZE_32K
	select MMTESTS_XFS_SECTION_REFLINK_32K
	output yaml
	help
	  XFS with 32k FSB with 32k sector size.

config MMTESTS_FS_XFS_64K_32KS
	bool "XFS 64k LBS - 32k sector size"
	select MMTESTS_XFS_SECTOR_SIZE_32K
	select MMTESTS_XFS_SECTION_REFLINK_64K
	output yaml
	help
	  XFS with 64k FSB with 32k sector size.

endchoice

choice
	prompt "XFS filesystem sector size to use"
	default MMTESTS_XFS_SECTOR_SIZE_4K

config MMTESTS_XFS_SECTOR_SIZE_512
	bool "512 bytes"
	output yaml
	depends on EXTRA_STORAGE_SUPPORTS_512
	help
	  Use 512 byte sector size.

config MMTESTS_XFS_SECTOR_SIZE_4K
	bool "4 KiB"
	output yaml
	depends on EXTRA_STORAGE_SUPPORTS_4K
	help
	  Use 4 KiB sector size.

config MMTESTS_XFS_SECTOR_SIZE_16K
	bool "16 KiB"
	output yaml
	depends on EXTRA_STORAGE_SUPPORTS_LARGEIO
	help
	  Use 16 KiB sector size.

config MMTESTS_XFS_SECTOR_SIZE_32K
	bool "32 KiB"
	output yaml
	depends on EXTRA_STORAGE_SUPPORTS_LARGEIO
	help
	  Use 32 KiB sector size.

endchoice

config MMTESTS_XFS_SECTOR_SIZE
	string
	output yaml
	default "512" if MMTESTS_XFS_SECTOR_SIZE_512
	default "4k"  if MMTESTS_XFS_SECTOR_SIZE_4K
	default "16k" if MMTESTS_XFS_SECTOR_SIZE_16K
	default "32k" if MMTESTS_XFS_SECTOR_SIZE_32K

config MMTESTS_XFS_SECTION_REFLINK_4K
	bool

config MMTESTS_XFS_SECTION_REFLINK_4K_CMD
	string
	depends on MMTESTS_XFS_SECTION_REFLINK_4K
	default "-f -m reflink=1,rmapbt=1, -i sparse=1 -b size=4k"

config MMTESTS_XFS_SECTION_REFLINK_8K
	bool

config MMTESTS_XFS_SECTION_REFLINK_8K_CMD
	string
	depends on MMTESTS_XFS_SECTION_REFLINK_8K
	default "-f -m reflink=1,rmapbt=1 -i sparse=1 -b size=8k"

config MMTESTS_XFS_SECTION_REFLINK_16K
	bool

config MMTESTS_XFS_SECTION_REFLINK_16K_CMD
	string
	depends on MMTESTS_XFS_SECTION_REFLINK_16K
	default "-f -m reflink=1,rmapbt=1 -i sparse=1 -b size=16k"

config MMTESTS_XFS_SECTION_REFLINK_32K
	bool

config MMTESTS_XFS_SECTION_REFLINK_32K_CMD
	string
	depends on MMTESTS_XFS_SECTION_REFLINK_32K
	default "-f -m reflink=1,rmapbt=1 -i sparse=1 -b size=32k"

config MMTESTS_XFS_SECTION_REFLINK_64K
	bool

config MMTESTS_XFS_SECTION_REFLINK_64K_CMD
	string
	depends on MMTESTS_XFS_SECTION_REFLINK_64K
	default "-f -m reflink=1,rmapbt=1 -i sparse=1 -b size=64k"

config MMTESTS_XFS_CMD
	string
	default MMTESTS_XFS_SECTION_REFLINK_4K_CMD if MMTESTS_FS_XFS_4K_4KS
	default MMTESTS_XFS_SECTION_REFLINK_8K_CMD if MMTESTS_XFS_SECTION_REFLINK_8K
	default MMTESTS_XFS_SECTION_REFLINK_16K_CMD if MMTESTS_XFS_SECTION_REFLINK_16K
	default MMTESTS_XFS_SECTION_REFLINK_32K_CMD if MMTESTS_XFS_SECTION_REFLINK_32K
	default MMTESTS_XFS_SECTION_REFLINK_64K_CMD if MMTESTS_XFS_SECTION_REFLINK_64K

endif # MMTESTS_FS_XFS
```
