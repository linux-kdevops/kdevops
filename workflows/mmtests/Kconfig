## workflows/nfstest/Kconfig
```kconfig
if KDEVOPS_WORKFLOW_ENABLE_NFSTEST

config NFSTEST_USE_KDEVOPS_NFSD
	bool "Provision and use the kdevops NFS server"
	select KDEVOPS_SETUP_NFSD
	default y
	help
	  Select this option to have kdevops provision an additional
	  target node to be used as the NFS server for testing.

	  Say N if you have a reachable NFS server to test against, and
	  specify that server's hostname using the
	  NFSTEST_NFS_SERVER_HOST option.

config NFSTEST_NFS_SERVER_HOST
	string "Test NFS Server hostname"
	default ""
	depends on !NFSTEST_USE_KDEVOPS_NFSD
	help
	  The NFS server hostname or address to test against. Tests
	  expect that an appropriate share is already available for
	  them to mount and use.

config NFSTEST_MNT
	string "Where clients mount the file system under test"
	default "/mnt/t"
	help
	  The directory over which to mount the file system under test.

config HAVE_MIRROR_NFSTEST
	bool
	depends on USE_LIBVIRT_MIRROR
	default $(shell, scripts/check_mirror_present.sh /mirror/nfstest.git)

config NFSTEST_REPO
	string "The nfstest repository"
	default DEFAULT_NFSTEST_URL if !HAVE_MIRROR_NFSTEST
	default $(shell, scripts/append-makefile-vars.sh git:// $(KDEVOPS_DEFAULT_BRIDGE_IP_VAGRANT) /mirror/nfstest.git) if HAVE_MIRROR_NFSTEST && VAGRANT
	default $(shell, scripts/append-makefile-vars.sh git:// $(KDEVOPS_DEFAULT_BRIDGE_IP_GUESTFS) /mirror/nfstest.git) if HAVE_MIRROR_NFSTEST && GUESTFS
	help
	  The nfstest repository to clone.

config NFSTEST_REPO_COMMIT
	string "The version of nfstest to check out"
	default "v3.2"
	help
	  The version of nfstest to be used for the test.

if KDEVOPS_WORKFLOW_DEDICATE_NFSTEST

config NFSTEST_TEST_GROUP_ALLOC
	bool "Enable the nfstest_alloc testing section"
	default n
	help
	  Provision a target node to test NFSv4.2 space reservation.

config NFSTEST_TEST_GROUP_DIO
	bool "Enable the nfstest_dio testing section"
	default n
	help
	  Provision target nodes to run direct I/O tests.

config NFSTEST_TEST_GROUP_INTEROP
	bool "Enable the nfstest_interop testing section"
	default y
	help
	  Provision target nodes to run NFS interoperability tests.

config NFSTEST_TEST_GROUP_LOCK
	bool "Enable the nfstest_lock testing section"
	default n
	help
	  Provision target nodes to test NFS file locking.

config NFSTEST_TEST_GROUP_POSIX
	bool "Enable the nfstest_posix testing section"
	default n
	help
	  Provision a target node to run POSIX file access tests.

config NFSTEST_TEST_GROUP_SPARSE
	bool "Enable the nfstest_sparse testing section"
	help
	  Provision a target node to test support for sparse files.

config NFSTEST_TEST_GROUP_SSC
	bool "Enable the nfstest_ssc testing section"
	help
	  Provision target nodes to test the operation of server-side
	  copy.

endif # KDEVOPS_WORKFLOW_DEDICATE_NFSTEST

endif # KDEVOPS_WORKFLOW_ENABLE_GITR
```

## workflows/pynfs/Kconfig
```kconfig
if KDEVOPS_WORKFLOW_ENABLE_PYNFS

config HAVE_MIRROR_PYNFS
	bool
	depends on USE_LIBVIRT_MIRROR
	default $(shell, scripts/check_mirror_present.sh /mirror/pynfs.git)

config PYNFS_REPO_CUSTOM
	bool "Clone a custom version of the pynfs source code"
	default n
	help
	  Choose N to clone the master pynfs source code repo from either
	  git.linux-nfs.org or a local mirror. Choose Y to enter a custom
	  URL to clone.

config PYNFS_REPO_URL
	string "The URL of the custom pynfs source code repository to clone"
	depends on PYNFS_REPO_CUSTOM
	help
	  Enter the URL of the pynfs source code repository to clone.

config PYNFS_GIT
	string
	default DEFAULT_PYNFS_GIT_URL if !PYNFS_REPO_CUSTOM && !HAVE_MIRROR_PYNFS
	default PYNFS_REPO_URL if PYNFS_REPO_CUSTOM
	default $(shell, scripts/append-makefile-vars.sh git:// $(KDEVOPS_DEFAULT_BRIDGE_IP_GUESTFS) /mirror/pynfs.git) if HAVE_MIRROR_PYNFS && GUESTFS

config PYNFS_GIT_TAG
	string "tag, branch or sha1sum"
	default "master"
	help
	  The tag, branch or sha1sum to check out.

config PYNFS_PNFS_BLOCK
	bool "Add the pNFS block tests"
	default n
	help
	  Select this option to additionally run tests related to
	  pNFS block layouts.

endif # KDEVOPS_WORKFLOW_ENABLE_PYNFS
```

## workflows/rcloud/Kconfig
```kconfig
config RCLOUD
	bool "Enable rcloud REST API server"
	default n
	help
	  Enable rcloud - a private cloud infrastructure REST API server for
	  managing VMs through libvirt. This provides a Ubicloud-like interface
	  for declarative VM management using Terraform.

	  rcloud leverages existing guestfs infrastructure (base images, storage
	  pools) and provides a REST API for VM lifecycle management.

	  When enabled, running 'make' will build the rcloud Rust binary, and
	  'make rcloud' will install and configure the systemd service.

	  This is typically enabled on a dedicated server to provide cloud-like
	  VM provisioning to multiple users.

if RCLOUD

config RCLOUD_SERVER_BIND
	string "rcloud API server bind address"
	output yaml
	default "127.0.0.1:8765"
	help
	  Address and port for the rcloud API server to bind to.

	  Default is localhost only (127.0.0.1:8765) for security.
	  Port 8765 is chosen to avoid conflicts with common services.
	  Use 0.0.0.0:8765 to allow network access (not recommended without
	  authentication - see docs/AUTHENTICATION.md).

	  Users can access via SSH tunnel:
	    ssh -L 8765:localhost:8765 server

config RCLOUD_WORKERS
	int "Number of worker threads"
	output yaml
	default 4
	help
	  Number of worker threads for the rcloud API server.
	  Default is 4, suitable for most deployments.

config RCLOUD_ENABLE_TERRAFORM_PROVIDER
	bool "Build Terraform provider"
	default y
	help
	  Build the Terraform provider for rcloud. This allows managing
	  rcloud VMs using Infrastructure as Code with Terraform.

	  The provider will be built in terraform-provider-rcloud/ and can
	  be installed to ~/.terraform.d/plugins/ for local development.

endif # RCLOUD
```

## workflows/selftests/Kconfig
```kconfig
if KDEVOPS_WORKFLOW_ENABLE_SELFTESTS

config SELFTESTS_KMOD_TIMEOUT_SET_BY_CLI
	bool
	default $(shell, scripts/check-cli-set-var.sh KMOD_TIMEOUT)

menu "Configure what to test in selftests"

config SELFTESTS_BUILD_RADIX_TREE
	bool
	output yaml

config SELFTESTS_BUILD_SELFTESTS_DIR
	bool
	output yaml

config SELFTESTS_MANUAL_COVERAGE
	bool "Enable manual coverage selection"
	output yaml
	default y
	help
	  By default we aim to spawn enough hosts to cover testing the full
	  set of supported tests. If you are sure you don't need to test
	  certain things, enabling this option lets you disable them here.

	  We only enable selftests for a subsystem by default after vetting by
	  respective subsystem maintainers.

if SELFTESTS_MANUAL_COVERAGE

config SELFTESTS_TEST_BUNDLE_RADIX_TREE
	bool "Test all tests related to kernel the radix tree"
	output yaml
	select SELFTESTS_SECTION_MAPLE
	select SELFTESTS_SECTION_XARRAY
	help
	  This will ensure you test the radix tree in the kernel.

config SELFTESTS_SECTION_FIRMWARE
	bool "Firmware loader"
	output yaml
	select SELFTESTS_BUILD_SELFTESTS_DIR
	help
	  This will create a host to test the firmware loader.

config SELFTESTS_SECTION_KMOD
	bool "kmod - Kernel module loader usermode helper"
	output yaml
	select SELFTESTS_BUILD_SELFTESTS_DIR
	help
	  This will create a host to test the kmod selftest.

config SELFTESTS_SECTION_MODULE
	bool "module - run all module seleftses"
	output yaml
	select SELFTESTS_BUILD_SELFTESTS_DIR
	help
	  This test all module selftets.

config SELFTESTS_SECTION_MAPLE
	bool "Maple tree"
	output yaml
	select SELFTESTS_BUILD_RADIX_TREE
	help
	  This will create a host to test the maple tree.

config SELFTESTS_SECTION_SYSCTL
	bool "sysctls"
	output yaml
	select SELFTESTS_BUILD_SELFTESTS_DIR
	help
	  This will create a host to test proc sysctls.

config SELFTESTS_SECTION_XARRAY
	bool "Xarray"
	output yaml
	select SELFTESTS_BUILD_RADIX_TREE
	help
	  This will create a host to test the xarray.

endif # SELFTESTS_MANUAL_COVERAGE

if !SELFTESTS_MANUAL_COVERAGE

config SELFTESTS_SECTION_FIRMWARE
	bool
	output yaml
	default y

config SELFTESTS_SECTION_KMOD
	bool
	output yaml
	default y

config SELFTESTS_SECTION_MODULE
	bool
	output yaml
	default y

config SELFTESTS_SECTION_SYSCTL
	bool
	output yaml
	default y

config SELFTESTS_SECTION_XARRAY
	bool
	output yaml
	default y

endif # !SELFTESTS_MANUAL_COVERAGE

endmenu

config SELFTESTS_SECTION_KMOD_TIMEOUT
	int "kmod timeout"
	output yaml
	depends on SELFTESTS_SECTION_KMOD
	default 165 if !SELFTESTS_KMOD_TIMEOUT_SET_BY_CLI
	default $(shell, ./scripts/append-makefile-vars-int.sh $(KMOD_TIMEOUT)) if SELFTESTS_KMOD_TIMEOUT_SET_BY_CLI
	help
	  A default timeout of 45 seconds is used for runner, however each
	  runner system configuration may also vary. So a timeout is very
	  runner specific. Selftests are by design supposed to be relatively
	  fast. In order to support some tests which may be longer and which
	  can vary depending on the runner selftests support a custom timeout
	  per runner. This will be used only for the kmod test:

	  ./run_kselftest.sh --override-timeout <timeout>

	  https://www.kernel.org/doc/Documentation/dev-tools/kselftest.rst

endif # KDEVOPS_WORKFLOW_ENABLE_SELFTESTS
```

## workflows/steady_state/Kconfig
```kconfig
config SSD_STEADY_STATE_DEVICE
    string "Device to pre-condition"
    output yaml
    default "/dev/disk/by-id/nvme-QEMU_NVMe_Ctrl_kdevops2" if LIBVIRT && LIBVIRT_EXTRA_STORAGE_DRIVE_NVME
    default "/dev/disk/by-id/virtio-kdevops2" if LIBVIRT && LIBVIRT_EXTRA_STORAGE_DRIVE_VIRTIO
    default "/dev/disk/by-id/ata-QEMU_HARDDISK_kdevops2" if LIBVIRT && LIBVIRT_EXTRA_STORAGE_DRIVE_IDE
    default "/dev/sdc" if LIBVIRT && LIBVIRT_EXTRA_STORAGE_DRIVE_SCSI
    default "/dev/nvme2n1" if TERRAFORM_AWS_INSTANCE_M5AD_4XLARGE
    default "/dev/nvme1n1" if TERRAFORM_GCE
    default "/dev/sdd" if TERRAFORM_AZURE
    default TERRAFORM_OCI_SPARSE_VOLUME_DEVICE_FILE_NAME if TERRAFORM_OCI
    help
      Block device to operate on for steady state.

config SSD_STEADY_STATE_PREFILL_BLOCKSIZE
    string "Prefill blocksize"
    output yaml
    default ""
    help
      Block size used during the prefill step before steady
      state verification. If empty we will try to infer this based first on the
      the device queue/optimal_io_size and if that is not available fallback
      to the queue/physical_block_size which should always exist. The final
      computed block size is kept at run time on the effective_blocksize
      varible and computed on the task 'Calculate effective configuration values'

config SSD_STEADY_STATE_IODEPTH
    string "Prefill iodepth"
    output yaml
    default "32"
    help
      Queue depth used for the prefill workload.

config SSD_STEADY_STATE_NUMJOBS
    string "Prefill number jobs"
    output yaml
    default "4"
    help
      Number of fio jobs to spawn for the prefill step.

config SSD_STEADY_STATE_PREFILL_LOOP
    int "Prefill loop count"
    output yaml
    default 2
    help
      How many iterations of the prefill helper to run.

config SSD_STEADY_STATE_RUNTIME
    string "Steady state runtime"
    output yaml
    default "6h"
    help
      Maximum runtime allowed for each steady state check.

config SSD_STEADY_STATE_IOPS_MEAN_LIMIT
    string "IOPS steady state mean limit"
    output yaml
    default "20%"
    help
      fio ss=iops value defining the IOPS mean limit criteria.

config SSD_STEADY_STATE_IOPS_MEAN_DUR
    string "IOPS steady state mean duration"
    output yaml
    default "4h"
    help
      Duration the IOPS mean limit must be sustained.

config SSD_STEADY_STATE_IOPS_SLOPE
    string "IOPS steady state slope"
    output yaml
    default "10%"
    help
      fio ss=iops_slope percentage for slope detection.

config SSD_STEADY_STATE_IOPS_SLOPE_DUR
    string "IOPS steady state slope duration"
    output yaml
    default "4h"
    help
      Duration the IOPS slope criterion must hold.

config SSD_STEADY_STATE_BW_MEAN_LIMIT
    string "BW steady state mean limit"
    output yaml
    default "20%"
    help
      fio ss=bw value defining the throughput mean limit.

config SSD_STEADY_STATE_BW_MEAN_DUR
    string "BW steady state mean duration"
    output yaml
    default "2h"
    help
      Duration the throughput mean limit must be sustained.

config SSD_STEADY_STATE_BW_SLOPE
    string "BW steady state slope"
    output yaml
    default "10%"
    help
      fio ss=bw_slope percentage for slope detection.

config SSD_STEADY_STATE_BW_SLOPE_DUR
    string "BW steady state slope duration"
    output yaml
    default "2h"
    help
      Duration the throughput slope criterion must hold.

menu "Prefill configuration options"

config SSD_STEADY_STATE_PREFILL_VERBOSE
    bool "Enable verbose prefill output"
    output yaml
    default n
    help
      Enable verbose debug output during the prefill operation.
      This provides detailed information about alignment calculations
      and fio command generation.

config SSD_STEADY_STATE_PREFILL_MAX_SIZE
    string "Maximum size for prefill operation"
    output yaml
    default ""
    help
      Override the automatic detection of device capacity.
      If empty, the script will use the full capacity of block devices
      or file size for regular files. Use suffixes like "1G", "100M", etc.

config SSD_STEADY_STATE_PREFILL_PHYSICAL_BS
    string "Physical block size override"
    output yaml
    default ""
    help
      Override the automatic detection of physical block size.
      If empty, the script will read from /sys/block/*/queue/physical_block_size
      for block devices. Must be a power of 2 and align with the blocksize.

config SSD_STEADY_STATE_PREFILL_IOENGINE
    string "FIO I/O engine for prefill"
    output yaml
    default "io_uring"
    help
      The FIO I/O engine to use for prefill operations.
      Common options: io_uring, libaio, psync, sync.
      io_uring provides the best performance on modern kernels.

config SSD_STEADY_STATE_PREFILL_DIRECT
    string "FIO direct I/O setting"
    output yaml
    default "1"
    help
      Enable or disable direct I/O for prefill operations.
      1 = direct I/O (bypass page cache)
      0 = buffered I/O (use page cache)
      Direct I/O is recommended for accurate device testing.

config SSD_STEADY_STATE_PREFILL_ALLOC_SIZE
    string "FIO memory allocation size per job"
    output yaml
    default "1048576"
    help
      Memory allocation size per FIO job in bytes.
      This controls how much memory each FIO job uses.
      Default of 1MB should support up to 128 threads.
      Increase if using more jobs or experiencing memory pressure.

config SSD_STEADY_STATE_PREFILL_EXTRA_ARGS
    string "Additional FIO arguments for prefill"
    output yaml
    default ""
    help
      Additional arguments to pass to FIO during prefill operations.
      These will be appended to the generated FIO command line.
      Example: "--gtod_reduce=1 --norandommap"

endmenu
```
