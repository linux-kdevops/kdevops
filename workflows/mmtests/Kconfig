## workflows/sysbench/Kconfig
```kconfig
config SYSBENCH_DB_TYPE_MYSQL
	bool
	output yaml

config SYSBENCH_DB_TYPE_POSTGRESQL
	bool
	output yaml

source "workflows/sysbench/Kconfig.fs"

choice
	prompt "What type of sysbench testing do you want to use"
	default SYSBENCH_DOCKER

config SYSBENCH_DOCKER
	bool "Run Sysbench in Docker Container"
	output yaml
	select SYSBENCH_TYPE_MYSQL_DOCKER
	help
	  Run sysbench inside Docker containers.

config SYSBENCH_NATIVE
	bool "Run Sysbench natively in the Guest OS"
	output yaml
	select SYSBENCH_TYPE_POSTGRESQL_NATIVE
	help
	  Run sysbench natively in the Guest OS.

endchoice

if SYSBENCH_DOCKER
source "workflows/sysbench/Kconfig.docker"
endif # SYSBENCH_DOCKER

if SYSBENCH_NATIVE
source "workflows/sysbench/Kconfig.native"
endif # SYSBENCH_NATIVE

config SYSBENCH_DB_TYPE
	string
	output yaml
	default "mysql" if SYSBENCH_DB_TYPE_MYSQL
	default "pgsql" if SYSBENCH_DB_TYPE_POSTGRESQL

if SYSBENCH_DB_TYPE_MYSQL

config SYSBENCH_MYSQL_TABLE_ENGINE
	string "Sysbench MySQL table engine to use"
	output yaml
	default "innodb" if SYSBENCH_TYPE_MYSQL_DOCKER

config SYSBENCH_MYSQL_INNODB_REDO_LOG_CAPACITY
	string "innodb_redo_log_capacity"
	output yaml
	default "1G" if SYSBENCH_TYPE_MYSQL_DOCKER
	help
	  innodb_dedicated_server=ON is not compatible with innodb_flush_method=O_DIRECT
	  and so we do what we can. See the following values which MySQL does
	  recommend use when dedicated server is enabled, we just have to compute
	  on our own and test on our own:

	  https://dev.mysql.com/doc/refman/8.0/en/innodb-dedicated-server.html

	  Let us assume n1-standard-16 with 60GB RAM or AWS i4i.4xlarge with 128GB.
	  The recommended values seem very large in consideration for when we disable
	  innodb_doublewrite and use O_DIRECT, so likely could be adjusted. We strive
	  to provide generic configurations for these types of instances in this
	  example file for innodb_doublewrite=0.

	  For systems with above 10 GiB RAM: 0.5625 * (RAM in GB)
	  n1-standard-16: 33.75G
	  i4i.4xlarge: 72G

config SYSBENCH_MYSQL_INNODB_BUFFER_POOL_SIZE
	string "innodb_buffer_pool_size"
	output yaml
	default "512M" if SYSBENCH_TYPE_MYSQL_DOCKER
	help
	  For systems with above 4 GiB RAM: 0.75 * (RAM in GB)
	  n1-standard-16: 45G
	  i4i.4xlarge: 96G

endif # SYSBENCH_DB_TYPE_MYSQL

config SYSBENCH_DB_NAME
	string "Database name to use"
	output yaml
	default "sbtest"

config SYSBENCH_DB_USERNAME
	string "Database username to use"
	output yaml
	default "sbtest"

config SYSBENCH_ROOT_DB_PASSWORD
	string "The root database password to use"
	output yaml
	default "kdevops"

config SYSBENCH_DB_PASSWORD
	string "Database password to use for sysbench database"
	output yaml
	default "kdevops"

config SYSBENCH_REPORT_INTERVAL
	int "Sysbench report interval"
	output yaml
	default "2"

config SYSBENCH_OLTP_TABLE_SIZE
	int "Sysbench OLTP table size"
	output yaml
	default "100000"

config SYSBENCH_OLTP_TABLE_COUNT
	int "Sysbench OLTP table count"
	output yaml
	default "24"

choice
	prompt "Number of threads?"
	default SYSBENCH_THREADS_INTEGER if SYSBENCH_DB_TYPE_MYSQL
	default SYSBENCH_THREADS_AUTO if SYSBENCH_DB_TYPE_POSTGRESQL

config SYSBENCH_THREADS_INTEGER
	bool "Manual"
	help
	  Configure the number of threads manually

config SYSBENCH_THREADS_AUTO
	bool "Auto"
	help
	  Configure the number of threads automatically using nproc

endchoice

if SYSBENCH_THREADS_INTEGER

config SYSBENCH_THREADS
	int "Sysbench number of threads"
	output yaml
	default "128"
	help
	  Set the number of threads for the sysbench test. Default is 128.

endif # SYSBENCH_THREADS_INTEGER

if SYSBENCH_THREADS_AUTO

config SYSBENCH_THREADS
	output yaml
	default "0"
	help
	  Set the number of threads using nproc.

endif # SYSBENCH_THREADS_AUTO

config SYSBENCH_TEST_DURATION
	int "Sysbench Test Duration (seconds)"
	default 3600
	output yaml
	help
	  Set the duration of the sysbench test in seconds. Default is 3600 (1 hour).

config SYSBENCH_TELEMETRY_PATH
	string "Where to collect telemetry information"
	default "/data/sysbench-telemetry"
	output yaml
	help
	  Set the path where to place telemetry information collected. By
	  default we use a directory under /data/ directory as we strive
	  to mkfs the filesystem mounted on /data/ as a separate filesystem
	  than where we place the database. This is so we separate the IOs
	  from telemetry and the database.
```

## workflows/sysbench/Kconfig.docker
```kconfig
choice
	prompt "What type of sysbench docker container do you want to use?"
	default SYSBENCH_TYPE_MYSQL_DOCKER

config SYSBENCH_TYPE_MYSQL_DOCKER
	bool "Use MySQL with Docker for Sysbench"
	output yaml
	select SYSBENCH_DB_TYPE_MYSQL
	help
	  Enable this option to run sysbench using MySQL inside a Docker
	  container. The benefit is having to install less package
	  dependencies.

endchoice

if SYSBENCH_TYPE_MYSQL_DOCKER

choice
	prompt "Which MySQL container image to use?"
	default SYSBENCH_MYSQL_CONTAINER_IMAGE_8_0

config SYSBENCH_MYSQL_CONTAINER_IMAGE_8_0
	bool "mysql:8.0"
	output yaml
	help
	  Uses mysql:8.0 as the docker image.

endchoice

config SYSBENCH_MYSQL_CONTAINER_IMAGE_STRING
	string
	output yaml
	default "mysql:8.0" if SYSBENCH_MYSQL_CONTAINER_IMAGE_8_0

config SYSBENCH_MYSQL_CONTAINER_NAME
	string "The local MySQL container to use for MySQL"
	default "mysql-sysbench"
	output yaml
	help
	  Set the name for the MySQL Docker container.

config SYSBENCH_MYSQL_CONTAINER_PYTHON_PATH
	string "The MySQL container python path"
	default "/usr/local/lib/python3.9/site-packages" if SYSBENCH_MYSQL_CONTAINER_IMAGE_8_0
	output yaml
	help
	  To support telemetry analysis we use a set of python packages
	  which we install with python pip, when these are installed locally
	  we need to inform MySQL where they are so that the mysqlsh can
	  find them. This can vary depending on the MySQL container image
	  used.

config SYSBENCH_MYSQL_CONTAINER_HOST_CLIENT_CONFIG_PATH
	string "Path on node where we'll place the mysql client configuration"
	default "/data/my.cnf"
	output yaml
	help
	  When using a container, we'll use a volume to propagate the actual
	  MySQL client configuration file used inside the container. This lets
	  us make edits on the node.

config SYSBENCH_MYSQL_CONTAINER_CLIENT_CONFIG
	string "The MySQL container client configuration file"
	default "/root/.my.cnf"
	output yaml
	help
	  This is where we will place the MySQL client configuration file on the
	  target container. This can vary depending on the version of the
	  docker container used.

config SYSBENCH_MYSQL_CONTAINER_HOST_CONFIG_PATH
	string "Path on node where we'll place the mysql server configuration"
	default "/data/mysql.conf"
	output yaml
	help
	  When using a container, we'll use a volume to propagate the actual
	  MySQL configuration file used inside the container. This lets us make
	  edits on the node.

config SYSBENCH_MYSQL_CONTAINER_CONFIG
	string "The MySQL container server configuration file"
	default "/etc/my.cnf"
	output yaml
	help
	  This is where we will place the MySQL configuration file on the
	  target container. This can vary depending on the version of the
	  docker container used.

config SYSBENCH_MYSQL_CONTAINER_DB_PATH
	string "MySQL container db path"
	default "/var/lib/mysql" if SYSBENCH_MYSQL_CONTAINER_IMAGE_8_0
	output yaml
	help
	  Where to place the database on the container.

config SYSBENCH_MYSQL_CONTAINER_HOST_ROOT_PATH
	string "Directory on the host to use as /root/ inside the container"
	default "/data/myql-container-root"
	output yaml
	help
	  When using a container, in order to support telemetry we rely on
	  a mysqlsh plugin which we git clone on the node where we will
	  run the container on. We use a container volume to let the container
	  get access to this clone. This specifies the path on the node which
	  we will use a docker volume passed onto the container as the
	  /root/ directory.

endif # SYSBENCH_TYPE_MYSQL_DOCKER

choice
	prompt "Which sysbench container image to use?"
	default SYSBENCH_CONTAINER_SEVERALNINES_SYSBENCH

config SYSBENCH_CONTAINER_SEVERALNINES_SYSBENCH
	bool "severalnines/sysbench"
	output yaml
	help
	  Use the severalnines/sysbench container when using sysbench.

endchoice

config SYSBENCH_CONTAINER_IMAGE_NAME
	string
	default "severalnines/sysbench" if SYSBENCH_CONTAINER_SEVERALNINES_SYSBENCH
	output yaml

config SYSBENCH_CONTAINER_NAME
	string "The name of the container to use for sysbench"
	default "sysbench-kdevops"
	output yaml

config SYSBENCH_LOCAL_DB_PORT
	int "The actual local database port to use"
	default "9901"
	output yaml
	help
	  When using containers we may want to support running different
	  databases. To support this and yet have the database be able to
	  run on its own default database port we just use a local arbitrary
	  port on the actual host, but inside the container the default port
	  could be used.

config SYSBENCH_DOCKER_TELEMETRY_PATH
	string "The path to place telemetry information on the docker container"
	default SYSBENCH_TELEMETRY_PATH
	output yaml
	help
	  Where to place telemetry information inside the docker container.
```

## workflows/sysbench/Kconfig.ext4
```kconfig
config SYSBENCH_FS_EXT4
	bool "ext4"
	output yaml
	help
	  Enable if you want to test sysbench against ext4.

if SYSBENCH_FS_EXT4

config SYSBENCH_SUPPORTED_FILESYSTEM_EXT4
	bool
	output yaml
	default y

choice
    prompt "EXT4 filesystem sector size to use"
    default SYSBENCH_EXT4_SECTOR_SIZE_4K

config SYSBENCH_EXT4_SECTOR_SIZE_512
	bool "512 bytes"
	output yaml
	depends on EXTRA_STORAGE_SUPPORTS_512
	help
	  Use 512 byte sector size.

config SYSBENCH_EXT4_SECTOR_SIZE_4K
	bool "4 KiB"
	output yaml
	depends on EXTRA_STORAGE_SUPPORTS_4K
	help
	  Use 4 KiB sector size.

endchoice

config SYSBENCH_EXT4_SECTOR_SIZE
	string
	output yaml
	default "512" if SYSBENCH_EXT4_SECTOR_SIZE_512
	default "4k"  if SYSBENCH_EXT4_SECTOR_SIZE_4K

config SYSBENCH_EXT4_SECTION_4K
	bool "ext4_4k"
	output yaml
	help
	  This will create a host to test the sysbench on EXT4 with the
	  following configuration which enables a 4k block size filesystem:

	       mkfs.ext4 -F -b 4k

config SYSBENCH_EXT4_SECTION_4K_CMD
	string
	depends on SYSBENCH_EXT4_SECTION_4K
	output yaml
	default "mkfs.ext4 -F -b 4k"

config SYSBENCH_EXT4_SECTION_4K_DB_PAGE_SIZE
	int
	depends on SYSBENCH_EXT4_SECTION_4K
	output yaml
	default "4096"

config SYSBENCH_EXT4_SECTION_4K_BIGALLOC_16K
	bool "ext4_4k_bigalloc_16k"
	output yaml
	help
	  This will create a host to test the sysbench with the following fs
	  configuration, that is 8k data block size:

	       mkfs.ext4 -F -b 4k -O bigalloc -C 16k

config SYSBENCH_EXT4_SECTION_4K_BIGALLOC_16K_CMD
	string
	output yaml
	depends on SYSBENCH_EXT4_SECTION_4K_BIGALLOC_16K
	default "mkfs.ext4 -F -b 4k -O bigalloc -C 16k"

config SYSBENCH_EXT4_SECTION_4K_BIGALLOC_16K_DB_PAGE_SIZE
	int
	output yaml
	depends on SYSBENCH_EXT4_SECTION_4K_BIGALLOC_16K
	default "16384"

config SYSBENCH_EXT4_SECTION_4K_BIGALLOC_32K
	bool "ext4_4k_bigalloc_32k"
	output yaml
	help
	  This will create a host to test the sysbench with the following fs
	  configuration, that is 4k data block size:

	       mkfs.ext4 -F -b 4k -O bigalloc -C 32k

config SYSBENCH_EXT4_SECTION_4K_BIGALLOC_32K_CMD
	string
	output yaml
	depends on SYSBENCH_EXT4_SECTION_4K_BIGALLOC_32K
	default "mkfs.ext4 -F -b 4k -O bigalloc -C 32k"

config SYSBENCH_EXT4_SECTION_4K_BIGALLOC_32K_DB_PAGE_SIZE
	int
	output yaml
	depends on SYSBENCH_EXT4_SECTION_4K_BIGALLOC_32K
	default "32768"

config SYSBENCH_EXT4_SECTION_4K_BIGALLOC_64K
	bool "ext4_4k_bigalloc_64k"
	output yaml
	help
	  This will create a host to test the sysbench with the following fs
	  configuration, that is 4k data block size:

	       mkfs.ext4 -F -b 4k -O bigalloc -C 64k

config SYSBENCH_EXT4_SECTION_4K_BIGALLOC_64K_CMD
	string
	output yaml
	depends on SYSBENCH_EXT4_SECTION_4K_BIGALLOC_64K
	default "mkfs.ext4 -F -b 4k -O bigalloc -C 64k"

config SYSBENCH_EXT4_SECTION_4K_BIGALLOC_64K_DB_PAGE_SIZE
	int
	output yaml
	depends on SYSBENCH_EXT4_SECTION_4K_BIGALLOC_64K
	default "65536"

endif # SYSBENCH_FS_EXT4
```
