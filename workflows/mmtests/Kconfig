## workflows/sysbench/Kconfig.native
```kconfig
choice
	prompt "What type of sysbench do you want to use?"
	default SYSBENCH_TYPE_POSTGRESQL_NATIVE

config SYSBENCH_TYPE_POSTGRESQL_NATIVE
	bool "Use PostgreSQL natively for Sysbench"
	output yaml
	select SYSBENCH_DB_TYPE_POSTGRESQL
	help
	  Enable this option to run sysbench using PostgreSQL natively
	  in the Guest OS.

endchoice

if SYSBENCH_TYPE_POSTGRESQL_NATIVE

choice
	prompt "Which PostgreSQL version to use?"
	default SYSBENCH_POSTGRESQL_VERSION_REL_17

config SYSBENCH_POSTGRESQL_VERSION_REL_17
	bool "PostgreSQL 17.m"
	output yaml
	help
	  Uses latest 17 release available (e.g. 17.0).

config SYSBENCH_POSTGRESQL_VERSION_REL_16
	bool "PostgreSQL 16.m"
	output yaml
	help
	  Uses latest 16 release available (e.g. 16.4).

config SYSBENCH_POSTGRESQL_VERSION_REL_15
	bool "PostgreSQL 15.m"
	output yaml
	help
	  Uses latest 15 release available (e.g. 15.8).

endchoice

config SYSBENCH_POSTGRESQL_REF_STRING
	string
	output yaml
	default "REL_17" if SYSBENCH_POSTGRESQL_VERSION_REL_17
	default "REL_16" if SYSBENCH_POSTGRESQL_VERSION_REL_16
	default "REL_15" if SYSBENCH_POSTGRESQL_VERSION_REL_15

config SYSBENCH_POSTGRESQL_REPO_PATH
	string "PostgreSQL repository path"
	default "{{ data_path }}/postgresql"
	output yaml
	help
	  Where to clone the PostgreSQL repository. This will be used as build directory
	  as well.

config SYSBENCH_POSTGRESQL_BLOCKSIZE
	string "PostgreSQL Block Size"
	default "8"
	output yaml
	help
	  PostgreSQL block size in kilobytes (--with-blocksize=BLOCKSIZE).
	  The value must be a power of 2 between 1 and 32 (kilobytes).
	  This is a build configuration option.
	  https://www.postgresql.org/docs/16/install-make.html#CONFIGURE-OPTION-WITH-BLOCKSIZE

config SYSBENCH_POSTGRESQL_WAL_BLOCKSIZE
	string "PostgreSQL WAL Block Size"
	default "8"
	output yaml
	help
	  PostgreSQL WAL block size in kilobytes (--with-wal-blocksize=BLOCKSIZE).
	  The value must be a power of 2 between 1 and 64 (kilobytes).
	  This is a build configuration option.
	  https://www.postgresql.org/docs/16/install-make.html#CONFIGURE-OPTION-WITH-WAL-BLOCKSIZE

config SYSBENCH_POSTGRESQL_USER
	string "PostgreSQL benchmark user"
	default "postgres"
	output yaml
	help
	  User to run PostgreSQL database and benchmark.

config SYSBENCH_POSTGRESQL_LOGFILE
	string "PostgreSQL Log File"
	default "{{ sysbench_mnt }}/postgresql/postgresql.log"
	output yaml
	help
	  Where to place the server log output file.
	  https://www.postgresql.org/docs/current/app-pg-ctl.html

config SYSBENCH_POSTGRESQL_PGDATA
	string "PostgreSQL Log File"
	default "{{ sysbench_mnt }}/postgresql"
	output yaml
	help
	  Specifies the file system location of the database configuration files.
	  https://www.postgresql.org/docs/current/app-pg-ctl.html

config SYSBENCH_POSTGRESQL_CONTROLDATA_LOGFILE
	string "PostgreSQL Cluster Log File"
	default "{{ sysbench_telemetry_path }}/controldata.log"
	output yaml
	help
	  Where to place the control information of the database cluster.
	  https://www.postgresql.org/docs/current/app-pgcontroldata.html

config SYSBENCH_LOCAL_DB_PORT
	int "The actual local database port to use"
	default "5432"
	output yaml
	help
	  PostgreSQL Database Port

choice
	prompt "What PostgreSQL configuration to use?"
	default SYSBENCH_POSTGRESQL_CONF_DEFAULT

config SYSBENCH_POSTGRESQL_CONF_DEFAULT
	bool "Default"
	help
	  Use default configuration file.
	  Check playbooks/roles/sysbench/templates/postgresql-conf-default.conf.j2.

config SYSBENCH_POSTGRESQL_CONF_000
	bool "Configuration-000"
	help
	  Use configuration file nr 0.
	  Check playbooks/roles/sysbench/templates/postgresql-conf-000.conf.j2.

endchoice

config SYSBENCH_POSTGRESQL_CONFIGURATION
	string
	output yaml
	default "postgresql-conf-default.conf" if SYSBENCH_POSTGRESQL_CONF_DEFAULT
	default "postgresql-conf-000.conf" if SYSBENCH_POSTGRESQL_CONF_000

endif # SYSBENCH_TYPE_POSTGRESQL_NATIVE
```

## workflows/sysbench/Kconfig.xfs
```kconfig
config SYSBENCH_FS_XFS
	bool "XFS"
	output yaml
	help
	  Enable if you want to test sysbench against XFS.

if SYSBENCH_FS_XFS

config SYSBENCH_SUPPORTED_FILESYSTEM_XFS
	bool
	output yaml
	default y

choice
	prompt "XFS filesystem sector size to use"
	default SYSBENCH_XFS_SECTOR_SIZE_4K

config SYSBENCH_XFS_SECTOR_SIZE_512
	bool "512 bytes"
	output yaml
	depends on EXTRA_STORAGE_SUPPORTS_512
	help
	  Use 512 byte sector size.

config SYSBENCH_XFS_SECTOR_SIZE_4K
	bool "4 KiB"
	output yaml
	depends on EXTRA_STORAGE_SUPPORTS_4K
	help
	  Use 4 KiB sector size.

config SYSBENCH_XFS_SECTOR_SIZE_16K
	bool "16 KiB"
	output yaml
	depends on EXTRA_STORAGE_SUPPORTS_LARGEIO
	help
	  Use 16 KiB sector size.

config SYSBENCH_XFS_SECTOR_SIZE_32K
	bool "32 KiB"
	output yaml
	depends on EXTRA_STORAGE_SUPPORTS_LARGEIO
	help
	  Use 32 KiB sector size.

endchoice

config SYSBENCH_XFS_SECTOR_SIZE
	string
	output yaml
	default "512" if SYSBENCH_XFS_SECTOR_SIZE_512
	default "4k"  if SYSBENCH_XFS_SECTOR_SIZE_4K
	default "16k" if SYSBENCH_XFS_SECTOR_SIZE_16K
	default "32k" if SYSBENCH_XFS_SECTOR_SIZE_32K

config SYSBENCH_XFS_SECTION_REFLINK_4K
	bool "xfs_reflink_4k"
	output yaml
	help
	  This will create a host to test the sysbench on XFS with the
	  following configuration which enables reflink using 4096 bytes
	  block size.

	      mkfs.xfs -f -m reflink=1,rmapbt=1 -i sparse=1, -b size=4k

config SYSBENCH_XFS_SECTION_REFLINK_4K_CMD
	string
	output yaml
	depends on SYSBENCH_XFS_SECTION_REFLINK_4K
	default "mkfs.xfs -f -m reflink=1,rmapbt=1, -i sparse=1 -b size=4k"

config SYSBENCH_XFS_SECTION_REFLINK_4K_DB_PAGE_SIZE
	int
	output yaml
	depends on SYSBENCH_XFS_SECTION_REFLINK_4K
	default "4096"

config SYSBENCH_XFS_SECTION_REFLINK_8K
	bool "xfs_reflink_8k"
	output yaml
	help
	  This will create a host to test the sysbench with the following fs
	  configuration, that is 8k data block size:

	      mkfs.xfs -f -m reflink=1,rmapbt=1 -i sparse=1 -b size=8k

config SYSBENCH_XFS_SECTION_REFLINK_8K_CMD
	string
	output yaml
	depends on SYSBENCH_XFS_SECTION_REFLINK_8K
	default "mkfs.xfs -f -m reflink=1,rmapbt=1 -i sparse=1 -b size=8k"

config SYSBENCH_XFS_SECTION_REFLINK_8K_DB_PAGE_SIZE
	int
	output yaml
	depends on SYSBENCH_XFS_SECTION_REFLINK_8K
	default "8192"

config SYSBENCH_XFS_SECTION_REFLINK_16K
	bool "xfs_reflink_16k"
	output yaml
	help
	  This will create a host to test the sysbench with the following fs
	  configuration, that is 16k data block size:

	      mkfs.xfs -f -m reflink=1,rmapbt=1 -i sparse=1 -b size=16k

config SYSBENCH_XFS_SECTION_REFLINK_16K_CMD
	string
	output yaml
	depends on SYSBENCH_XFS_SECTION_REFLINK_16K
	default "mkfs.xfs -f -m reflink=1,rmapbt=1 -i sparse=1 -b size=16k"

config SYSBENCH_XFS_SECTION_REFLINK_16K_DB_PAGE_SIZE
	int
	output yaml
	depends on SYSBENCH_XFS_SECTION_REFLINK_16K
	default "16384"

config SYSBENCH_XFS_SECTION_REFLINK_32K
	bool "xfs_reflink_32k"
	output yaml
	help
	  This will create a host to test the sysbench with the following fs
	  configuration, that is with 32k sector size

	      mkfs.xfs -f -m reflink=1,rmapbt=1 -i sparse=1 -b size=32k

config SYSBENCH_XFS_SECTION_REFLINK_32K_CMD
	string
	output yaml
	depends on SYSBENCH_XFS_SECTION_REFLINK_32K
	default "mkfs.xfs -f -m reflink=1,rmapbt=1 -i sparse=1 -b size=32k"

config SYSBENCH_XFS_SECTION_REFLINK_32K_DB_PAGE_SIZE
	int
	output yaml
	depends on SYSBENCH_XFS_SECTION_REFLINK_32K
	default "32768"

config SYSBENCH_XFS_SECTION_REFLINK_64K
	bool "xfs_reflink_64k"
	output yaml
	help
	  This will create a host to test the sysbench with the following fs
	  configuration, that is with 64k sector size

	      mkfs.xfs -f -m reflink=1,rmapbt=1, -i sparse=1 -b size=64k

config SYSBENCH_XFS_SECTION_REFLINK_64K_CMD
	string
	output yaml
	depends on SYSBENCH_XFS_SECTION_REFLINK_64K
	default "mkfs.xfs -f -m reflink=1,rmapbt=1 -i sparse=1 -b size=64k"

config SYSBENCH_XFS_SECTION_REFLINK_64K_DB_PAGE_SIZE
	string
	output yaml
	depends on SYSBENCH_XFS_SECTION_REFLINK_64K
	default "65536"

endif # SYSBENCH_FS_XFS
```

## workflows/tcg-storage/Kconfig
```kconfig
if KDEVOPS_WORKFLOW_ENABLE_TCG_STORAGE

config HAVE_DISTRO_PREFERS_TCG_STORAGE_WATCHDOG
	bool
	default n

config HAVE_DISTRO_PREFERS_TCG_STORAGE_WATCHDOG_KILL
	bool
	default n

config HAVE_DISTRO_PREFERS_TCG_STORAGE_WATCHDOG_RESET
	bool
	default n

config TCG_STORAGE_TOOLS
	bool "Install TCG storage tools"
	default y
	help
	  This will install the go-tcg-storage tools:
	  - sedlockctl: Tool to manage SED/TCG drives
	  - tcgsdiag: Diagnostic tool for TCG drives
	  - tcgdiskstat: Display TCG drive statistics
	  - gosedctl: Alternative SED control tool

config TCG_STORAGE_GITHUB_URL
	string "GitHub URL for go-tcg-storage"
	default "https://github.com/open-source-firmware/go-tcg-storage"
	help
	  GitHub repository URL for the go-tcg-storage project.
	  You can override this to use a fork or mirror.

config TCG_STORAGE_BRANCH
	string "Branch to use for go-tcg-storage"
	default "main"
	help
	  Branch or tag to checkout from the go-tcg-storage repository.

config TCG_STORAGE_USE_LOCAL
	bool "Use local go-tcg-storage directory"
	default n
	help
	  If enabled, use the local go-tcg-storage directory at
	  ../go-tcg-storage instead of cloning from GitHub.
	  This is useful for development and testing.

config TCG_STORAGE_LOCAL_PATH
	string "Local path to go-tcg-storage"
	default "../go-tcg-storage"
	depends on TCG_STORAGE_USE_LOCAL
	help
	  Path to the local go-tcg-storage directory.
	  This path is relative to the kdevops root directory.

config TCG_STORAGE_TEST_DEVICE
	string "Device to use for TCG storage testing"
	default "/dev/nvme0n1"
	help
	  The block device to use for TCG storage testing.
	  WARNING: This device should be a test device as tests may
	  modify TCG/OPAL settings on the device.

	  For declared hosts (bare metal), you can override this at
	  make time with: TCG_DEVICE=/dev/nvme0n1
	  Common values:
	  - /dev/nvme0n1 for NVMe devices
	  - /dev/sda for SATA devices
	  - /dev/sg0 for SAS devices

config TCG_STORAGE_TEST_DEVICE_TYPE
	string "Type of storage device"
	default "nvme"
	help
	  Type of the storage device being tested.
	  Valid options: nvme, sata, sas

config TCG_STORAGE_TEST_PASSWORD
	string "Password for TCG operations"
	default "testpassword123"
	help
	  Password to use for TCG/OPAL operations during testing.
	  This password will be used for taking ownership and
	  authentication during tests.

config TCG_STORAGE_RUN_UNIT_TESTS
	bool "Run go-tcg-storage unit tests"
	default y
	help
	  Run the unit tests included with go-tcg-storage.
	  These tests verify the library functionality.

config TCG_STORAGE_RUN_INTEGRATION_TESTS
	bool "Run integration tests on test device"
	default n
	help
	  Run integration tests that interact with actual TCG/OPAL devices.
	  WARNING: These tests will modify the TCG state of the test device.
	  Only enable this if you have a dedicated test device.

config TCG_STORAGE_TEST_TAKE_OWNERSHIP
	bool "Test taking ownership of device"
	default n
	depends on TCG_STORAGE_RUN_INTEGRATION_TESTS
	help
	  Test taking ownership of the TCG device.
	  This will set the Admin1 password on the device.

config TCG_STORAGE_TEST_LOCKING_RANGES
	bool "Test locking range operations"
	default n
	depends on TCG_STORAGE_RUN_INTEGRATION_TESTS
	help
	  Test creating, modifying, and deleting locking ranges.
	  This will test the locking functionality of the device.

config TCG_STORAGE_TEST_REVERT
	bool "Test device revert operations"
	default n
	depends on TCG_STORAGE_RUN_INTEGRATION_TESTS
	help
	  Test reverting the device to factory defaults.
	  WARNING: This will erase all TCG configuration on the device.


config TCG_STORAGE_WATCHDOG
	bool "Enable kdevops tcg-storage watchdog"
	default y if HAVE_DISTRO_PREFERS_TCG_STORAGE_WATCHDOG
	default n if !HAVE_DISTRO_PREFERS_TCG_STORAGE_WATCHDOG
	depends on KERNEL_CI
	help
	  Enable the TCG storage watchdog which monitors test progress
	  and can detect hung tests.

if TCG_STORAGE_WATCHDOG

config TCG_STORAGE_WATCHDOG_CHECK_TIME
	int "How often to check test status in seconds"
	default 5
	help
	  How often to trigger the TCG storage watchdog check, in seconds.

config TCG_STORAGE_WATCHDOG_MAX_TEST_TIME
	int "Max minutes to wait for a test before assuming a hang"
	default 30
	help
	  Maximum time in minutes to wait for a test to complete
	  before assuming it is hung.

config TCG_STORAGE_WATCHDOG_KILL_HUNG_TEST
	bool "Kill hung tests"
	default y if HAVE_DISTRO_PREFERS_TCG_STORAGE_WATCHDOG_KILL
	default n if !HAVE_DISTRO_PREFERS_TCG_STORAGE_WATCHDOG_KILL
	help
	  If enabled, the watchdog will kill tests that appear to be hung.

config TCG_STORAGE_WATCHDOG_RESET_HUNG_TEST_SYSTEM
	bool "Reset system with hung tests"
	default y if HAVE_DISTRO_PREFERS_TCG_STORAGE_WATCHDOG_RESET
	default n if !HAVE_DISTRO_PREFERS_TCG_STORAGE_WATCHDOG_RESET
	help
	  If enabled, the watchdog will reset systems that have hung tests.
	  This is useful for automated testing but should be used with caution.

endif # TCG_STORAGE_WATCHDOG

config TCG_STORAGE_RESULTS_DIR
	string "Directory for test results"
	default "workflows/tcg-storage/results"
	help
	  Directory where test results will be stored.
	  Results include test output, logs, and device information.

config TCG_STORAGE_BASELINE
	bool "Establish baseline for TCG storage tests"
	default n
	help
	  Run tests to establish a baseline for TCG storage functionality.
	  This baseline can be used to compare against future test runs.

config TCG_STORAGE_BASELINE_AND_DEV
	bool "Enable A/B testing for TCG storage"
	default n
	help
	  Enable A/B testing mode where tests are run on both baseline
	  and development systems to compare results.

endif # KDEVOPS_WORKFLOW_ENABLE_TCG_STORAGE
```
