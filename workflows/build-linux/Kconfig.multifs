## workflows/fio-tests/Kconfig.btrfs
```kconfig
if FIO_TESTS_FS_BTRFS

choice
	prompt "Btrfs filesystem configuration to use"
	default FIO_TESTS_FS_BTRFS_NOHOFSPACE

config FIO_TESTS_FS_BTRFS_NOHOFSPACE
	bool "btrfs no-holes + free-space-tree"
	select FIO_TESTS_BTRFS_SECTION_NOHOFSPACE
	output yaml
	help
	  Btrfs with both the no-holes and free space tree features enabled.
	  This is the default modern configuration.

config FIO_TESTS_FS_BTRFS_NOHOFSPACE_ZSTD
	bool "btrfs no-holes + free-space-tree + zstd compression"
	select FIO_TESTS_BTRFS_SECTION_NOHOFSPACE_ZSTD
	output yaml
	help
	  Btrfs with no-holes, free space tree, and zstd compression enabled.

config FIO_TESTS_FS_BTRFS_FSPACE
	bool "btrfs free-space-tree only"
	select FIO_TESTS_BTRFS_SECTION_FSPACE
	output yaml
	help
	  Btrfs with free space tree enabled but no-holes disabled.

config FIO_TESTS_FS_BTRFS_SIMPLE
	bool "btrfs simple profile"
	select FIO_TESTS_BTRFS_SECTION_SIMPLE
	output yaml
	help
	  Btrfs with simple profile for data and metadata.
	  This profile is used to help ensure compatibility.

endchoice

config FIO_TESTS_BTRFS_SECTION_NOHOFSPACE
	bool

config FIO_TESTS_BTRFS_SECTION_NOHOFSPACE_CMD
	string
	depends on FIO_TESTS_BTRFS_SECTION_NOHOFSPACE
	default "-f -O no-holes,free-space-tree"

config FIO_TESTS_BTRFS_SECTION_NOHOFSPACE_ZSTD
	bool

config FIO_TESTS_BTRFS_SECTION_NOHOFSPACE_ZSTD_CMD
	string
	depends on FIO_TESTS_BTRFS_SECTION_NOHOFSPACE_ZSTD
	default "-f -O no-holes,free-space-tree"

config FIO_TESTS_BTRFS_SECTION_FSPACE
	bool

config FIO_TESTS_BTRFS_SECTION_FSPACE_CMD
	string
	depends on FIO_TESTS_BTRFS_SECTION_FSPACE
	default "-f -O free-space-tree"

config FIO_TESTS_BTRFS_SECTION_SIMPLE
	bool

config FIO_TESTS_BTRFS_SECTION_SIMPLE_CMD
	string
	depends on FIO_TESTS_BTRFS_SECTION_SIMPLE
	default "-f"

config FIO_TESTS_BTRFS_CMD
	string
	output yaml
	default FIO_TESTS_BTRFS_SECTION_NOHOFSPACE_CMD if FIO_TESTS_FS_BTRFS_NOHOFSPACE
	default FIO_TESTS_BTRFS_SECTION_NOHOFSPACE_ZSTD_CMD if FIO_TESTS_FS_BTRFS_NOHOFSPACE_ZSTD
	default FIO_TESTS_BTRFS_SECTION_FSPACE_CMD if FIO_TESTS_FS_BTRFS_FSPACE
	default FIO_TESTS_BTRFS_SECTION_SIMPLE_CMD if FIO_TESTS_FS_BTRFS_SIMPLE

config FIO_TESTS_BTRFS_MOUNT_OPTS
	string
	output yaml
	default "compress=zstd" if FIO_TESTS_FS_BTRFS_NOHOFSPACE_ZSTD
	default "defaults"
	help
	  Mount options for btrfs filesystem.

endif # FIO_TESTS_FS_BTRFS
```

## workflows/fio-tests/Kconfig.ext4
```kconfig
if FIO_TESTS_FS_EXT4

choice
	prompt "ext4 filesystem configuration to use"
	default FIO_TESTS_FS_EXT4_4K_4KS

config FIO_TESTS_FS_EXT4_4K_4KS
	bool "ext4 4k -  4k sector size"
	select FIO_TESTS_EXT4_SECTOR_SIZE_4K
	select FIO_TESTS_EXT4_SECTION_4K
	output yaml
	help
	  ext4 4k FSB with 4k sector size.

config FIO_TESTS_FS_EXT4_4K_4KS_BIGALLOC_16K
	bool "ext4 4k block size bigalloc 16k cluster sizes -  4k sector size"
	select FIO_TESTS_EXT4_SECTOR_SIZE_4K
	select FIO_TESTS_EXT4_SECTION_4K_BIGALLOC_16K
	output yaml
	help
	  ext4 4 KiB FSB with 4 KiB sector size, 16 KiB cluster sizes.

config FIO_TESTS_FS_EXT4_4K_4KS_BIGALLOC_32K
	bool "ext4 4k block size bigalloc 32k cluster sizes -  4k sector size"
	select FIO_TESTS_EXT4_SECTOR_SIZE_4K
	select FIO_TESTS_EXT4_SECTION_4K_BIGALLOC_32K
	output yaml
	help
	  ext4 4 KiB FSB with 4 KiB sector size, 32 KiB cluster sizes.

config FIO_TESTS_FS_EXT4_4K_4KS_BIGALLOC_64K
	bool "ext4 4k block size bigalloc 64k cluster sizes -  4k sector size"
	select FIO_TESTS_EXT4_SECTOR_SIZE_4K
	select FIO_TESTS_EXT4_SECTION_4K_BIGALLOC_64K
	output yaml
	help
	  ext4 4 KiB FSB with 4 KiB sector size, 64 KiB cluster sizes.

endchoice

choice
    prompt "EXT4 filesystem sector size to use"
    default FIO_TESTS_EXT4_SECTOR_SIZE_4K

config FIO_TESTS_EXT4_SECTOR_SIZE_512
	bool "512 bytes"
	output yaml
	depends on EXTRA_STORAGE_SUPPORTS_512
	help
	  Use 512 byte sector size.

config FIO_TESTS_EXT4_SECTOR_SIZE_4K
	bool "4 KiB"
	output yaml
	depends on EXTRA_STORAGE_SUPPORTS_4K
	help
	  Use 4 KiB sector size.

endchoice

config FIO_TESTS_EXT4_SECTOR_SIZE
	string
	output yaml
	default "512" if FIO_TESTS_EXT4_SECTOR_SIZE_512
	default "4k"  if FIO_TESTS_EXT4_SECTOR_SIZE_4K

config FIO_TESTS_EXT4_SECTION_4K
	bool

config FIO_TESTS_EXT4_SECTION_4K_CMD
	string
	depends on FIO_TESTS_EXT4_SECTION_4K
	default "-F -b 4k"

config FIO_TESTS_EXT4_SECTION_4K_BIGALLOC_16K
	bool

config FIO_TESTS_EXT4_SECTION_4K_BIGALLOC_16K_CMD
	string
	depends on FIO_TESTS_EXT4_SECTION_4K_BIGALLOC_16K
	default "-F -b 4k -O bigalloc -C 16k"

config FIO_TESTS_EXT4_SECTION_4K_BIGALLOC_32K
	bool

config FIO_TESTS_EXT4_SECTION_4K_BIGALLOC_32K_CMD
	string
	depends on FIO_TESTS_EXT4_SECTION_4K_BIGALLOC_32K
	default "-F -b 4k -O bigalloc -C 32k"

config FIO_TESTS_EXT4_SECTION_4K_BIGALLOC_64K
	bool

config FIO_TESTS_EXT4_SECTION_4K_BIGALLOC_64K_CMD
	string
	depends on FIO_TESTS_EXT4_SECTION_4K_BIGALLOC_64K
	default "-F -b 4k -O bigalloc -C 64k"

config FIO_TESTS_EXT4_CMD
	string
	output yaml
	default FIO_TESTS_EXT4_SECTION_4K_CMD if FIO_TESTS_FS_EXT4_4K_4KS
	default FIO_TESTS_EXT4_SECTION_4K_BIGALLOC_16K_CMD if FIO_TESTS_FS_EXT4_4K_4KS_BIGALLOC_16K
	default FIO_TESTS_EXT4_SECTION_4K_BIGALLOC_32K_CMD if FIO_TESTS_FS_EXT4_4K_4KS_BIGALLOC_32K
	default FIO_TESTS_EXT4_SECTION_4K_BIGALLOC_64K_CMD if FIO_TESTS_FS_EXT4_4K_4KS_BIGALLOC_64K

config FIO_TESTS_EXT4_MOUNT_OPTS
	string
	output yaml
	default "defaults"
	help
	  Mount options for ext4 filesystem.

endif # FIO_TESTS_FS_EXT4
```

## workflows/fio-tests/Kconfig.xfs
```kconfig
if FIO_TESTS_FS_XFS

choice
	prompt "XFS filesystem configuration to use"
	default FIO_TESTS_FS_XFS_4K_4KS

config FIO_TESTS_FS_XFS_4K_4KS
	bool "XFS 4k LBS - 4k sector size"
	select FIO_TESTS_XFS_SECTOR_SIZE_4K
	select FIO_TESTS_XFS_SECTION_REFLINK_4K
	output yaml
	help
	  XFS with 4k FSB with 4k sector size.

config FIO_TESTS_FS_XFS_8K_4KS
	bool "XFS 8k LBS - 4k sector size"
	select FIO_TESTS_XFS_SECTOR_SIZE_4K
	select FIO_TESTS_XFS_SECTION_REFLINK_8K
	output yaml
	help
	  XFS with 8k FSB with 4k sector size.

config FIO_TESTS_FS_XFS_16K_4KS
	bool "XFS 16k LBS - 4k sector size"
	select FIO_TESTS_XFS_SECTOR_SIZE_4K
	select FIO_TESTS_XFS_SECTION_REFLINK_16K
	output yaml
	help
	  XFS with 16k FSB with 4k sector size.

config FIO_TESTS_FS_XFS_32K_4KS
	bool "XFS 32k LBS - 4k sector size"
	select FIO_TESTS_XFS_SECTOR_SIZE_4K
	select FIO_TESTS_XFS_SECTION_REFLINK_32K
	output yaml
	help
	  XFS with 32k FSB with 4k sector size.

config FIO_TESTS_FS_XFS_64K_4KS
	bool "XFS 64k LBS - 4k sector size"
	select FIO_TESTS_XFS_SECTOR_SIZE_4K
	select FIO_TESTS_XFS_SECTION_REFLINK_64K
	output yaml
	help
	  XFS with 64k FSB with 4k sector size.

config FIO_TESTS_FS_XFS_16K_16KS
	bool "XFS 16k LBS - 16k sector size"
	select FIO_TESTS_XFS_SECTOR_SIZE_16K
	select FIO_TESTS_XFS_SECTION_REFLINK_16K
	output yaml
	help
	  XFS with 16k FSB with 16k sector size.

config FIO_TESTS_FS_XFS_32K_16KS
	bool "XFS 32k LBS - 16k sector size"
	select FIO_TESTS_XFS_SECTOR_SIZE_16K
	select FIO_TESTS_XFS_SECTION_REFLINK_32K
	output yaml
	help
	  XFS with 32k FSB with 16k sector size.

config FIO_TESTS_FS_XFS_64K_16KS
	bool "XFS 64k LBS - 16k sector size"
	select FIO_TESTS_XFS_SECTOR_SIZE_16K
	select FIO_TESTS_XFS_SECTION_REFLINK_64K
	output yaml
	help
	  XFS with 64k FSB with 16k sector size.

endchoice

choice
	prompt "XFS filesystem sector size to use"
	default FIO_TESTS_XFS_SECTOR_SIZE_4K

config FIO_TESTS_XFS_SECTOR_SIZE_512
	bool "512 bytes"
	output yaml
	depends on EXTRA_STORAGE_SUPPORTS_512
	help
	  Use 512 byte sector size.

config FIO_TESTS_XFS_SECTOR_SIZE_4K
	bool "4 KiB"
	output yaml
	depends on EXTRA_STORAGE_SUPPORTS_4K
	help
	  Use 4 KiB sector size.

config FIO_TESTS_XFS_SECTOR_SIZE_16K
	bool "16 KiB"
	output yaml
	depends on EXTRA_STORAGE_SUPPORTS_LARGEIO
	help
	  Use 16 KiB sector size.

config FIO_TESTS_XFS_SECTOR_SIZE_32K
	bool "32 KiB"
	output yaml
	depends on EXTRA_STORAGE_SUPPORTS_LARGEIO
	help
	  Use 32 KiB sector size.

endchoice

config FIO_TESTS_XFS_SECTOR_SIZE
	string
	output yaml
	default "512" if FIO_TESTS_XFS_SECTOR_SIZE_512
	default "4k"  if FIO_TESTS_XFS_SECTOR_SIZE_4K
	default "16k" if FIO_TESTS_XFS_SECTOR_SIZE_16K
	default "32k" if FIO_TESTS_XFS_SECTOR_SIZE_32K

config FIO_TESTS_XFS_SECTION_REFLINK_4K
	bool

config FIO_TESTS_XFS_SECTION_REFLINK_4K_CMD
	string
	depends on FIO_TESTS_XFS_SECTION_REFLINK_4K
	default "-f -m reflink=1,rmapbt=1, -i sparse=1 -b size=4k"

config FIO_TESTS_XFS_SECTION_REFLINK_8K
	bool

config FIO_TESTS_XFS_SECTION_REFLINK_8K_CMD
	string
	depends on FIO_TESTS_XFS_SECTION_REFLINK_8K
	default "-f -m reflink=1,rmapbt=1 -i sparse=1 -b size=8k"

config FIO_TESTS_XFS_SECTION_REFLINK_16K
	bool

config FIO_TESTS_XFS_SECTION_REFLINK_16K_CMD
	string
	depends on FIO_TESTS_XFS_SECTION_REFLINK_16K
	default "-f -m reflink=1,rmapbt=1 -i sparse=1 -b size=16k"

config FIO_TESTS_XFS_SECTION_REFLINK_32K
	bool

config FIO_TESTS_XFS_SECTION_REFLINK_32K_CMD
	string
	depends on FIO_TESTS_XFS_SECTION_REFLINK_32K
	default "-f -m reflink=1,rmapbt=1 -i sparse=1 -b size=32k"

config FIO_TESTS_XFS_SECTION_REFLINK_64K
	bool

config FIO_TESTS_XFS_SECTION_REFLINK_64K_CMD
	string
	depends on FIO_TESTS_XFS_SECTION_REFLINK_64K
	default "-f -m reflink=1,rmapbt=1 -i sparse=1 -b size=64k"

config FIO_TESTS_XFS_CMD
	string
	default FIO_TESTS_XFS_SECTION_REFLINK_4K_CMD if FIO_TESTS_FS_XFS_4K_4KS
	default FIO_TESTS_XFS_SECTION_REFLINK_8K_CMD if FIO_TESTS_XFS_SECTION_REFLINK_8K
	default FIO_TESTS_XFS_SECTION_REFLINK_16K_CMD if FIO_TESTS_XFS_SECTION_REFLINK_16K
	default FIO_TESTS_XFS_SECTION_REFLINK_32K_CMD if FIO_TESTS_XFS_SECTION_REFLINK_32K
	default FIO_TESTS_XFS_SECTION_REFLINK_64K_CMD if FIO_TESTS_XFS_SECTION_REFLINK_64K

config FIO_TESTS_XFS_MOUNT_OPTS
	string
	output yaml
	default "defaults"
	help
	  Mount options for XFS filesystem.

endif # FIO_TESTS_FS_XFS
```

## workflows/fio_tests/Kconfig
```kconfig
menu "fio-tests simple workflows"

config FIO_TESTS_DEVICE
    string "Device or file to use"
    output yaml
    default "/dev/null"

config FIO_TEST_BASIC
    bool "Basic tests"
    output yaml

config FIO_TEST_IOBATCH
    bool "IO depth batch tests"
    output yaml

config FIO_TEST_MAX_IOBATCH_SINGLE
    bool "Max iodepth batch single job tests"
    output yaml

config FIO_TEST_MAX_IOBATCH_JOBS
    bool "Max iodepth batch jobs tests"
    output yaml

config FIO_TEST_SNIA
    bool "SNIA interpretation tests"
    output yaml

endmenu
```

## workflows/fstests/cifs/Kconfig
```kconfig
config FSTESTS_USE_KDEVOPS_SMBD
	bool "Test against the kdevops SMB server"
	select KDEVOPS_SETUP_SMBD
	default y
	help
	  Do you want to test against Linux smbd as deployed by kdevops?
	  If so, select this option. If you want to test against another
	  (already-deployed and reachable) server, disable this and specify
	  the location.

config FSTESTS_SMB_SERVER_HOST
	string "Test Server hostname"
	default ""
	depends on !FSTESTS_USE_KDEVOPS_SMBD
	help
	  The SMB server hostname or address to test against. Note that
	  the clients will expect that an appropriate hierarchy is already
	  created for them to mount and use.
	  FIXME: document how to make that.

# Distributions actively maintaining CIFS support should select this and then
# be careful to select any of the other HAVE_DISTRO_SMB_* below so that
# testers can know what to test for.
config HAVE_DISTRO_CIFS_PREFERS_MANUAL
	bool
	default n

config FSTESTS_CIFS_MANUAL_COVERAGE
	bool "Enable manual coverage selection"
	default y if HAVE_DISTRO_CIFS_PREFERS_MANUAL
	default n if !HAVE_DISTRO_CIFS_PREFERS_MANUAL
	help
	  By default we aim to spawn enough hosts to cover testing the full
	  range of supported features upstream on the Linux kernel for SMB,
	  and for you to also be able to do development on each section
	  concurrently. Distributions however may override sensible defaults
	  and only support certain features. Enabling this option lets you
	  select and test only specific configurations.

	  By default we enables all tests, but certain distributions may
	  disable certain features and as such don't need to run certain
	  type of tests.

	  You can enable this to allow you to override the default test
	  coverage.

if FSTESTS_CIFS_MANUAL_COVERAGE

config FSTESTS_CIFS_SECTION_SMB3
	bool "Enable testing section: smb3"
	default y
	help
	  Enabling this will test SMB3.

config FSTESTS_CIFS_SECTION_SMB3_SEAL
	bool "Enable testing section: smb3_seal"
	default n
	help
	  Enabling this will test SMB3 with encryption.

config FSTESTS_CIFS_SECTION_SMB3_SIGN
	bool "Enable testing section: smb3_sign"
	default n
	help
	  Enabling this will test SMB3 with signing.

endif # FSTESTS_CIFS_MANUAL_COVERAGE

if !FSTESTS_CIFS_MANUAL_COVERAGE

config FSTESTS_CIFS_SECTION_SMB3
	bool
	default y

config FSTESTS_CIFS_SECTION_SMB3_SEAL
	bool
	default n

config FSTESTS_CIFS_SECTION_SMB3_SIGN
	bool
	default n

endif # !FSTESTS_CIFS_MANUAL_COVERAGE
```
