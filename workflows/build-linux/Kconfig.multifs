## workflows/fstests/ext4/Kconfig
```kconfig
# Distributions actively maintaining btrfs support should select this and then
# be careful to select any of the other HAVE_DISTRO_BTRFS_* below so that
# testers can know what to test for.
config HAVE_DISTRO_EXT4_PREFERS_MANUAL
	bool
	default n

config FSTESTS_EXT4_MANUAL_COVERAGE
	bool "Enable manual coverage selection"
	default y if HAVE_DISTRO_EXT4_PREFERS_MANUAL
	default n if !HAVE_DISTRO_EXT4_PREFERS_MANUAL
	help
	  By default we aim to spawn enough hosts to cover testing the full
	  range of supported features upstream on the Linux kernel for ext4,
	  and for you to also be able to do development on each section
	  concurrently. Distributions however may override sensible defaults
	  and only support certain features. Enabling this option lets you
	  select and test only specific configurations.

	  By default we enables all tests, but certain distributions may
	  disable certain features and as such don't need to run certain
	  type of tests.

	  You can enable this to allow you to override the default test
	  coverage.

if FSTESTS_EXT4_MANUAL_COVERAGE

config FSTESTS_EXT4_SECTION_DEFAULTS
	bool "Enable testing section: ext4_defaults"
	help
	  Enabling this will test ext4 with the default options for the mkfs.ext4
	  to create the filesystem.

config FSTESTS_EXT4_SECTION_1K
	bool "Enable testing section: ext4_1k"
	help
	  Enabling this will test ext4 with the default options for the mkfs.ext4
	  to create the filesystem but with 1k block size.

config FSTESTS_EXT4_SECTION_2K
	bool "Enable testing section: ext4_2k"
	help
	  Enabling this will test ext4 with the default options for the mkfs.ext4
	  to create the filesystem but with 1k block size.

config FSTESTS_EXT4_SECTION_4K
	bool "Enable testing section: ext4_4k"
	help
	  Enabling this will test ext4 with the default options for the mkfs.ext4
	  to create the filesystem but with 1k block size.

config FSTESTS_EXT4_SECTION_BIGALLOC16K_4K
	bool "Enable testing section: ext4_bigalloc16k_4k"
	help
	  Enabling this will test ext4 with the default options for the mkfs.ext4
	  to create the filesystem but with 4k block size using the bigalloc
	  feature for 16k cluster sizes.

config FSTESTS_EXT4_SECTION_BIGALLOC32K_4K
	bool "Enable testing section: ext4_bigalloc32k_4k"
	help
	  Enabling this will test ext4 with the default options for the mkfs.ext4
	  to create the filesystem but with 4k block size using the bigalloc
	  feature for 32k cluster sizes.

config FSTESTS_EXT4_SECTION_BIGALLOC64K_4K
	bool "Enable testing section: ext4_bigalloc64k_4k"
	help
	  Enabling this will test ext4 with the default options for the mkfs.ext4
	  to create the filesystem but with 4k block size using the bigalloc
	  feature for 64k cluster sizes.

config FSTESTS_EXT4_SECTION_BIGALLOC1024K_4K
	bool "Enable testing section: ext4_bigalloc1024k_4k"
	help
	  Enabling this will test ext4 with the default options for the mkfs.ext4
	  to create the filesystem but with 4k block size using the bigalloc
	  feature for 1M cluster sizes.

config FSTESTS_EXT4_SECTION_BIGALLOC2048K_4K
	bool "Enable testing section: ext4_bigalloc2048k_4k"
	help
	  Enabling this will test ext4 with the default options for the mkfs.ext4
	  to create the filesystem but with 4k block size using the bigalloc
	  feature for 2M cluster sizes.

config FSTESTS_EXT4_SECTION_ADVANCED_FEATURES
	bool "Enable testing section: ext4_advanced_features"
	help
	  Enabling this will test ext4 with the advanced features enabled.
	  This enables a host which will use the following configuration:

	      [ext4_advanced_features]
	      MKFS_OPTIONS="-I 256 -O inline_data,metadata_csum,64bit"
	      FSTYP=ext4

endif # FSTESTS_EXT4_MANUAL_COVERAGE

if !FSTESTS_EXT4_MANUAL_COVERAGE

config FSTESTS_EXT4_SECTION_DEFAULTS
	bool
	default y

config FSTESTS_EXT4_SECTION_ADVANCED_FEATURES
	bool
	default y

endif # !FSTESTS_EXT4_MANUAL_COVERAGE
```

## workflows/gitr/Kconfig
```kconfig
if KDEVOPS_WORKFLOW_ENABLE_GITR

choice
	prompt "The target file system type to be tested"
	default GITR_BTRFS

config GITR_XFS
	bool "xfs"
	help
	  Run the git regression suite on an xfs file system.

config GITR_BTRFS
	bool "btrfs"
	help
	  Run the git regression suite on a btrfs file system.

config GITR_EXT4
	bool "ext4"
	help
	  Run the git regression suite on an ext4 file system.

config GITR_NFS
	bool "nfs"
	help
	  Run the git regression suite on an NFS mount.

config GITR_TMPFS
	bool "tmpfs"
	help
	  Run the git regression suite on a tmpfs file system.

endchoice

if GITR_XFS
menu "Configure how to test XFS"
source "workflows/gitr/xfs/Kconfig"
endmenu
endif # GITR_XFS

if GITR_BTRFS
menu "Configure how to test btrfs"
source "workflows/gitr/btrfs/Kconfig"
endmenu
endif # GITR_BTRFS

if GITR_EXT4
menu "Configure how to test ext4"
source "workflows/gitr/ext4/Kconfig"
endmenu
endif # GITR_EXT4

if GITR_NFS
menu "Configure how nfs should be tested"
source "workflows/gitr/nfs/Kconfig"
endmenu
endif # GITR_NFS

if GITR_TMPFS
menu "Configure how tmpfs should be tested"
source "workflows/gitr/tmpfs/Kconfig"
endmenu
endif # GITR_TMPFS

config GITR_MNT
	string "Where to mount the file system under test"
	default "/media/git"
	help
	  The directory over which to mount the file system under test.

config HAVE_MIRROR_GIT
	bool
	depends on USE_LIBVIRT_MIRROR
	default $(shell, scripts/check_mirror_present.sh /mirror/git.git)

config GITR_REPO
	string "The git tool repository to clone"
	default DEFAULT_GIT_URL if !HAVE_MIRROR_GIT
	default $(shell, scripts/append-makefile-vars.sh git:// $(KDEVOPS_DEFAULT_BRIDGE_IP_VAGRANT) /mirror/git.git) if HAVE_MIRROR_GIT && VAGRANT
	default $(shell, scripts/append-makefile-vars.sh git:// $(KDEVOPS_DEFAULT_BRIDGE_IP_GUESTFS) /mirror/git.git) if HAVE_MIRROR_GIT && GUESTFS
        help
	  The git tool repository to clone.

config GITR_REPO_COMMIT
	string "The version of git to check out"
	default "v2.46.0"
	help
	  The commit to be used for the test.

if KDEVOPS_WORKFLOW_DEDICATE_GITR

config GITR_ALL_TESTS
	bool "Run all available git regression tests"
	default y
	help
	  Say Y here if you simply want to run the full git
	  regression suite. This is the default.

	  If you would like to run only specific individual tests,
	  say N here, and fill in the GITR_TEST_LIST option below.

config GITR_TEST_LIST
	string "List of regression tests to run"
	default ""
	depends on !GITR_ALL_TESTS
	help
	  This option specifies a blank-separated list of specific
	  individual regression tests that can be run with "make
	  gitr-baseline" and its brethren targets.

	  You can find a list of scripts that can be run in the t/
	  directory of the git repo.

choice
	prompt "The number of test threads"
	default GITR_THREAD_FAST

config GITR_THREAD_SINGLE
	bool "single"
	help
	  Run the test in single-threaded mode. This makes the test
	  take a while, but is the most reliable way to run the
	  test suite. What's more, single-threading makes it easier
	  to sort the results and any failures. 

config GITR_THREAD_FAST
	bool "fast"
	help
	  Run the test with as many threads as there are CPUs on
	  the target node. This gets through the testing faster
	  than the single-thread test. This is the default.

config GITR_THREAD_STRESS
	bool "stress"
	help
	  Run the test with as twice as many threads as there are
	  CPUs on the target node. This is recommended in t/README
	  to stress the tool and underlying file system.

config GITR_THREAD_CUSTOM
	bool "custom"
	help
	  Run the test with a specific number of threads.

endchoice

if GITR_THREAD_CUSTOM
config GITR_THREAD_CUSTOM_COUNT
	int "Test thread count"
	default 8
	help
	  Run the test with the number of threads specified by this
	  option.
endif # GITR_THREAD_CUSTOM

endif # KDEVOPS_WORKFLOW_DEDICATE_GITR

endif # KDEVOPS_WORKFLOW_ENABLE_GITR
```

## workflows/gitr/tmpfs/Kconfig
```kconfig
# SPDX-License-Identifier: copyleft-next-0.3.1
config GITR_TMPFS_MOUNT_OPTS
	string "The file system mount options to use"
	default "size=75%"
	help
	  The mount options to use when mounting the file system under test.
```

## workflows/knlp/Kconfig
```kconfig
config WORKFLOW_KNLP
	bool "Enable the knlp ML research workflow"
	default y if KDEVOPS_WORKFLOW_ENABLE_KNLP
	default n
	output yaml
	help
	  This enables the knlp (Kernel Natural Language Processing) workflow.
	  knlp is a collaborative transformer architecture research project that
	  applies Linux kernel development methodologies to machine learning
	  experimentation and reproducibility.

	  The project demonstrates how kernel development best practices -
	  Kconfig-driven configuration, defconfig presets, Makefile-based builds,
	  and rigorous testing - can improve ML research workflows with better
	  reproducibility, configuration management, and systematic testing.

	  The workflow will clone the knlp repository from GitHub and install
	  all required Python dependencies.

	  Repository: https://github.com/mcgrof/knlp

if WORKFLOW_KNLP

menu "knlp ML research workflow configuration"

config WORKFLOW_KNLP_GIT_URL
	string "knlp git repository URL"
	default "https://github.com/mcgrof/knlp.git"
	output yaml
	help
	  The git repository URL for knlp. You can override this if you
	  want to use a fork or a local mirror.

config WORKFLOW_KNLP_GIT_REF
	string "knlp git reference (branch, tag, or commit)"
	default "main"
	output yaml
	help
	  The git reference to checkout. This can be a branch name, tag,
	  or commit SHA. Default is 'main'.

config WORKFLOW_KNLP_DATA_PATH
	string "Path to install knlp"
	default "/data/knlp"
	output yaml
	help
	  The directory where knlp will be cloned and installed.
	  This should have sufficient space for the repository and
	  any models or data it downloads.

endmenu # knlp AI workflow configuration

endif # WORKFLOW_KNLP
```
