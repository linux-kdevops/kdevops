## workflows/linux/Kconfig.btrfs
```kconfig
if BOOTLINUX_TREE_BTRFS_DEVEL

source "workflows/linux/refs/default/Kconfig.btrfs-devel"
source "workflows/linux/refs/user/Kconfig.btrfs-devel"

config BOOTLINUX_TREE_BTRFS_DEVEL_NAME
	string
	default "btrfs-devel"

config BOOTLINUX_TREE_BTRFS_TREE_URL
	string
	default "https://github.com/kdave/btrfs-devel.git" if BOOTLINUX_TREE_BTRFS_DEVEL

endif # BOOTLINUX_TREE_BTRFS_DEVEL
```

## workflows/linux/Kconfig.cel
```kconfig
if BOOTLINUX_TREE_CEL_LINUX

choice
	prompt "cel-linux branch to use"
	default BOOTLINUX_TREE_CEL_LINUX_NEXT

config BOOTLINUX_TREE_CEL_LINUX_NEXT
	bool "nfsd-next"
	help
	  Pull the nfsd-next branch.

config BOOTLINUX_TREE_CEL_LINUX_FIXES
	bool "nfsd-fixes"
	help
	  Pull the nfsd-fixes branch.

config BOOTLINUX_TREE_CEL_LINUX_CUSTOM
	bool "Custom branch name"
	help
	  Pull a custom branch name.

endchoice

config BOOTLINUX_TREE_CEL_LINUX_CUSTOM_NAME
	string "Custom branch name"
	default "custom"
	depends on BOOTLINUX_TREE_CEL_LINUX_REF_CUSTOM
	help
	  Custom branch name to use for Chuck Lever's linux tree.

config BOOTLINUX_TREE_CEL_LINUX_REF
	string
	default "nfsd-next" if BOOTLINUX_TREE_CEL_LINUX_NEXT
	default "nfsd-fixes" if BOOTLINUX_TREE_CEL_LINUX_FIXES
	default BOOTLINUX_TREE_CEL_LINUX_CUSTOM_NAME if BOOTLINUX_TREE_CEL_LINUX_CUSTOM

config BOOTLINUX_TREE_CEL_LINUX_NAME
	string
	default "cel-linux"

config BOOTLINUX_TREE_CEL_LINUX_URL
	string
	default "https://git.kernel.org/pub/scm/linux/kernel/git/cel/linux.git" if BOOTLINUX_TREE_CEL_LINUX

endif # BOOTLINUX_TREE_CEL_LINUX
```

## workflows/linux/Kconfig.fragments
```kconfig
config BOOTLINUX_USE_CONFIG_FRAGMENTS
	bool "Use kernel configuration fragments"
	output yaml
	help
	  Enable this to build the kernel using configuration fragments
	  instead of a monolithic configuration file. This allows you to
	  compose kernel configurations from smaller, focused fragments.

	  When enabled, the kernel configuration will be built using
	  merge_config.sh with selected fragments from both upstream
	  kernel sources and kdevops templates.

if BOOTLINUX_USE_CONFIG_FRAGMENTS

source "workflows/linux/fragments/Kconfig.essential"
source "workflows/linux/fragments/Kconfig.security"
source "workflows/linux/fragments/Kconfig.arch"
source "workflows/linux/fragments/Kconfig.development"
source "workflows/linux/fragments/Kconfig.memory"
source "workflows/linux/fragments/Kconfig.modules"
source "workflows/linux/fragments/Kconfig.advanced"
source "workflows/linux/fragments/Kconfig.container"
source "workflows/linux/fragments/Kconfig.specialized"
source "workflows/linux/fragments/Kconfig.legacy"

endif # BOOTLINUX_USE_CONFIG_FRAGMENTS
```

## workflows/linux/Kconfig.jlayton
```kconfig
if BOOTLINUX_TREE_JLAYTON_LINUX

source "workflows/linux/refs/default/Kconfig.jlayton-linux"
source "workflows/linux/refs/user/Kconfig.jlayton-linux"

config BOOTLINUX_TREE_JLAYTON_LINUX_CUSTOM_NAME
	string "Custom branch name"
	default "kdevops"
	depends on BOOTLINUX_TREE_JLAYTON_LINUX_REF_CUSTOM
	help
	  Custom branch name to use for Jeff Layton's linux tree.

config BOOTLINUX_TREE_JLAYTON_LINUX_NAME
	string
	default "jlayton-linux"

config BOOTLINUX_TREE_JLAYTON_LINUX_URL
	string
	default "git://git.kernel.org/pub/scm/linux/kernel/git/jlayton/linux.git" if BOOTLINUX_TREE_JLAYTON_LINUX

endif # BOOTLINUX_TREE_JLAYTON_LINUX
```

## workflows/linux/Kconfig.kdevops
```kconfig
if BOOTLINUX_TREE_KDEVOPS_LINUS

source "workflows/linux/refs/default/Kconfig.kdevops-linus"
source "workflows/linux/refs/user/Kconfig.kdevops-linus"

config BOOTLINUX_TREE_KDEVOPS_URL
	string
	default "https://github.com/linux-kdevops/linux.git" if !USE_LOCAL_LINUX_MIRROR
	default "/mirror/kdevops-linus.git" if USE_LIBVIRT_MIRROR && BOOTLINUX_9P

config BOOTLINUX_TREE_KDEVOPS_NAME
	string
	default "kdevops-linus"

endif # BOOTLINUX_TREE_KDEVOPS_LINUS
```

## workflows/linux/Kconfig.linus
```kconfig
if BOOTLINUX_LINUS

choice
	prompt "Linux tree based on Linus' tree to use"
	default BOOTLINUX_TREE_LINUS

config BOOTLINUX_TREE_LINUS
	bool "linux"
	help
	  Use Linus Torvald's linux tree.

config BOOTLINUX_TREE_KDEVOPS_LINUS
	bool "kdevops-linus"
	help
	  Branches in kdevops' tree based on Linus' tree.

config BOOTLINUX_TREE_MCGROF_LINUS
	bool "mcgrof-linus"
	help
	  Branches in mcgrof's tree based on Linus' tree.

endchoice

if BOOTLINUX_TREE_LINUS

source "workflows/linux/refs/default/Kconfig.linus"
source "workflows/linux/refs/user/Kconfig.linus"

config BOOTLINUX_TREE_LINUS_NAME
	string
	default "linux"

config BOOTLINUX_TREE_LINUS_URL
	string
	default DEFAULT_TORVALDS_HTTPS_URL if !USE_LOCAL_LINUX_MIRROR
	default $(shell, scripts/append-makefile-vars.sh git:// $(KDEVOPS_DEFAULT_BRIDGE_IP_VAGRANT) /mirror/linux.git) if USE_LIBVIRT_MIRROR && !BOOTLINUX_9P && VAGRANT
	default $(shell, scripts/append-makefile-vars.sh git:// $(KDEVOPS_DEFAULT_BRIDGE_IP_GUESTFS) /mirror/linux.git) if USE_LIBVIRT_MIRROR && !BOOTLINUX_9P && GUESTFS
	default "/mirror/linux.git" if USE_LIBVIRT_MIRROR && BOOTLINUX_9P

endif # BOOTLINUX_TREE_LINUS

endif # BOOTLINUX_LINUS
```

## workflows/linux/Kconfig.mcgrof
```kconfig
if BOOTLINUX_TREE_MCGROF_LINUS

source "workflows/linux/refs/default/Kconfig.mcgrof-linus"
source "workflows/linux/refs/user/Kconfig.mcgrof-linus"

endif # BOOTLINUX_TREE_MCGROF_LINUS

if BOOTLINUX_TREE_MCGROF_NEXT

source "workflows/linux/refs/default/Kconfig.mcgrof-next"
source "workflows/linux/refs/user/Kconfig.mcgrof-next"

endif # BOOTLINUX_TREE_MCGROF_NEXT

if BOOTLINUX_TREE_MCGROF_LINUS || BOOTLINUX_TREE_MCGROF_NEXT

config BOOTLINUX_TREE_MCGROF
	bool
	default y

config BOOTLINUX_TREE_MCGROF_NAME
	string
	default "mcgrof-linus" if BOOTLINUX_TREE_MCGROF_LINUS
	default "mcgrof-next" if BOOTLINUX_TREE_MCGROF_NEXT

config BOOTLINUX_TREE_MCGROF_URL
	string
	default "https://git.kernel.org/pub/scm/linux/kernel/git/mcgrof/linux-next.git" if BOOTLINUX_TREE_MCGROF_NEXT && !USE_LOCAL_LINUX_MIRROR
	default "/mirror/mcgrof-next.git" if BOOTLINUX_TREE_MCGROF_NEXT && USE_LIBVIRT_MIRROR && BOOTLINUX_9P
	default "https://git.kernel.org/pub/scm/linux/kernel/git/mcgrof/linux.git" if BOOTLINUX_TREE_MCGROF_LINUS && !USE_LOCAL_LINUX_MIRROR
	default "/mirror/mcgrof-linus.git" if BOOTLINUX_TREE_MCGROF_LINUS && USE_LIBVIRT_MIRROR && BOOTLINUX_9P
	default $(shell, scripts/append-makefile-vars.sh git:// $(KDEVOPS_DEFAULT_BRIDGE_IP_VAGRANT) /mirror/mcgrof-linus.git) if BOOTLINUX_TREE_MCGROF_LINUS && USE_LIBVIRT_MIRROR && !BOOTLINUX_9P && VAGRANT
	default $(shell, scripts/append-makefile-vars.sh git:// $(KDEVOPS_DEFAULT_BRIDGE_IP_GUESTFS) /mirror/mcgrof-next.git) if BOOTLINUX_TREE_MCGROF_NEXT && USE_LIBVIRT_MIRROR && !BOOTLINUX_9P && GUESTFS

endif # BOOTLINUX_TREE_MCGROF_LINUS || BOOTLINUX_TREE_MCGROF_NEXT
```

## workflows/linux/Kconfig.modules
```kconfig
if BOOTLINUX_TREE_MODULES

source "workflows/linux/refs/default/Kconfig.modules"

endif # BOOTLINUX_TREE_MODULES

if BOOTLINUX_TREE_MODULES

config BOOTLINUX_TREE_MODULES_NAME
	string
	default "modules" if BOOTLINUX_TREE_MODULES

config BOOTLINUX_TREE_MODULES_URL
	string
	default DEFAULT_MODULES_GIT_URL if BOOTLINUX_TREE_VFS && !USE_LOCAL_LINUX_MIRROR
	default "/mirror/modules.git" if BOOTLINUX_TREE_MODULES && USE_LIBVIRT_MIRROR && BOOTLINUX_9P
	default $(shell, scripts/append-makefile-vars.sh git:// $(KDEVOPS_DEFAULT_BRIDGE_IP_VAGRANT) /mirror/modules.git) if BOOTLINUX_TREE_MODULES && USE_LIBVIRT_MIRROR && !BOOTLINUX_9P && VAGRANT
	default $(shell, scripts/append-makefile-vars.sh git:// $(KDEVOPS_DEFAULT_BRIDGE_IP_GUESTFS) /mirror/modules.git) if BOOTLINUX_TREE_MODULES && USE_LIBVIRT_MIRROR && !BOOTLINUX_9P && GUESTFS

endif # BOOTLINUX_TREE_MODULES
```

## workflows/linux/Kconfig.stable
```kconfig
if BOOTLINUX_STABLE

choice
	prompt "Linux stable tree to use"
	default BOOTLINUX_TREE_STABLE

config BOOTLINUX_TREE_STABLE
	bool "linux-stable"
	help
	  Use the linux-stable tree.

endchoice

if BOOTLINUX_TREE_STABLE

source "workflows/linux/refs/default/Kconfig.stable"
source "workflows/linux/refs/user/Kconfig.stable"

endif # BOOTLINUX_TREE_STABLE

config BOOTLINUX_TREE_STABLE_NAME
	string
	default "linux-stable" if BOOTLINUX_TREE_STABLE

config BOOTLINUX_TREE_STABLE_URL
	string
	default "https://git.kernel.org/pub/scm/linux/kernel/git/stable/linux.git" if !USE_LOCAL_LINUX_MIRROR
	default $(shell, scripts/append-makefile-vars.sh git:// $(KDEVOPS_DEFAULT_BRIDGE_IP_VAGRANT) /mirror/linux-stable.git) if USE_LIBVIRT_MIRROR && !BOOTLINUX_9P && VAGRANT
	default $(shell, scripts/append-makefile-vars.sh git:// $(KDEVOPS_DEFAULT_BRIDGE_IP_GUESTFS) /mirror/linux-stable.git) if USE_LIBVIRT_MIRROR && !BOOTLINUX_9P && GUESTFS
	default "/mirror/linux-stable.git" if USE_LIBVIRT_MIRROR && BOOTLINUX_9P

endif # BOOTLINUX_STABLE
```

## workflows/linux/Kconfig.stable_rc
```kconfig
if BOOTLINUX_STABLE_RC

choice
	prompt "Linux stable release candidate tree to use"
	default BOOTLINUX_TREE_STABLE_RC

config BOOTLINUX_TREE_STABLE_RC
	bool "linux-stable-rc"
	help
	  Use the linux-stable release candidate tree.

endchoice

if BOOTLINUX_TREE_STABLE_RC

source "workflows/linux/refs/default/Kconfig.stable_rc"
source "workflows/linux/refs/user/Kconfig.stable_rc"

endif # BOOTLINUX_TREE_STABLE_RC

config BOOTLINUX_TREE_STABLE_RC_NAME
	string
	default "linux-stable-rc" if BOOTLINUX_TREE_STABLE_RC

config BOOTLINUX_TREE_STABLE_RC_URL
	string
	default DEFAULT_STABLE_RC_HTTPS_URL if !USE_LOCAL_LINUX_MIRROR
	default $(shell, scripts/append-makefile-vars.sh git:// $(KDEVOPS_DEFAULT_BRIDGE_IP_GUESTFS) /mirror/linux-stable-rc.git) if USE_LIBVIRT_MIRROR && !BOOTLINUX_9P && GUESTFS
	default "/mirror/linux-stable-rc.git" if USE_LIBVIRT_MIRROR && BOOTLINUX_9P

endif # BOOTLINUX_STABLE_RC
```

## workflows/linux/Kconfig.vfs
```kconfig
if BOOTLINUX_TREE_VFS

source "workflows/linux/refs/default/Kconfig.vfs"

endif # BOOTLINUX_TREE_MCGROF_LINUS

if BOOTLINUX_TREE_VFS

config BOOTLINUX_TREE_VFS_NAME
	string
	default "vfs" if BOOTLINUX_TREE_VFS

config BOOTLINUX_TREE_VFS_URL
	string
	default DEFAULT_VFS_GIT_URL if BOOTLINUX_TREE_VFS && !USE_LOCAL_LINUX_MIRROR
	default "/mirror/vfs.git" if BOOTLINUX_TREE_VFS && USE_LIBVIRT_MIRROR && BOOTLINUX_9P
	default $(shell, scripts/append-makefile-vars.sh git:// $(KDEVOPS_DEFAULT_BRIDGE_IP_GUESTFS) /mirror/vfs.git) if BOOTLINUX_TREE_MCGROF_NEXT && USE_LIBVIRT_MIRROR && !BOOTLINUX_9P && GUESTFS

endif # BOOTLINUX_TREE_VFS
```

## workflows/linux/Kconfig.xfs
```kconfig
if BOOTLINUX_TREE_XFS

source "workflows/linux/refs/default/Kconfig.xfs"

endif # BOOTLINUX_TREE_XFS

if BOOTLINUX_TREE_XFS

config BOOTLINUX_TREE_XFS_NAME
	string
	default "xfs-linux" if BOOTLINUX_TREE_XFS

config BOOTLINUX_TREE_XFS_URL
	string
	default DEFAULT_XFS_GIT_URL if BOOTLINUX_TREE_XFS && !USE_LOCAL_LINUX_MIRROR
	default "/mirror/xfs-linux.git" if BOOTLINUX_TREE_XFS && USE_LIBVIRT_MIRROR && BOOTLINUX_9P
	default $(shell, scripts/append-makefile-vars.sh git:// $(KDEVOPS_DEFAULT_BRIDGE_IP_VAGRANT) /mirror/xfs-linux.git) if BOOTLINUX_TREE_XFS && USE_LIBVIRT_MIRROR && !BOOTLINUX_9P && VAGRANT
	default $(shell, scripts/append-makefile-vars.sh git:// $(KDEVOPS_DEFAULT_BRIDGE_IP_GUESTFS) /mirror/xfs-linux.git) if BOOTLINUX_TREE_XFS && USE_LIBVIRT_MIRROR && !BOOTLINUX_9P && GUESTFS

endif # BOOTLINUX_TREE_XFS
```
