## workflows/linux/Kconfig
```kconfig
if BOOTLINUX

config BOOTLINUX_TREE_SET_BY_CLI
	bool
	output yaml
	default $(shell, scripts/check-cli-set-var.sh LINUX_TREE)

config BOOTLINUX_TREE_REF_SET_BY_CLI
	bool
	output yaml
	default $(shell, scripts/check-cli-set-var.sh LINUX_TREE_REF)

config BOOTLINUX_HAS_PURE_IOMAP_CONFIG
	bool

# For images / distros that do not require CONFIG_BUFFER_HEAD To support this
# you should have an image / instance which does not require BLK_DEV_MD (RAID
# support), ext4, vfat, or other older filesystems which require struct buffer
# head usage.
#
# CONFIG_BUFFER_HEAD is only available currently on development branches, not
# even yet part of linux-next. The branches that have support for this must
# select BOOTLINUX_HAS_PURE_IOMAP_CONFIG.
#
# Instances / images which can boot into a kernel without buffer heads then
# must also select HAVE_SUPPORTS_PURE_IOMAP

if HAVE_SUPPORTS_PURE_IOMAP

config BOOTLINUX_PURE_IOMAP
	bool "Use a kernel configuration which disables buffer heads"
	default HAVE_SUPPORTS_PURE_IOMAP
	depends on BOOTLINUX_HAS_PURE_IOMAP_CONFIG

endif # HAVE_SUPPORTS_PURE_IOMAP

choice
	prompt "Kernel build location"
	default BOOTLINUX_TARGETS if !LIBVIRT || GUESTFS_LACKS_9P
	default BOOTLINUX_9P if LIBVIRT && !GUESTFS_LACKS_9P
	help
	  Choose where you want to compile the test kernel. The help
	  for the choices below explain how each alternative works.

config BOOTLINUX_TARGETS
	bool "Target nodes"
	output yaml
	help
	  Choosing this option clones and builds the test kernel on
	  each target node, then installs the test kernel and
	  reboots each target node. These actions are triggered by
	  using "make linux".

	  This choice is best when the target node configuration is
	  vastly different than the controller node's configuration.
	  It is the only choice available when the target nodes
	  reside in the cloud.

config BOOTLINUX_9P
	bool "Controller node"
	output yaml
	depends on LIBVIRT && !GUESTFS_LACKS_9P
	help
	  Choosing this option clones and builds the test kernel on
	  the Ansible controller node. Once the test kernel is
	  built, the target nodes access the controller node's build
	  directory via 9p to install the test kernel, then each
	  target node is rebooted into the new kernel. These actions
	  are triggered by using "make linux".

	  This is quick and efficient (since the kernel is built only
	  once, and the build has access to all compute resources on
	  the controller node). The source tree and compiled artifacts
	  are not removed when the test runners are destroyed, so
	  subsequent builds can be fast.

	  However, 9p is available only when using a local
	  virtualization method such as libvirt.

config BOOTLINUX_BUILDER
	bool "Separate kernel builder"
	output yaml
	help
	  Enabling this option brings up a separate guest/instance
	  for building the Linux kernel to test. The new kernel is
	  packaged appropriately for installation on other systems,
	  but is not installed. Once the kernel is built, the kernel
	  packages are saved on the controller host and the builder
	  node can be destroyed.

	  This choice is best when the test runners are resource-
	  limited or vastly different than the controller host.

endchoice

if BOOTLINUX_9P

menu "Modify default 9p configuration"
config BOOTLINUX_9P_HOST_PATH
	string "9p host path"
	default $(shell, echo $PWD/linux)
	help
	  This sets the 9p host path that will be used. This is the path
	  that has your or we'll clone the respective linux git tree.
	  If you have no git tree present there we'll git clone Linux there
	  for you. Otherwise we'll just reset the tree for you and build Linux
	  there for you. We build Linux only once.

config BOOTLINUX_9P_MSIZE
	int "9p msize"
	default 131072
	help
	  This sets the msize value. Prior to v5.15 this was set to 8 KiB as
	  default, however this is reported to have produced pretty terrible
	  performance, and so this was bumped 128 KiB as default after v5.15.
	  The qemu wiki [0] seems to suggest to use a range between 10-100 MiB
	  for SATA and however that is a lie as 500 KiB (512000) is the maximum
	  value possible. Also, using the max value possible I get a different
	  value for sha1sum on files! So let's just stick to the default
	  of 128 KiB (131072). If you are going to update the default value
	  for msize on kdevops please make sure you test this and it works.

	  [0] https://wiki.qemu.org/Documentation/9psetup

config BOOTLINUX_9P_FSDEV
	string "9p fsdev"
	default "kdevops_9p_fsdev"
	help
	  This sets the 9p fsdev ID. This is used by libvirt if that is enabled,
	  and then by the respective mount command.

config BOOTLINUX_9P_SECURITY_MODEL
	string "9p security model"
	default "none"
	help
	  The security model to use.

config BOOTLINUX_9P_DRIVER
	string "9p driver to use"
	default "virtio-9p-pci"
	help
	  The security model to use.

config BOOTLINUX_9P_MOUNT_TAG
	string "9p mount tag"
	default "kdevops_9p_bootlinux"
	help
	  This sets the 9p mount tag to use.

endmenu

endif # BOOTLINUX_9P

choice
	prompt "Compiler to use to build the kernel"
	default BOOTLINUX_COMPILER_GCC
	help
	  Choose which toolchain to use to build the kernel.

config BOOTLINUX_COMPILER_GCC
	bool "gcc"
	output yaml
	help
	  Use the gcc compiler toolchain to build the Linux kernel.

config BOOTLINUX_COMPILER_CLANG
	bool "clang"
	output yaml
	help
	  Use the clang compiler toolchain to build the Linux kernel.

endchoice

choice
	prompt "Type of development version of Linux to use"
	default BOOTLINUX_LINUS if !BOOTLINUX_TREE_SET_BY_CLI && !BOOTLINUX_TREE_REF_SET_BY_CLI
	default BOOTLINUX_CUSTOM if BOOTLINUX_TREE_SET_BY_CLI || BOOTLINUX_TREE_REF_SET_BY_CLI

config BOOTLINUX_LINUS
	bool "Linux releases based on Linus' tree"
	help
	  This will let you choose Linux trees based on Linus' tree.

config BOOTLINUX_STABLE
	bool "Stable Linux releases"
	help
	  This will let you choose from stable Linux trees only.

config BOOTLINUX_DEV
	bool "Development Linux releases"
	help
	  This will let you choose from development Linux trees only. Mostly
	  linux-next based trees.

config BOOTLINUX_CUSTOM
	bool "Custom Linux releases"
	help
	  This will let you enter in your own git tree URL / branch / ID.

endchoice

source "workflows/linux/Kconfig.linus"
source "workflows/linux/Kconfig.stable"
source "workflows/linux/Kconfig.dev"
source "workflows/linux/Kconfig.modules"
source "workflows/linux/Kconfig.next"
source "workflows/linux/Kconfig.vfs"
source "workflows/linux/Kconfig.xfs"

# Later on we could automate this with 'make dynconfig' and reading
# dynamically kernel.org's sources / branches.
source "workflows/linux/Kconfig.kdevops"
source "workflows/linux/Kconfig.mcgrof"
source "workflows/linux/Kconfig.jlayton"
source "workflows/linux/Kconfig.cel"
source "workflows/linux/Kconfig.stable_rc"

source "workflows/linux/Kconfig.btrfs"

if BOOTLINUX_CUSTOM

config BOOTLINUX_TREE_CUSTOM_NAME
	string "Custom Linux kernel tree name"
	default "linux"
	help
	  Short name to describe your custom tree. This will be used for the
	  the path used to place linux on the nodes on /data/$BOOTLINUX_TREE_NAME.

config BOOTLINUX_TREE_CUSTOM_URL
	string "Custom git tree URL"
	default $(shell, ./scripts/append-makefile-vars.sh $(LINUX_TREE)) if BOOTLINUX_TREE_SET_BY_CLI
	default "git://git.kernel.org/pub/scm/linux/kernel/git/torvalds/linux.git" if !BOOTLINUX_TREE_SET_BY_CLI

config BOOTLINUX_TREE_CUSTOM_REF
	string "Custom Linux kernel tag or branch to use"
	default $(shell, ./scripts/append-makefile-vars.sh $(LINUX_TREE_REF)) if BOOTLINUX_TREE_REF_SET_BY_CLI
	default "master" if !BOOTLINUX_TREE_REF_SET_BY_CLI
	help
	  The git ID or branch name to check out to compile linux.

endif # BOOTLINUX_CUSTOM

# This ends up being the directory name used for the /data/ partition
# where linux is deployed on the nodes.
config BOOTLINUX_TREE_NAME
	string
	default BOOTLINUX_TREE_LINUS_NAME if BOOTLINUX_TREE_LINUS
	default BOOTLINUX_TREE_STABLE_NAME if BOOTLINUX_TREE_STABLE
	default BOOTLINUX_TREE_STABLE_RC_NAME if BOOTLINUX_TREE_STABLE_RC
	default BOOTLINUX_TREE_NEXT_NAME if BOOTLINUX_TREE_NEXT
	default BOOTLINUX_TREE_BTRFS_DEVEL_NAME if BOOTLINUX_TREE_BTRFS_DEVEL
	default BOOTLINUX_TREE_KDEVOPS_NAME if BOOTLINUX_TREE_KDEVOPS_LINUS
	default BOOTLINUX_TREE_MCGROF_NAME if BOOTLINUX_TREE_MCGROF
	default BOOTLINUX_TREE_MODULES_NAME if BOOTLINUX_TREE_MODULES
	default BOOTLINUX_TREE_JLAYTON_LINUX_NAME if BOOTLINUX_TREE_JLAYTON_LINUX
	default BOOTLINUX_TREE_CEL_LINUX_NAME if BOOTLINUX_TREE_CEL_LINUX
	default BOOTLINUX_TREE_CUSTOM_NAME if BOOTLINUX_CUSTOM
	default BOOTLINUX_TREE_VFS_NAME if BOOTLINUX_TREE_VFS
	default BOOTLINUX_TREE_XFS_NAME if BOOTLINUX_TREE_XFS

config BOOTLINUX_TREE
	string
	default BOOTLINUX_TREE_LINUS_URL if BOOTLINUX_TREE_LINUS
	default BOOTLINUX_TREE_STABLE_URL if BOOTLINUX_TREE_STABLE
	default BOOTLINUX_TREE_STABLE_RC_URL if BOOTLINUX_TREE_STABLE_RC
	default BOOTLINUX_TREE_NEXT_URL if BOOTLINUX_TREE_NEXT
	default BOOTLINUX_TREE_MCGROF_URL if BOOTLINUX_TREE_MCGROF
	default BOOTLINUX_TREE_MODULES_URL if BOOTLINUX_TREE_MODULES
	default BOOTLINUX_TREE_KDEVOPS_URL if BOOTLINUX_TREE_KDEVOPS_LINUS
	default BOOTLINUX_TREE_BTRFS_DEVEL_URL if BOOTLINUX_TREE_BTRFS_DEVEL
	default BOOTLINUX_TREE_JLAYTON_LINUX_URL if BOOTLINUX_TREE_JLAYTON_LINUX
	default BOOTLINUX_TREE_CEL_LINUX_URL if BOOTLINUX_TREE_CEL_LINUX
	default BOOTLINUX_TREE_VFS_URL if BOOTLINUX_TREE_VFS
	default BOOTLINUX_TREE_XFS_URL if BOOTLINUX_TREE_XFS
	default BOOTLINUX_TREE_CUSTOM_URL if BOOTLINUX_CUSTOM

config BOOTLINUX_TEST_MESSAGE_ID_SET_BY_CLI
	bool
	default $(shell, scripts/check-cli-set-var.sh B4_MESSAGE_ID)

config BOOTLINUX_TEST_MESSAGE_ID
	bool "Test mailing list message ID"
	default BOOTLINUX_TEST_MESSAGE_ID_SET_BY_CLI
	select BOOTLINUX_TEST_MESSAGE_ID_INSTALL_B4 if BOOTLINUX_TEST_MESSAGE_ID
	help
	  When enabled, the b4 command from public-inbox will rebase the patches
	  contained in the message-id on top of a baseline kernel and install it
	  in the development box. A baseline kernel without the patches will be
	  installed in the baseline box. The effects of the patch on the tests
	  can then be seen as the difference between the baseline and development
	  test runs.

config BOOTLINUX_TEST_MESSAGE_ID_THREAD_ID
	string "The message ID"
	default $(shell, ./scripts/append-makefile-vars.sh $(B4_MESSAGE_ID)) if BOOTLINUX_TEST_MESSAGE_ID_SET_BY_CLI
	default "" if !BOOTLINUX_TEST_MESSAGE_ID_SET_BY_CLI
	depends on BOOTLINUX_TEST_MESSAGE_ID
	help
	  The message id that will be rebased on top of the baseline kernel in
	  the development box.

config BOOTLINUX_TEST_MESSAGE_ID_INSTALL_B4
	bool
	default n
	depends on BOOTLINUX_TEST_MESSAGE_ID
	prompt "Install b4 on development system" if BOOTLINUX_TEST_MESSAGE_ID
	help
	  When enabled, b4 will be installed using pip

config BOOTLINUX_TREE_REF
	string
	default BOOTLINUX_TREE_LINUS_REF if BOOTLINUX_TREE_LINUS
	default BOOTLINUX_TREE_STABLE_REF if BOOTLINUX_STABLE
	default BOOTLINUX_TREE_STABLE_RC_REF if BOOTLINUX_STABLE_RC
	default BOOTLINUX_TREE_NEXT_REF if BOOTLINUX_TREE_NEXT
	default BOOTLINUX_TREE_VFS_REF if BOOTLINUX_TREE_VFS
	default BOOTLINUX_TREE_XFS_REF if BOOTLINUX_TREE_XFS
	default BOOTLINUX_TREE_BTRFS_DEVEL_REF if BOOTLINUX_TREE_BTRFS_DEVEL
	default BOOTLINUX_TREE_KDEVOPS_LINUS_REF if BOOTLINUX_TREE_KDEVOPS_LINUS
	default BOOTLINUX_TREE_MCGROF_LINUS_REF if BOOTLINUX_TREE_MCGROF_LINUS
	default BOOTLINUX_TREE_MCGROF_NEXT_REF if BOOTLINUX_TREE_MCGROF_NEXT
	default BOOTLINUX_TREE_MODULES_REF if BOOTLINUX_TREE_MODULES
	default BOOTLINUX_TREE_JLAYTON_LINUX_REF if BOOTLINUX_TREE_JLAYTON_LINUX
	default BOOTLINUX_TREE_CEL_LINUX_REF if BOOTLINUX_TREE_CEL_LINUX
	default BOOTLINUX_TREE_CUSTOM_REF if BOOTLINUX_CUSTOM

config BOOTLINUX_TREE_CUSTOM_KERNELRELEASE
	bool "Do you want a full custom kernel release name?"
	output yaml
	help
	  Do you want a full custom Linux kernel release which will be output
	  through uname?

config BOOTLINUX_TREE_KERNELRELEASE
	string "Linux kernel release version to use"
	depends on BOOTLINUX_TREE_CUSTOM_KERNELRELEASE
	help
	  The Linux kernel release version to use (for uname).

	  The string here (e.g. 'devel') will be appended to the result of make
	  kernelversion. Example: '6.8.0-rc3-devel'

config BOOTLINUX_TREE_CUSTOM_LOCALVERSION
	bool "Do you want to append a custom kernel release tag?"
	output yaml
	help
	  Do you want a full custom Linux kernel release which will be output
	  through uname?

config BOOTLINUX_TREE_LOCALVERSION
	string "Linux local version to use"
	depends on BOOTLINUX_TREE_CUSTOM_LOCALVERSION
	help
	  The Linux local version to use (for uname).

config BOOTLINUX_SHALLOW_CLONE
	bool "Shallow git clone"
	default y if !KDEVOPS_BASELINE_AND_DEV
	depends on !BOOTLINUX_AB_DIFFERENT_REF
	help
	  If enabled the git tree cloned with be cloned using a shallow tree
	  with history truncated. You want to enable this if you really don't
	  care about the git history on the targets which will clone Linux.
	  Using a full shallow tree will save you about 5 minutes in time.
	  You want to say no here (the default) if you are using the targets
	  for actual kernel development. You want to enable this if you are
	  just using the targets as dummy target runners and don't expect to
	  be using 'git log' on the target guests.

	  This option is automatically disabled when using A/B testing with
	  different kernel references, as shallow clones may not contain all
	  the required refs for checkout.

config BOOTLINUX_SHALLOW_CLONE_DEPTH
	int "Shallow git clone depth"
	default 30 if BOOTLINUX_TREE_SET_BY_CLI
	default 1 if !BOOTLINUX_TREE_SET_BY_CLI
	depends on BOOTLINUX_SHALLOW_CLONE
	help
	  Create a shallow clone with a history truncated to the specified
	  number or revisions. The minimum possible value is 1, otherwise
	  ignored. Needs git>=1.9.1 to work correctly.

if KDEVOPS_BASELINE_AND_DEV

choice
	prompt "A/B kernel testing configuration"
	default BOOTLINUX_AB_SAME_REF
	help
	  When A/B testing is enabled, you can choose to use the same
	  kernel reference for both baseline and dev nodes, or specify
	  different kernel references to test different kernel versions.

config BOOTLINUX_AB_SAME_REF
	bool "Use same kernel reference for baseline and dev"
	output yaml
	help
	  Use the same kernel tree and reference for both baseline and
	  development nodes. This is useful for testing configuration
	  changes or different test parameters with the same kernel.

config BOOTLINUX_AB_DIFFERENT_REF
	bool "Use different kernel references for baseline and dev"
	output yaml
	help
	  Use different kernel references for baseline and development
	  nodes. This enables testing between different kernel versions,
	  commits, or branches. The baseline will use the main configured
	  kernel reference, while dev uses a separate reference.

endchoice

if BOOTLINUX_AB_DIFFERENT_REF

config BOOTLINUX_DEV_TREE
	string "Development kernel tree URL"
	output yaml
	default BOOTLINUX_TREE
	help
	  Git tree URL for the development kernel. If left empty or same
	  as the baseline tree, the same tree will be used with a different
	  reference. This allows testing different branches or forks.

config TARGET_LINUX_DEV_REF
	string "Development kernel reference"
	output yaml
	default $(shell, scripts/infer_last_stable_kernel.sh)
	help
	  Git reference (branch, tag, or commit) for the development kernel.
	  This should be different from the baseline reference to enable
	  meaningful A/B comparison between kernel versions.

	  The default is automatically inferred as the most recent stable
	  kernel version (e.g., v6.15) from the git repository.

	  Examples:
	  - "v6.8" (stable release)
	  - "linux-next" (latest development)
	  - "v6.7..v6.8" (range for bisection)
	  - commit SHA (specific commit)

config TARGET_LINUX_DEV_KERNELRELEASE
	string "Development kernel release version"
	depends on BOOTLINUX_TREE_CUSTOM_KERNELRELEASE
	output yaml
	help
	  The string here (e.g. 'devel') will be appended to the result of make
	  kernelversion. Example: '6.8.0-rc3-devel' but only for the dev group.
	  Leave it empty unless you want a custom tag at the end.

config TARGET_LINUX_DEV_LOCALVERSION
	string "Development kernel local version"
	output yaml
	depends on BOOTLINUX_TREE_CUSTOM_LOCALVERSION
	default BOOTLINUX_TREE_LOCALVERSION
	help
	  The Linux local version to use for the development kernel (for uname).
	  If left empty, will use the same as baseline.

endif # BOOTLINUX_AB_DIFFERENT_REF

endif # KDEVOPS_BASELINE_AND_DEV

endif # BOOTLINUX
```
