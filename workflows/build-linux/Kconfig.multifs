## workflows/build-linux/Kconfig.multifs
```kconfig
menu "Multi-filesystem testing configuration"

config BUILD_LINUX_ENABLE_MULTIFS_TESTING
	bool "Enable multi-filesystem testing"
	default n
	output yaml
	help
	  Enable testing kernel builds across multiple filesystem
	  configurations. This allows comparing build performance
	  characteristics between different filesystems and their
	  configurations.

	  When enabled, the build workflow will run on multiple nodes,
	  each with a different filesystem configuration, allowing for
	  detailed performance analysis across different storage backends.

if BUILD_LINUX_ENABLE_MULTIFS_TESTING

config BUILD_LINUX_MULTIFS_TEST_XFS
	bool "Test XFS configurations"
	default y
	output yaml
	help
	  Enable testing kernel builds on XFS filesystem with different
	  block size configurations.

if BUILD_LINUX_MULTIFS_TEST_XFS

menu "XFS configuration profiles"

config BUILD_LINUX_MULTIFS_XFS_4K_4KS
	bool "XFS 4k block size - 4k sector size"
	default y
	output yaml
	help
	  Test kernel builds on XFS with 4k filesystem block size
	  and 4k sector size. This is the most common configuration
	  and provides good performance for most workloads.

config BUILD_LINUX_MULTIFS_XFS_8K_4KS
	bool "XFS 8k block size - 4k sector size"
	default n
	output yaml
	help
	  Test kernel builds on XFS with 8k filesystem block size
	  and 4k sector size. Slightly larger block size for improved
	  I/O efficiency.

config BUILD_LINUX_MULTIFS_XFS_16K_4KS
	bool "XFS 16k block size - 4k sector size"
	default n
	output yaml
	help
	  Test kernel builds on XFS with 16k filesystem block size
	  and 4k sector size. Larger block sizes can improve performance
	  for large file operations common in kernel builds.

config BUILD_LINUX_MULTIFS_XFS_32K_4KS
	bool "XFS 32k block size - 4k sector size"
	default n
	output yaml
	help
	  Test kernel builds on XFS with 32k filesystem block size
	  and 4k sector size. Even larger block sizes can provide
	  benefits for builds with many large object files.

config BUILD_LINUX_MULTIFS_XFS_64K_4KS
	bool "XFS 64k block size - 4k sector size"
	default n
	output yaml
	help
	  Test kernel builds on XFS with 64k filesystem block size
	  and 4k sector size. Maximum supported block size for XFS,
	  testing extreme configurations for kernel builds.

endmenu

endif # BUILD_LINUX_MULTIFS_TEST_XFS

config BUILD_LINUX_MULTIFS_TEST_EXT4
	bool "Test ext4 configurations"
	default y
	output yaml
	help
	  Enable testing kernel builds on ext4 filesystem with different
	  configurations including bigalloc options.

if BUILD_LINUX_MULTIFS_TEST_EXT4

menu "ext4 configuration profiles"

config BUILD_LINUX_MULTIFS_EXT4_4K
	bool "ext4 4k block size"
	default y
	output yaml
	help
	  Test kernel builds on ext4 with standard 4k block size.
	  This is the default ext4 configuration.

config BUILD_LINUX_MULTIFS_EXT4_16K_BIGALLOC
	bool "ext4 16k bigalloc"
	default n
	output yaml
	help
	  Test kernel builds on ext4 with 16k bigalloc enabled.
	  Bigalloc reduces metadata overhead and can improve
	  performance for large file workloads like kernel builds.

endmenu

endif # BUILD_LINUX_MULTIFS_TEST_EXT4

config BUILD_LINUX_MULTIFS_TEST_BTRFS
	bool "Test btrfs configurations"
	default y
	output yaml
	help
	  Enable testing kernel builds on btrfs filesystem with
	  common default configuration profile.

if BUILD_LINUX_MULTIFS_TEST_BTRFS

menu "btrfs configuration profiles"

config BUILD_LINUX_MULTIFS_BTRFS_DEFAULT
	bool "btrfs default profile"
	default y
	output yaml
	help
	  Test kernel builds on btrfs with default configuration.
	  This includes modern defaults with free-space-tree and
	  no-holes features enabled.

endmenu

endif # BUILD_LINUX_MULTIFS_TEST_BTRFS

config BUILD_LINUX_MULTIFS_TEST_TMPFS
	bool "Test tmpfs (RAM filesystem)"
	default n
	output yaml
	help
	  Enable testing kernel builds on tmpfs (RAM-based filesystem).
	  This provides the fastest possible build times but requires
	  sufficient RAM to hold the entire kernel build.

if BUILD_LINUX_MULTIFS_TEST_TMPFS

menu "tmpfs configuration profiles"

config BUILD_LINUX_MULTIFS_TMPFS_DEFAULT
	bool "tmpfs default profile"
	default y
	output yaml
	help
	  Test kernel builds on tmpfs with default configuration.
	  This will use RAM for the build directory, providing
	  maximum performance if sufficient memory is available.

endmenu

config BUILD_LINUX_TMPFS_MEM_GB
	int "Memory in GB for tmpfs build nodes"
	default 32
	range 16 128
	output yaml
	help
	  Amount of memory in gigabytes to allocate for tmpfs build nodes.
	  Building the Linux kernel in tmpfs requires significant memory:
	  - Minimum 16GB for a shallow clone build
	  - Recommended 32GB for comfortable operation
	  - 64GB or more for full clone builds

	  This memory is only allocated to nodes with tmpfs in their name
	  when the build-linux workflow is enabled.

endif # BUILD_LINUX_MULTIFS_TEST_TMPFS

config BUILD_LINUX_MULTIFS_RESULTS_DIR
	string "Multi-filesystem results directory"
	output yaml
	default "/data/build-linux-multifs-benchmark"
	help
	  Directory where multi-filesystem test results and logs will be stored.
	  Each filesystem configuration will have its own subdirectory.

config BUILD_LINUX_MULTIFS_USE_NODE_FS
	bool "Automatically detect filesystem type from node name"
	default y
	output yaml
	help
	  When enabled, the filesystem type for build storage will be
	  automatically determined based on the node's configuration name.
	  For example, nodes named *-xfs-* will use XFS, *-ext4-* will
	  use ext4, *-btrfs-* will use Btrfs, and *-tmpfs-* will use tmpfs.

endif # BUILD_LINUX_ENABLE_MULTIFS_TESTING

endmenu
```

## workflows/demos/reboot-limit/Kconfig
```kconfig
config WORKFLOWS_REBOOT_LIMIT
	bool "Reboot-limit"
	help
	  If you are doing kernel tests which includes a reboot, along the way,
	  or if you do a reboot after a series of tests, you may want to first
	  figure out what your upper bound limit is on successful reboots
	  without any issue are before running a series of tests. Without this,
	  you really have no idea clearly if you can reboot without issues
	  forever and may end up with a false positive on an unidentified issue.

if WORKFLOWS_REBOOT_LIMIT

menu "Configure and reboot-limit"
choice
	prompt "Reboot test type"
	default REBOOT_LIMIT_TYPE_ANSIBLE

config REBOOT_LIMIT_TYPE_ANSIBLE
	bool "Use the Ansible reboot module"
	help
	  Ansible has a module to reboot. Its implementation is to
	  run 'shutdown -r'. If you are OK with this then select
	  this.

config REBOOT_LIMIT_TYPE_SYSTEMD_REBOOT
	bool "Use systemctl reboot"
	help
	  This will try to reboot instead using systemctl reboot.

config REBOOT_LIMIT_TYPE_SYSTEMD_KEXEC
	bool "Use systemctl kexec"
	help
	  This will try to reboot instead using systemctl kexec.

config REBOOT_LIMIT_TYPE_COMPARE_BOTH
	bool "Compare regular reboot vs kexec"
	help
	  This will test both regular reboot (ansible) and kexec reboot
	  sequentially to compare their performance characteristics.
	  Regular reboot will be tested first, followed by kexec reboot.
	  Statistics will be collected separately for each reboot type.

endchoice

config REBOOT_LIMIT_TEST_TYPE
	string
	default "ansible" if REBOOT_LIMIT_TYPE_ANSIBLE
	default "systemctl_reboot" if REBOOT_LIMIT_TYPE_SYSTEMD_REBOOT
	default "systemctl_kexec" if REBOOT_LIMIT_TYPE_SYSTEMD_KEXEC
	default "compare_both" if REBOOT_LIMIT_TYPE_COMPARE_BOTH

config REBOOT_LIMIT_COMPARE_BOTH_ENABLED
	bool
	default y if REBOOT_LIMIT_TYPE_COMPARE_BOTH
	help
	  Internal configuration variable to track when comparison mode is enabled.

config REBOOT_LIMIT_BOOT_MAX
	int "How many reboots should we do to consider reboots OK?"
	default 100
	help
	  This will make the make reboot-limit-baseline consist of the number
	  specified of reboots.

config REBOOT_LIMIT_WATCHDOG
	bool "Enable a watchdog for the reboot-limit test"
	help
	  This can be enabled but doesn't do much yet. Eventually this will
	  use the systemd built-in watchdog. But we have to also consider
	  the really rare cases where even Ansible times out. Could be due
	  to a DHCP after bootup, for example.

if REBOOT_LIMIT_WATCHDOG

config REBOOT_LIMIT_WATCHDOG_CHECK_TIME
	int "How often to run the reboot-limit watchdog in seconds"
	default 5
	help
	  How often to trigger running the reboot-limit watchdog, in seconds.

endif

config REBOOT_LIMIT_ENABLE_LOOP
	bool "Enable loop testing for reboot-limit"
	default y
	help
	  Enable this to run reboot-limit tests in a loop until a failure
	  is found or steady state is reached.

if REBOOT_LIMIT_ENABLE_LOOP

config REBOOT_LIMIT_LOOP_STEADY_STATE_GOAL
	int "Steady-state goal for reboot-limit loop testing"
	default 100
	help
	  The maximum number of successful test loops to run before
	  declaring steady state achieved. Each loop runs REBOOT_LIMIT_BOOT_MAX
	  reboots, so the total number of reboots is this value multiplied
	  by REBOOT_LIMIT_BOOT_MAX.

config REBOOT_LIMIT_LOOP_STEADY_STATE_INCREMENTAL
	bool "Use incremental steady-state counting"
	default y
	help
	  Enable this so that the loop will resume from the last success
	  counter after failures rather than resetting to zero.

endif # REBOOT_LIMIT_ENABLE_LOOP

config REBOOT_LIMIT_BOOT_COUNT_CRASH_ENABLE
	bool "Force a crash after certain period of reboots"
	help
	  Enable the system to be crashed after a period of number of boots.

config REBOOT_LIMIT_BOOT_COUNT_CRASH
	int "After how many reboots should we force a crash"
	depends on REBOOT_LIMIT_BOOT_COUNT_CRASH_ENABLE
	help
	  After how many boots should we force a crash.

config REBOOT_LIMIT_ENABLE_DATA_COLLECTION
	bool "Enable data collection stats on every reboot"
	default y
	help
	  Enable this if you want to collect some statistics after every boot.

if REBOOT_LIMIT_ENABLE_DATA_COLLECTION

config REBOOT_LIMIT_DATA
	string "Where to place boot statistics as we move forward with tests"
	default "{{data_path}}/reboot-limit"
	help
	  This is the target location of where to we'd place the boot statistics
	  of each node. Note that {{data_path}} corresponds to the location set
	  by the configuration option CONFIG_WORKFLOW_DATA_PATH.

config REBOOT_LIMIT_DATA_REGULAR
	string "Where to place regular reboot statistics in comparison mode"
	default "{{data_path}}/reboot-limit/regular"
	depends on REBOOT_LIMIT_COMPARE_BOTH_ENABLED
	help
	  This is the target location for regular (ansible) reboot statistics
	  when running in comparison mode.

config REBOOT_LIMIT_DATA_KEXEC
	string "Where to place kexec reboot statistics in comparison mode"
	default "{{data_path}}/reboot-limit/kexec"
	depends on REBOOT_LIMIT_COMPARE_BOTH_ENABLED
	help
	  This is the target location for kexec reboot statistics
	  when running in comparison mode.

config REBOOT_LIMIT_ENABLE_SYSTEMD_ANALYZE
	bool "Enable data collection of systemd-analyze results"
	default y
	help
	  Enable this if you want to collect some systemd-analyze results
	  after every boot.

endif # REBOOT_LIMIT_ENABLE_DATA_COLLECTION

endmenu
endif # WORKFLOWS_REBOOT_LIMIT
```
